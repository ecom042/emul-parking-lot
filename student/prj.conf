## CMakeLists.txt
```
cmake_minimum_required(VERSION 3.20.0)
# The lab's board (hardware/boards/ufal/parking_lot_u5) and course bindings.
list(APPEND BOARD_ROOT ${CMAKE_CURRENT_SOURCE_DIR}/../hardware)
list(APPEND DTS_ROOT ${CMAKE_CURRENT_SOURCE_DIR}/../hardware)
find_package(Zephyr REQUIRED HINTS $ENV{ZEPHYR_BASE})
project(parking_student)
target_sources(app PRIVATE
  src/main.c
  src/hw.c
  src/lane.c
  src/adc_sampler.c
  src/line_parser.c
  src/protocol.c
  src/sessions.c
  src/tariff.c
  src/display.c
  src/font.c
)
```

## Kconfig
```
source "Kconfig.zephyr"

config PARKING_CAPACITY
	int "Maximum number of parked cars"
	default 4
	range 1 8

config PARKING_TARIFF_UNIT_MS
	int "Tariff unit duration in milliseconds"
	default 60000
	range 1000 60000
```

## prj.conf
```kconfig
CONFIG_CONSOLE=y
CONFIG_UART_CONSOLE=y
CONFIG_PRINTK=y
CONFIG_SERIAL=y
CONFIG_GPIO=y
CONFIG_SPI=y
CONFIG_ADC=y
CONFIG_ADC_ASYNC=y
CONFIG_PM=n
# Firmware do estacionamento
CONFIG_POLL=y
CONFIG_UART_INTERRUPT_DRIVEN=y
CONFIG_RING_BUFFER=y
CONFIG_MAIN_THREAD_PRIORITY=2
CONFIG_MAIN_STACK_SIZE=2048
```

## app.overlay
```dts
#include "../hardware/parking.overlay"
```

## src/main.c
```c
/*
 * Firmware do estacionamento: laço de controle e thread do display.
 *
 * Threads:
 *  - main (prioridade alta, o laço de controle): a cada volta, atende as
 *    duas faixas (lane_tick), as três UARTs, o ADC e o display. Nunca
 *    bloqueia: só dorme até o próximo evento (EXTI, byte de UART, display
 *    pronto) ou no máximo LOOP_PERIOD_MS;
 *  - display (prioridade baixa): desenha no ST7789V quando o laço pede. O
 *    SPI bloqueia enquanto envia, mas o laço tem prioridade maior e
 *    interrompe a thread do display sempre que precisa (REQ-04: a espera
 *    de uma faixa não atrasa a segurança da outra).
 */
#include <string.h>

#include <zephyr/kernel.h>
#include <zephyr/sys/atomic.h>
#include <zephyr/sys/printk.h>

#include "adc_sampler.h"
#include "display.h"
#include "hw.h"
#include "lane.h"
#include "line_parser.h"
#include "sessions.h"
#include "ui.h"

/** Período máximo do laço. Os prazos têm folga de 10 ms; 2 ms basta. */
#define LOOP_PERIOD_MS 2

#define DISPLAY_STACK 1536
#define DISPLAY_PRIORITY 10

static struct lane lanes[LANE_COUNT];
static struct line_parser parsers[UART_COUNT];

/* ---- Thread do display -------------------------------------------------- */

struct ui_request {
	bool amount_step; /* false: placa; true: valor e avisos */
	char plate[PLATE_LEN + 1];
	uint32_t centavos;
};

K_MSGQ_DEFINE(ui_queue, sizeof(struct ui_request), 2, 4);

/** Resultado da última etapa: 0 nada, 1 ok, 2 erro (lido pelo laço). */
static atomic_t ui_done;

int ui_request_plate(const char *plate)
{
	struct ui_request req = {.amount_step = false};

	memcpy(req.plate, plate, sizeof(req.plate));
	return k_msgq_put(&ui_queue, &req, K_NO_WAIT);
}

int ui_request_amount(uint32_t centavos)
{
	struct ui_request req = {.amount_step = true, .centavos = centavos};

	return k_msgq_put(&ui_queue, &req, K_NO_WAIT);
}

static void display_thread(void *a, void *b, void *c)
{
	ARG_UNUSED(a);
	ARG_UNUSED(b);
	ARG_UNUSED(c);
	struct ui_request req;
	/* A inicialização (cerca de 400 ms de esperas) acontece em paralelo. */
	int init_rc = display_init();

	printk("display init %d\n", init_rc);
	for (;;) {
		(void)k_msgq_get(&ui_queue, &req, K_FOREVER);
		int rc = init_rc;

		if (rc == 0) { /* LCOV_EXCL_LINE: a inicialização do display não falha no modelo */
			rc = req.amount_step ? display_show_amount(req.centavos)
					     : display_show_plate(req.plate);
		}
		atomic_set(&ui_done, rc == 0 ? 1 : 2); /* LCOV_EXCL_LINE: o SPI não falha no modelo; o caso de erro é testado em tests/faixa */
		hw_wake();
	}
}

K_THREAD_DEFINE(display_tid, DISPLAY_STACK, display_thread, NULL, NULL, NULL,
		DISPLAY_PRIORITY, 0, 0);

/* ---- Laço de controle --------------------------------------------------- */

/** Lê os bytes de uma UART e entrega as linhas completas à faixa certa. */
static void service_uart(enum uart_ch ch, int64_t now)
{
	uint8_t bytes[32];
	size_t n;

	while ((n = hw_uart_read(ch, bytes, sizeof(bytes))) > 0U) {
		for (size_t i = 0; i < n; i++) {
			if (line_parser_feed(&parsers[ch], bytes[i], now) < 0) {
				continue;
			}
			const char *line = parsers[ch].buf;

			if (ch == UART_PAYMENT) {
				lane_on_payment_line(&lanes[LANE_EXIT], line, now);
			} else {
				lane_on_camera_line(&lanes[ch == UART_CAM_ENTRY ? LANE_ENTRY : LANE_EXIT],
						    line, now);
			}
		}
	}
	line_parser_poll(&parsers[ch], now);
}

int main(void)
{
	int64_t now = hw_now_ms();
	bool adc_fault_reported = false;

	if (hw_init() != 0) { /* LCOV_EXCL_LINE: os drivers sempre ficam prontos no Renode */
		/* Nada é seguro sem os drivers: fica parado com o vermelho aceso. */
		printk("PARKING: hardware init failed\n"); /* LCOV_EXCL_LINE: drivers sempre prontos no Renode */
		return 0;                                 /* LCOV_EXCL_LINE: idem */
	}
	sessions_reset();
	adc_sampler_reset();
	lane_module_reset();
	line_parser_init(&parsers[UART_CAM_ENTRY], LINE_CRLF);
	line_parser_init(&parsers[UART_CAM_EXIT], LINE_CRLF);
	line_parser_init(&parsers[UART_PAYMENT], LINE_LF);
	lane_init(&lanes[LANE_ENTRY], LANE_ENTRY, now);
	lane_init(&lanes[LANE_EXIT], LANE_EXIT, now);
	printk("PARKING: ready (capacity %d, tariff unit %d ms)\n", CONFIG_PARKING_CAPACITY,
	       CONFIG_PARKING_TARIFF_UNIT_MS);

	for (;;) {
		struct adc_sample sample;

		now = hw_now_ms();

		/* 1. Segurança primeiro: fins de curso, feixe, prazos, buzzer. */
		lane_tick(&lanes[LANE_ENTRY], now);
		lane_tick(&lanes[LANE_EXIT], now);

		/* 2. Linhas completas das três UARTs. */
		for (int ch = 0; ch < UART_COUNT; ch++) {
			service_uart((enum uart_ch)ch, now);
		}

		/* 3. ADC4: no máximo uma amostra nova por volta. */
		if (adc_sampler_poll(now, &sample)) {
			lane_on_distance(&lanes[sample.lane], sample.code, now);
		}
		if (adc_sampler_failed() && !adc_fault_reported) { /* LCOV_EXCL_LINE: o modelo não produz falha de ADC; testada em tests/logica e tests/faixa */
			adc_fault_reported = true; /* LCOV_EXCL_LINE: o modelo não produz falha de ADC */
			lane_fault(&lanes[LANE_ENTRY], now); /* LCOV_EXCL_LINE: idem */
			lane_fault(&lanes[LANE_EXIT], now);  /* LCOV_EXCL_LINE: idem */
		}

		/* 4. A thread do display terminou uma etapa? */
		atomic_val_t done = atomic_set(&ui_done, 0);

		if (done != 0) {
			lane_on_display_done(&lanes[LANE_EXIT], done == 1, now);
		}

		hw_wait_event(LOOP_PERIOD_MS);
	}
	return 0;
}
```

## include/camera.h
```c
/*
 * camera.h — Máquina de captura da câmera de placas (uma por faixa)
 * =================================================================
 *
 * PARA QUE SERVE?
 *   Implementa a METADE "câmera" da interface `struct parking_equipment`
 *   (src/parking.h), que a Maria Antonia já usa no controle:
 *
 *       capture_start  -> camera_capture_start()
 *       capture_poll   -> camera_capture_poll()
 *       capture_cancel -> camera_capture_cancel()
 *
 *   O controle (parking.c) só diz "capture" e pergunta "já tem placa?".
 *   TUDO o que é protocolo fica aqui dentro: ids, tentativas, prazos,
 *   confiança mínima. Isso é o "O firmware decide" do desafio.
 *
 * REGRAS IMPLEMENTADAS (REQ-02, REQ-03 na parte da câmera, REQ-11):
 *   - Cada tentativa envia  AT+CAPTURE=<id>\r\n  com um id NOVO (1, 2, 3...).
 *   - Cada tentativa tem 1000 ms de prazo para a resposta COMPLETA
 *     (a resposta chega em pedaços, então o prazo inclui a montagem).
 *   - São no máximo 3 tentativas. Confiança < 85 ou prazo vencido gasta uma
 *     tentativa. Esgotadas: EQUIPMENT_FAILED (o controle pede assistência).
 *   - Só vale um +PLATE com o id da tentativa ATUAL, placa válida e
 *     confiança >= 85 ("OK" e "ERROR" NÃO aceitam nada e NÃO reiniciam o
 *     prazo). Resposta de id antigo, malformada ou fora do prazo é ignorada.
 *
 * COMO O CONTROLE USA (resumo do contrato):
 *   1. camera_capture_start(lane, now)  -> 0 se a captura começou.
 *   2. a cada passo:  r = camera_capture_poll(lane, now, plate)
 *        EQUIPMENT_PENDING -> ainda esperando
 *        EQUIPMENT_OK      -> `plate` tem a placa aceita (texto de 7 + '\0')
 *        EQUIPMENT_FAILED  -> tentativas esgotadas ou erro: pedir assistência
 *      OK e FAILED são "de uma vez só": depois deles a captura acabou.
 *   3. camera_capture_cancel(lane)  -> abandono (carro foi embora): invalida
 *      o id atual NA HORA; qualquer resposta tardia dele nunca autoriza nada.
 *
 * TEMPO: `now` é sempre o uptime virtual do Zephyr (k_uptime_get(), em ms).
 *        Este módulo nunca lê relógio nenhum por conta própria.
 */
#ifndef PARKING_CAMERA_H
#define PARKING_CAMERA_H

#include <stdint.h>

#include "equipment_types.h"

#define CAMERA_ATTEMPTS 3             /* tentativas por captura */
#define CAMERA_ATTEMPT_TIMEOUT_MS 1000 /* prazo de cada tentativa */
#define CAMERA_MIN_CONFIDENCE 85      /* confiança mínima aceita (>=) */

/* Cada chamada de poll lê no máximo CAMERA_READ_ROUNDS blocos de CAMERA_READ_CHUNK bytes. */
#define CAMERA_READ_CHUNK 16U
#define CAMERA_READ_ROUNDS 8

/* Prepara o módulo: zera o estado e confere as UARTs. 0 ou -errno. Chamar no boot. */
int camera_init(void);

/* Esquece capturas, ids e bytes parciais (REQ-13: reset coerente). */
void camera_reset(void);

/* Começa uma captura na faixa. 0 = iniciada; -EINVAL, -EIO ou -ENOSPC se falhou. */
int camera_capture_start(enum parking_lane_id lane, int64_t now);

/* Avança a captura. Veja o contrato no topo deste arquivo. */
enum equipment_result camera_capture_poll(enum parking_lane_id lane, int64_t now,
					  char plate[PARKING_PLATE_SIZE]);

/* Abandona a captura em andamento (não existe comando de cancelamento no protocolo). */
void camera_capture_cancel(enum parking_lane_id lane);

/* Só para testes: força o próximo id (para exercitar o limite 999999999 sem 1 bilhão de capturas). */
void camera_set_next_id(enum parking_lane_id lane, uint32_t id);

#endif /* PARKING_CAMERA_H */
```

## include/camera_hw.h
```c
/*
 * camera_hw.h — Camada FINA de hardware das câmeras (UART)
 * ========================================================
 *
 * PARA QUE SERVE?
 *   É a única fronteira entre a lógica da câmera (camera.c) e o driver UART
 *   real do Zephyr. Só três operações:
 *
 *       camera_hw_init()  -> confere se as duas UARTs existem e estão prontas;
 *       camera_hw_send()  -> envia bytes para a câmera de uma faixa;
 *       camera_hw_read()  -> pega os bytes que já chegaram (sem esperar).
 *
 * POR QUE EXISTE (em vez de chamar uart_poll_out() dentro de camera.c)?
 *   Para poder testar a lógica SEM hardware. Nos testes de unidade, estas três
 *   funções são trocadas por falsos do FFF: o teste escolhe quais bytes
 *   "chegam" e inclusive força erros (-EIO), que os cenários do Renode nunca
 *   provocam. Os caminhos de erro só se cobrem assim (veja o desafio,
 *   "Testes de unidade").
 *
 * ÍNDICE DA FAIXA:
 *   `lane` é o mesmo número de enum parking_lane_id: 0 = entrada (USART3),
 *   1 = saída (USART2).
 *
 * VALORES DE RETORNO (convenção do Zephyr: 0/positivo = ok, negativo = -errno):
 *   -EINVAL faixa inexistente ou ponteiro nulo; -ENODEV UART não está pronta;
 *   -EIO erro do driver durante a leitura.
 */
#ifndef PARKING_CAMERA_HW_H
#define PARKING_CAMERA_HW_H

#include <stddef.h>
#include <stdint.h>

/* Verifica as UARTs das duas câmeras. 0 se tudo certo, -ENODEV se alguma não estiver pronta. */
int camera_hw_init(void);

/* Envia `len` bytes à câmera da faixa. Devolve 0 ou -errno. Retorna rápido: são ~16 bytes. */
int camera_hw_send(unsigned int lane, const uint8_t *data, size_t len);

/*
 * Lê até `max` bytes que JÁ chegaram da câmera, sem bloquear.
 * Devolve quantos bytes leu (0 = nada novo) ou -errno.
 */
int camera_hw_read(unsigned int lane, uint8_t *buf, size_t max);

#endif /* PARKING_CAMERA_HW_H */
```

## include/camera_parser.h
```c
/*
 * camera_parser.h — Analisador (parser) das linhas que a câmera envia pela UART
 * ==========================================================================
 *
 * PARA QUE SERVE ESTE ARQUIVO?
 *   A câmera de placas fala um protocolo de texto (comandos "AT"). Ela
 *   responde ao firmware com linhas como:
 *
 *       OK\r\n
 *       ERROR\r\n
 *       +PLATE:17,"ABC1D23",93\r\n      (id da captura, placa, confiança)
 *
 *   O problema: a UART entrega BYTE A BYTE, e a câmera simulada ainda
 *   "fragmenta" a resposta em pedaços de até 8 bytes, um a cada 10 ms. Então
 *   o firmware nunca recebe "a linha pronta": ele precisa MONTAR a linha.
 *   É exatamente isso que este módulo faz, e só isso.
 *
 * POR QUE UM MÓDULO À PARTE (e sem nenhum include do Zephyr)?
 *   Regra de ouro do desafio: separar a LÓGICA da camada que toca o hardware.
 *   Este módulo é lógica pura: recebe bytes, devolve "quadros" (frames).
 *   Como não depende de driver nenhum, dá para testá-lo com ztest sem falsos
 *   (FFF) e cobrir todos os desvios (branches) — isso vale pontos de
 *   cobertura (REQ-11).
 *
 * O QUE ESTE PARSER GARANTE (REQ-11):
 *   1. Quadro de no máximo 128 bytes, contando o terminador CR LF.
 *   2. Montagem parcial com prazo: se a linha não terminar em 1000 ms contados
 *      do PRIMEIRO byte, o que já chegou é descartado.
 *   3. Se a linha for inválida (caractere proibido, grande demais, sem CR,
 *      campo mal formado), descarta-se TUDO ATÉ O PRÓXIMO LF e volta a
 *      sincronizar. Nunca se "aproveita" um prefixo que pareça válido.
 *   4. Validação rígida: id canônico (1..999999999, sem zero à esquerda),
 *      placa [A-Z]{3}[0-9][A-Z0-9][0-9]{2}, confiança canônica 0..100.
 *
 * O QUE ESTE PARSER NÃO FAZ:
 *   Ele não decide se a placa é aceita (confiança >= 85, id atual...). Isso é
 *   política de captura e fica em camera.c. O parser só diz "chegou um quadro
 *   X com estes campos".
 */
#ifndef PARKING_CAMERA_PARSER_H
#define PARKING_CAMERA_PARSER_H

#include <stdbool.h>
#include <stddef.h>
#include <stdint.h>

/* Tamanho máximo de um quadro, INCLUINDO o terminador CR LF (contrato do desafio). */
#define CAMERA_FRAME_MAX 128U

/* Prazo para uma linha parcial terminar, contado do primeiro byte (virtual, em ms). */
#define CAMERA_FRAME_TIMEOUT_MS 1000

/* Uma placa tem 7 caracteres (ex.: ABC1D23). O buffer guarda mais o '\0'. */
#define CAMERA_PLATE_LEN 7U

/* Limites do protocolo. */
#define CAMERA_ID_MAX 999999999U
#define CAMERA_CONFIDENCE_MAX 100U

/** Tipo de quadro recebido da câmera. */
enum camera_frame_kind {
	CAMERA_FRAME_NONE,    /**< Nenhum quadro completo. */
	CAMERA_FRAME_OK,      /**< A câmera aceitou o comando de captura. */
	CAMERA_FRAME_ERROR,   /**< A câmera rejeitou o comando. */
	CAMERA_FRAME_PLATE,   /**< Resultado da captura com placa e confiança. */
	CAMERA_FRAME_INVALID, /**< A linha malformada foi descartada ao chegar ao LF. */
};

/** Quadro decodificado. A carga útil vale quando o tipo é CAMERA_FRAME_PLATE. */
struct camera_frame {
	enum camera_frame_kind kind;        /**< Tipo de quadro. */
	uint32_t id;                         /**< Identificador da captura respondida. */
	char plate[CAMERA_PLATE_LEN + 1U];   /**< Placa terminada em NUL. */
	uint8_t confidence;                  /**< Confiança informada pela câmera, de 0 a 100. */
};

/**
 * Estado de UM analisador. Cada câmera (entrada e saída) tem o seu próprio:
 * "analisadores independentes" é exigência do REQ-11 — o lixo de uma UART
 * jamais pode contaminar a outra.
 */
struct camera_parser {
	char buf[CAMERA_FRAME_MAX]; /**< Bytes da linha em montagem, sem o LF. */
	size_t len;                 /**< Número de bytes armazenados em buf. */
	bool discarding;            /**< Descarta bytes até o próximo LF. */
	int64_t started_at;         /**< Uptime em ms do primeiro byte da linha. */
};

/* Coloca o analisador no estado inicial (vazio, sincronizado). */
void camera_parser_init(struct camera_parser *parser);

/*
 * Entrega UM byte recebido da UART no instante `now` (ms, tempo virtual).
 * Devolve o tipo de quadro que esse byte CONCLUIU:
 *   - CAMERA_FRAME_NONE    -> o byte só entrou no buffer (ou foi descartado);
 *   - OK/ERROR/PLATE       -> quadro válido pronto em *frame;
 *   - CAMERA_FRAME_INVALID -> uma linha ruim terminou e foi jogada fora.
 * *frame é sempre escrito (pelo menos o campo kind).
 */
enum camera_frame_kind camera_parser_feed(struct camera_parser *parser, uint8_t byte,
					  int64_t now, struct camera_frame *frame);

/*
 * Aplica o prazo de 1000 ms a uma linha parcial. camera_parser_feed() já chama
 * isto sozinha; é exposta porque quem chama pode querer expirar antes de ler.
 */
void camera_parser_expire(struct camera_parser *parser, int64_t now);

#endif /* PARKING_CAMERA_PARSER_H */
```

## include/display.h
```c
/*
 * display.h — Display do terminal (ST7789V por SPI): REQ-12
 * =========================================================
 *
 * PARA QUE SERVE?
 *   Desenha no display do terminal de pagamento as duas telas do REQ-12 e
 *   cumpre o contrato `struct payment_display_ops` (payment.h) que o módulo de
 *   pagamento (issue #6) espera. O cenário lê o que o MODELO recebeu pela SPI;
 *   texto no console não conta.
 *
 * COMO O TRABALHO É DIVIDIDO (tudo SEM BLOQUEAR a segurança):
 *   Falar com o ST7789V é lento e tem esperas (a inicialização leva ~400 ms).
 *   Se o firmware ficasse parado esperando, a OUTRA faixa (cancela, obstrução)
 *   ficaria sem atenção. Então tudo é uma máquina de estados "em fatias":
 *   display_service(now) faz um PEDAÇO pequeno do trabalho e volta.
 *
 *   1) INICIALIZAÇÃO (começa em display_init(), avança em display_service()):
 *        reset por hardware (segura 10 ms, solta, espera 120 ms)
 *        SWRESET (espera 150 ms) -> SLPOUT (espera 120 ms)
 *        COLMOD 0x55 (RGB565) -> MADCTL 0x00 -> DISPON
 *   2) DESENHO: cada tela é uma lista de retângulos de texto. Cada chamada de
 *      display_service() envia no máximo DISPLAY_ROWS_PER_STEP linhas de pixels.
 *
 * COMO O CONTROLE USA (integração, issue #8):
 *   - no boot:               display_init();
 *   - a cada passo do laço:  display_service(now);   <- faz a inicialização andar
 *   - ao criar o pagamento:  payment_init(display_ops());
 */
#ifndef PARKING_DISPLAY_H
#define PARKING_DISPLAY_H

#include <stdint.h>

#include "equipment_types.h"

struct payment_display_ops;

/* Máximo de linhas de pixels enviadas por chamada de display_service(). */
#define DISPLAY_ROWS_PER_STEP 4U

/* Confere SPI/GPIOs e começa a inicialização. 0 ou -errno. */
int display_init(void);

/* Avança a inicialização e/ou o desenho em andamento. Não bloqueia. `now` em ms virtuais. */
void display_service(int64_t now);

/* ---- funções da tabela struct payment_display_ops ---- */

/* Pede o desenho da tela da PLACA. 0 = aceito; -ENODEV sem display_init(); -EIO se a
 * inicialização falhou; -EBUSY se há desenho em andamento; -EINVAL argumento inválido. */
int display_draw_plate(const char plate[PARKING_PLATE_SIZE]);

/* Pede o desenho da tela da COBRANÇA (placa, BRL r.cc, SIMULATED PAYMENT, NOT PIX). */
int display_draw_charge(const char plate[PARKING_PLATE_SIZE], uint32_t amount_centavos);

/* Andamento do último pedido: PENDING, OK ou FAILED (também FAILED se nada foi pedido). */
enum equipment_result display_poll(int64_t now);

/* Abandona o desenho em andamento. */
void display_cancel(void);

/* A tabela pronta para payment_init(). */
const struct payment_display_ops *display_ops(void);

#ifdef CONFIG_ZTEST
void display_reset_for_test(void);
#endif

#endif /* PARKING_DISPLAY_H */
```

## include/display_render.h
```c
/*
 * display_render.h — Layout e renderização de texto em pixels RGB565
 * ===================================================================
 *
 * PARA QUE SERVE?
 *   Responde, sem tocar em hardware nenhum, a duas perguntas:
 *     1) O QUE aparece em cada tela e ONDE?        -> layout (display_layout_*)
 *     2) QUAIS BYTES formam cada linha de pixels?  -> display_render_row()
 *   Como é lógica pura, os testes conferem posições, cores e valores sem SPI.
 *
 * AS DUAS TELAS (REQ-12):
 *   - tela da PLACA:   a placa reconhecida (e apaga o valor da saída anterior).
 *   - tela da COBRANÇA: placa, "BRL r.cc", "SIMULATED PAYMENT" e "NOT PIX".
 *
 * CONCEITOS:
 *   - "item" = UMA linha de texto = UM retângulo da tela. Cada item é pintado
 *     com uma única janela do ST7789V (CASET/RASET/RAMWR).
 *   - O texto é desenhado com fundo opaco (bg). Assim, desenhar de novo sobre
 *     um retângulo apaga o que havia antes (valor da saída anterior, p.ex.).
 *   - "scale" amplia a fonte 5x7: cada pixel da letra vira um quadrado
 *     scale x scale. Cada letra ocupa 6 colunas (5 + 1 de espaço) x scale.
 *   - Cor RGB565 = 16 bits (5 vermelho, 6 verde, 5 azul), enviada com o byte
 *     ALTO primeiro (contrato do modelo).
 *
 * POR QUE NÃO PINTAR A TELA INTEIRA?
 *   240x320 pixels = 153.600 bytes por SPI, e isso gasta tempo virtual do
 *   firmware antes de mandar a cobrança ao terminal (prazo apertado no cenário
 *   payment-delayed). Pintamos só os retângulos de texto (~15% da tela).
 */
#ifndef PARKING_DISPLAY_RENDER_H
#define PARKING_DISPLAY_RENDER_H

#include <stdbool.h>
#include <stddef.h>
#include <stdint.h>


#define DISPLAY_WIDTH 240U
#define DISPLAY_HEIGHT 320U
#define DISPLAY_CELL_COLS 6U /* 5 colunas da letra + 1 de espaço */
#define DISPLAY_ROW_BYTES_MAX (DISPLAY_WIDTH * 2U) /* uma linha cheia, 2 bytes por pixel */

#define DISPLAY_PLATE_CHARS 7U
#define DISPLAY_AMOUNT_CHARS 12U /* "BRL 10000.00": o maior valor possível (1.000.000 centavos) */
#define DISPLAY_TEXT_MAX 24U     /* maior texto + '\0' ("SIMULATED PAYMENT" tem 17) */
#define DISPLAY_MAX_ITEMS 4U

/* Cores RGB565 usadas. */
#define DISPLAY_COLOR_BLACK 0x0000U
#define DISPLAY_COLOR_WHITE 0xFFFFU
#define DISPLAY_COLOR_YELLOW 0xFFE0U
#define DISPLAY_COLOR_GREEN 0x07E0U
#define DISPLAY_COLOR_RED 0xF800U

/** Retângulo da tela usado para desenhar uma linha de texto. */
struct display_item {
	char text[DISPLAY_TEXT_MAX]; /**< Texto terminado em NUL. */
	uint16_t x;                   /**< Coordenada esquerda em pixels. */
	uint16_t y;                   /**< Coordenada superior em pixels. */
	uint8_t chars;                /**< Número de células desenhadas, incluindo espaços. */
	uint8_t scale;                /**< Fator inteiro de ampliação da fonte. */
	uint16_t fg;                  /**< Cor do texto em RGB565. */
	uint16_t bg;                  /**< Cor do fundo em RGB565. */
};

/* Largura e altura do retângulo do item, em pixels. */
uint16_t display_item_width(const struct display_item *item);
uint16_t display_item_height(const struct display_item *item);

/*
 * Gera a linha de pixels `row` (0 = a de cima) do item em out, no formato
 * RGB565 com byte alto primeiro. Devolve quantos bytes escreveu
 * (= largura * 2, no máximo DISPLAY_ROW_BYTES_MAX). `row` fora do item => 0.
 */
size_t display_render_row(const struct display_item *item, unsigned int row, uint8_t *out);

/*
 * Formata o valor como "BRL <reais>.<centavos com 2 dígitos>", completado com
 * espaços à direita até DISPLAY_AMOUNT_CHARS (largura fixa: apaga o valor
 * anterior por inteiro). Ex.: 400 -> "BRL 4.00". false se não couber
 * (acima de 1.000.000 centavos, que é o máximo do terminal).
 */
bool display_amount_text(uint32_t centavos, char out[DISPLAY_AMOUNT_CHARS + 1U]);

/* Tela da PLACA: devolve quantos itens preencheu em items (0 se `plate` for NULL). */
size_t display_layout_plate(const char *plate, struct display_item items[DISPLAY_MAX_ITEMS]);

/* Tela da COBRANÇA: 4 itens. Devolve 0 se `plate` for NULL ou o valor não couber. */
size_t display_layout_charge(const char *plate, uint32_t centavos,
			     struct display_item items[DISPLAY_MAX_ITEMS]);

#endif /* PARKING_DISPLAY_RENDER_H */
```

## include/distance.h
```c
#ifndef PARKING_DISTANCE_H
#define PARKING_DISTANCE_H

#include <stdbool.h>
#include <stdint.h>

#define PARKING_ADC_DEADLINE_MS 100
#define PARKING_ARRIVAL_CODE 683
#define PARKING_DEPARTURE_CODE 1024

/** @brief Última conversão assíncrona concluída para uma faixa. */
struct distance_sample {
	int64_t observed_at; /**< Uptime em ms quando o controlador observou a conclusão. */
	uint16_t code;       /**< Código bruto de 12 bits do ADC4 (0 a 4095). */
	bool valid;          /**< A faixa já possui uma amostra concluída com sucesso. */
};

/** @brief Configura o ADC4 antes do início da fila do controlador.
 * @return Zero em caso de sucesso ou um código de erro negativo.
 */
int distance_init(void);
/** @brief Avança a aquisição assíncrona sem esperar pela conversão.
 * @details Após a inicialização, a fila do controlador é dona da aquisição.
 * @param now Uptime atual em ms.
 */
void distance_step(int64_t now);
/** @brief Consulta a falha persistente da aquisição.
 * @return Verdadeiro se ocorreu uma falha que exige reinicialização.
 */
bool distance_faulted(void);
/** @brief Obtém uma amostra recente da faixa.
 * @param lane Índice válido da faixa.
 * @param now Uptime atual em ms.
 * @param[out] code Destino do código bruto, preenchido em caso de sucesso.
 * @return Verdadeiro se há uma amostra válida e recente.
 */
bool distance_read(unsigned int lane, int64_t now, uint16_t *code);

#endif
```

## include/equipment_types.h
```c
#ifndef PARKING_EQUIPMENT_TYPES_H
#define PARKING_EQUIPMENT_TYPES_H

#define PARKING_LANES 2      /**< Número de faixas do estacionamento. */
#define PARKING_PLATE_SIZE 8 /**< Sete caracteres da placa mais o terminador NUL. */

/** @enum parking_lane_id
 * @brief Índices das faixas no controlador e nos adaptadores.
 */
enum parking_lane_id {
	PARKING_ENTRY, /**< Faixa de entrada. */
	PARKING_EXIT,  /**< Faixa de saída, com terminal de pagamento. */
};

/** @enum equipment_result
 * @brief Resultado da consulta à operação atual do equipamento.
 */
enum equipment_result {
	EQUIPMENT_PENDING, /**< Operação ainda em andamento. */
	EQUIPMENT_OK,      /**< Operação concluída com sucesso. */
	EQUIPMENT_FAILED,  /**< Operação encerrada com falha. */
};

#endif
```

## include/font5x7.h
```c
/*
 * font5x7.h — Fonte de bitmap 5x7 (cada letra é uma grade de 5 colunas x 7 linhas)
 * ================================================================================
 *
 * PARA QUE SERVE?
 *   O display ST7789V não sabe desenhar texto: ele só recebe PIXELS. Então o
 *   firmware precisa saber "como é a letra A em pixels". Este módulo guarda isso.
 *   O desafio diz "com a fonte que quiser" — esta é a nossa.
 *
 * COMO AS LETRAS SÃO GUARDADAS (de propósito, legível a olho nu):
 *   Cada glifo é uma lista de 7 textos de 5 caracteres, onde '#' é pixel aceso e
 *   '.' é apagado. Por exemplo, a letra T:
 *
 *        #####
 *        ..#..
 *        ..#..          (7 linhas, de cima para baixo)
 *        ..#..
 *        ..#..
 *        ..#..
 *        ..#..
 *
 *   É menos compacto que guardar bits, mas qualquer pessoa confere o desenho
 *   direto no código (e o teste imprime/decodifica o resultado).
 *
 * CARACTERES SUPORTADOS: A-Z, 0-9, '.' e espaço — exatamente o que o REQ-12
 * precisa (placa, "BRL 4.00", "SIMULATED PAYMENT", "NOT PIX"). Qualquer outro
 * caractere vira um espaço em branco (nunca quebra o desenho).
 *
 * MÓDULO PURO: nenhum include do Zephyr, só dados e consultas.
 */
#ifndef PARKING_FONT5X7_H
#define PARKING_FONT5X7_H

#include <stdbool.h>
#include <stdint.h>

#define FONT_COLS 5U /* colunas de pixels de uma letra */
#define FONT_ROWS 7U /* linhas de pixels de uma letra */

/* Um glifo: 7 linhas de 5 caracteres ('#' aceso, '.' apagado). */
/** Mapa de pixels de um caractere da fonte 5×7. */
struct font_glyph {
	char character;             /**< Caractere ASCII representado. */
	const char *rows[FONT_ROWS]; /**< Linhas do glifo, da superior à inferior. */
};

/* Devolve o glifo de `c` (ou o do espaço, em branco, se `c` não existir na fonte). Nunca NULL. */
const struct font_glyph *font_lookup(char c);

/* true se o pixel (col, row) do glifo está aceso. Fora da grade 5x7 => false. */
bool font_pixel(const struct font_glyph *glyph, unsigned int col, unsigned int row);

/* true se `c` tem desenho próprio na fonte. */
bool font_has_glyph(char c);

#endif /* PARKING_FONT5X7_H */
```

## include/gate.h
```c
#ifndef PARKING_GATE_H
#define PARKING_GATE_H

#include <stdbool.h>
#include <stdint.h>

#define GATE_MOTION_MS 2500
#define GATE_BUZZER_MS 100

/** @enum gate_state
 * @brief Estados da máquina de segurança de uma cancela.
 */
enum gate_state {
	GATE_CLOSED,     /**< Fechada ou aguardando a primeira leitura no boot. */
	GATE_OPENING,    /**< Motor abrindo, à espera do fim de curso superior. */
	GATE_OPEN,       /**< Fim de curso superior confirmado e motor parado. */
	GATE_CLOSING,    /**< Motor fechando, sob supervisão do feixe. */
	GATE_ASSISTANCE, /**< Movimento interrompido e sinal vermelho aceso. */
};

/** @brief Leitura dos sensores usada em um passo do controle. */
struct gate_inputs {
	bool upper; /**< Fim de curso superior ativo. */
	bool lower; /**< Fim de curso inferior ativo. */
	bool beam;  /**< Feixe interrompido ou obstrução capturada no fechamento. */
};

/** @enum gate_output
 * @brief Saídas encaminhadas pelo adaptador de GPIO.
 */
enum gate_output {
	GATE_ENABLE,    /**< Ativa o motor. */
	GATE_DIRECTION, /**< Ativo para abrir, inativo para fechar. */
	GATE_RED,       /**< Sinal vermelho da faixa. */
	GATE_GREEN,     /**< Sinal verde da faixa. */
	GATE_BUZZER,    /**< Aviso sonoro de assistência. */
};

/** @brief Estado e dependências de uma instância da máquina de segurança.
 * @details As operações devem ser chamadas de um único contexto de controle serializado.
 */
struct gate {
	enum gate_state state; /**< Estado atual da cancela. */
	int64_t deadline;      /**< Prazo de movimento ou fim do pulso sonoro, em ms de uptime. */
	bool latched;          /**< Falha persistente que exige reinicialização. */
	bool buzzing;          /**< Pulso sonoro ativo, aguardando desligamento. */
	int (*write)(void *context, enum gate_output output, bool active);
	/**< Escreve uma saída lógica e retorna zero em caso de sucesso. */
	void *context;         /**< Contexto repassado ao adaptador de saída. */
};

/** @brief Interrompe o movimento e sinaliza assistência.
 * @param gate Cancela afetada.
 * @param now Uptime atual em ms.
 * @param latch Se verdadeiro, exige reinicialização para liberar a cancela.
 */
void gate_assist(struct gate *gate, int64_t now, bool latch);
/** @brief Processa sensores e prazos da cancela.
 * @param gate Cancela a atualizar.
 * @param input Estado atual dos sensores.
 * @param now Uptime atual em ms.
 */
void gate_step(struct gate *gate, struct gate_inputs input, int64_t now);
/** @brief Solicita a abertura de uma cancela fechada.
 * @param gate Cancela a abrir.
 * @param input Estado atual dos sensores.
 * @param now Uptime atual em ms.
 * @return Verdadeiro se o movimento de abertura foi iniciado.
 */
bool gate_open(struct gate *gate, struct gate_inputs input, int64_t now);
/** @brief Solicita o fechamento de uma cancela aberta com o feixe livre.
 * @param gate Cancela a fechar.
 * @param input Estado atual dos sensores.
 * @param now Uptime atual em ms.
 * @return Verdadeiro se o movimento de fechamento foi iniciado.
 */
bool gate_close(struct gate *gate, struct gate_inputs input, int64_t now);
/** @brief Tenta liberar uma cancela em assistência recuperável.
 * @param gate Cancela a rearmar.
 * @param input Estado atual dos sensores.
 * @param vehicle_gone Indica que o veículo já se afastou da faixa.
 * @return Verdadeiro se a cancela voltou ao estado fechado.
 */
bool gate_rearm(struct gate *gate, struct gate_inputs input, bool vehicle_gone);

#endif
```

## include/parking.h
```c
#ifndef PARKING_CONTROLLER_H
#define PARKING_CONTROLLER_H

#include <stdbool.h>
#include <stdint.h>

#include "equipment_types.h"

struct gate;
struct gate_inputs;

/**
 * @brief Operações de equipamento usadas pelo controlador das faixas.
 * @details Os callbacks são executados na fila serializada e devem retornar
 * rapidamente. O adaptador controla os identificadores, quadros, prazos
 * e tentativas. O cancelamento invalida a operação antes de retornar.
 */
struct parking_equipment {
	int (*capture_start)(enum parking_lane_id lane, int64_t now);
	/**< Inicia a captura na câmera da faixa no instante informado. */
	enum equipment_result (*capture_poll)(enum parking_lane_id lane, int64_t now,
					      char plate[PARKING_PLATE_SIZE]);
	/**< Consulta a captura e entrega a placa terminada em NUL quando aceita. */
	void (*capture_cancel)(enum parking_lane_id lane);
	/**< Invalida a captura ativa da faixa. */
	int (*payment_start)(const char plate[PARKING_PLATE_SIZE], int64_t entered_at);
	/**< Solicita desenho da placa, cálculo da tarifa a partir da entrada e cobrança. */
	enum equipment_result (*payment_poll)(int64_t now);
	/**< Consulta o pagamento atual. Sucesso indica confirmação do terminal. */
	void (*payment_cancel)(void);
	/**< Invalida a cobrança e solicita o cancelamento ao terminal quando aplicável. */
};

/** @brief Registra o adaptador de equipamentos durante a inicialização.
 * @param equipment Tabela completa de callbacks com duração de armazenamento estática.
 */
void parking_set_equipment(const struct parking_equipment *equipment);

/** @brief Avança a operação da faixa após o processamento de segurança.
 * @param lane Faixa a processar.
 * @param gate Estado da cancela associado à faixa.
 * @param input Estado atual dos sensores da cancela.
 * @param beam_rose Indica uma interrupção do feixe desde o último passo.
 * @param now Uptime atual em ms.
 */
void parking_step(enum parking_lane_id lane, struct gate *gate,
		  struct gate_inputs input, bool beam_rose, int64_t now);

#endif
```

## include/payment.h
```c
/*
 * payment.h — Cobrança na saída (REQ-05, REQ-11 no terminal, REQ-12 tarifa)
 * =========================================================================
 *
 * PARA QUE SERVE?
 *   Implementa a METADE "pagamento" de `struct parking_equipment` (parking.h):
 *
 *       payment_start  -> payment_start()
 *       payment_poll   -> payment_poll()
 *       payment_cancel -> payment_cancel()
 *
 *   O controle (parking.c) só diz "cobrar esta placa, que entrou em T" e
 *   pergunta "já pagou?". Tudo o que é tarifa, display, UUID, retransmissão e
 *   conferência do PAID mora aqui.
 *
 * A SEQUÊNCIA (por que nessa ordem — exigência do desafio e de INTERFACES.md):
 *
 *   start ─► [1] desenha a PLACA no display ─► [2] CONGELA a tarifa
 *         ─► [3] desenha a COBRANÇA no display ─► [4] envia P1 CHARGE ao terminal
 *         ─► [5] espera P1 RESULT ... PAID (retransmite se calar)
 *
 *   - O valor é calculado UMA vez, no passo [2], e nunca muda: nem o display
 *     nem as retransmissões o recalculam, mesmo que o tempo passe.
 *   - A cobrança só é enviada depois do display terminar (o terminal "mostra" o
 *     que o cliente vai pagar).
 *   - O prazo de 1000 ms do terminal só começa ao ENVIAR a cobrança; o tempo de
 *     desenho do display não o consome.
 *
 * REGRAS DE SEGURANÇA (REQ-05): a cancela só abre (EQUIPMENT_OK) com um
 * `P1 RESULT <uuid ATUAL> PAID <valor CONGELADO> BRL`. Resposta ausente, de UUID
 * antigo, com outro valor, CANCELLED ou malformada NUNCA abre. São no máximo 3
 * envios (mesmo UUID e mesmo valor), 1000 ms entre eles. Esgotado: o firmware
 * invalida o UUID e manda `P1 CANCEL <uuid>`; o resultado é EQUIPMENT_FAILED
 * (o controle pede assistência).
 *
 * COMO O DISPLAY ENTRA (injeção de dependência):
 *   O display (SPI) é a issue #7. Para este módulo não depender dele em tempo de
 *   link, ele recebe em payment_init() uma tabela de funções (`struct
 *   payment_display_ops`). O display real (display.c) oferecerá essas funções, e
 *   na integração (#8) basta passar a tabela. Nos testes passam-se falsos FFF.
 *   Os desenhos são NÃO BLOQUEANTES: draw_*() só pede; poll() diz se terminou.
 *   Assim, empurrar pixels pela SPI nunca atrasa a segurança da outra faixa.
 *
 * TEMPO: `now` é sempre o uptime virtual (k_uptime_get()), passado pelo chamador.
 */
#ifndef PARKING_PAYMENT_H
#define PARKING_PAYMENT_H

#include <stdint.h>

#include "equipment_types.h"

#define PAYMENT_ATTEMPTS 3             /* envios da mesma cobrança */
#define PAYMENT_ATTEMPT_TIMEOUT_MS 1000 /* espera por envio */
#define PAYMENT_READ_CHUNK 16U
#define PAYMENT_READ_ROUNDS 8

/** Operações de display usadas durante a cobrança. */
struct payment_display_ops {
	int (*draw_plate)(const char plate[PARKING_PLATE_SIZE]);
	/**< Solicita o desenho da placa. Retorna zero se o pedido for aceito. */
	int (*draw_charge)(const char plate[PARKING_PLATE_SIZE], uint32_t amount_centavos);
	/**< Solicita a tela com a placa, o valor em centavos e os avisos de simulação. */
	enum equipment_result (*poll)(int64_t now);
	/**< Consulta o andamento do último desenho sem bloquear. */
	void (*cancel)(void);
	/**< Abandona o desenho em andamento. */
};

/*
 * Registra o display, zera o estado e confere a UART. 0 ou -errno (-EINVAL se a tabela for
 * incompleta, -ENODEV se a UART não estiver pronta). Se falhar, o módulo fica não inicializado.
 */
int payment_init(const struct payment_display_ops *display);

/* Esquece cobrança em andamento, UUID, valor e bytes parciais (REQ-13). Não envia nada. */
void payment_reset(void);

/*
 * Pede uma cobrança. `entered_at` = instante (ms virtuais) da passagem na entrada.
 * Só REGISTRA o pedido; o trabalho acontece em payment_poll().
 * -ENODEV sem payment_init(); -EBUSY se já há cobrança; -EINVAL placa inválida.
 */
int payment_start(const char plate[PARKING_PLATE_SIZE], int64_t entered_at);

/* Avança a cobrança. PENDING = ainda trabalhando; OK = PAID confirmado; FAILED = assistência. */
enum equipment_result payment_poll(int64_t now);

/* Abandona a cobrança: invalida o UUID e, se já enviou a cobrança, manda P1 CANCEL. */
void payment_cancel(void);

#endif /* PARKING_PAYMENT_H */
```

## include/payment_hw.h
```c
/*
 * payment_hw.h — Camada FINA de hardware do terminal de pagamento (LPUART1)
 * =========================================================================
 * Mesma ideia de camera_hw.h: a ÚNICA fronteira entre a lógica (payment.c) e o
 * driver UART real. Assim os testes trocam estas três funções por falsos FFF e
 * conseguem forçar erros de driver (-EIO). Só existe UM terminal (na saída).
 *
 *   payment_hw_init() -> confere se a UART do terminal está pronta (-ENODEV se não);
 *   payment_hw_send() -> envia bytes ao terminal (0 ou -errno);
 *   payment_hw_read() -> lê os bytes que JÁ chegaram, sem bloquear
 *                        (devolve quantos leu, 0 = nada novo, ou -errno).
 */
#ifndef PARKING_PAYMENT_HW_H
#define PARKING_PAYMENT_HW_H

#include <stddef.h>
#include <stdint.h>

int payment_hw_init(void);
int payment_hw_send(const uint8_t *data, size_t len);
int payment_hw_read(uint8_t *buf, size_t max);

#endif /* PARKING_PAYMENT_HW_H */
```
