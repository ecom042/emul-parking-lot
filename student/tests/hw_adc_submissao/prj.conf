## CMakeLists.txt
```
# Suite ztest + FFF de hw_adc.c, uma trava por boot. Compila o hw_adc.c real com
# src/shim.h forcado no inicio: o shim inclui os headers reais do Zephyr e
# redireciona device_is_ready, adc_channel_setup e adc_read_async para falsos
# do FFF (src/fakes.c). O kernel (k_poll_signal) continua o real.
cmake_minimum_required(VERSION 3.20.0)
list(APPEND BOARD_ROOT ${CMAKE_CURRENT_SOURCE_DIR}/../../../hardware)
list(APPEND DTS_ROOT ${CMAKE_CURRENT_SOURCE_DIR}/../../../hardware)
find_package(Zephyr REQUIRED HINTS $ENV{ZEPHYR_BASE})
project(parking_test_hw_adc_submissao)
set(HW_ADC_C ${CMAKE_CURRENT_SOURCE_DIR}/../../src/hw_adc.c)
target_include_directories(app PRIVATE ../../src src)
target_sources(app PRIVATE src/fakes.c src/test_hw_adc_submissao.c ${HW_ADC_C})
set_source_files_properties(${HW_ADC_C} PROPERTIES
	COMPILE_OPTIONS "-include;${CMAKE_CURRENT_SOURCE_DIR}/src/shim.h")
```

## prj.conf
```kconfig
CONFIG_ZTEST=y
CONFIG_CONSOLE=y
CONFIG_UART_CONSOLE=y
CONFIG_PRINTK=y
CONFIG_SERIAL=y
CONFIG_PM=n
# hw_adc.c usa DEVICE_DT_GET do ADC4 e k_poll_signal: os mesmos drivers do
# firmware precisam existir para o link, mesmo com as chamadas falsas.
CONFIG_ADC=y
CONFIG_ADC_ASYNC=y
```

## src/shim.h
```c
/* SPDX-License-Identifier: Apache-2.0 */
/*
 * Incluido a forca no inicio de hw_adc.c (veja CMakeLists.txt). Os headers
 * reais entram primeiro; os include guards fazem os #include do .c virarem
 * nada, e os #define abaixo mandam as chamadas de driver para os falsos.
 */
#ifndef TEST_HW_ADC_SHIM_H_
#define TEST_HW_ADC_SHIM_H_

#include <zephyr/device.h>
#include <zephyr/drivers/adc.h>
#include <zephyr/kernel.h>
#include <zephyr/sys/util.h>

#include "fakes.h"

#define device_is_ready   fake_device_is_ready
#define adc_channel_setup fake_adc_channel_setup
#define adc_read_async    fake_adc_read_async

#endif /* TEST_HW_ADC_SHIM_H_ */
```

## src/test_hw_adc_submissao.c
```c
/* SPDX-License-Identifier: Apache-2.0 */
/*
 * Uma trava de hw_adc_poll por boot: hw_adc.c nao destrava sem reset da
 * maquina, entao esta suite tem um unico teste. O resto do ADC4 esta na
 * suite tests/hw_adc, com os mesmos falsos (shim.h, fakes.c).
 */
#include <errno.h>

#include <zephyr/ztest.h>

#include "fakes.h"
#include "hw_adc.h"

#define CANAL_SAIDA 18U

static const struct hw_adc_sample intocada = { .lane = LANE_COUNT, .code = 0xBEEFU };

static void preparar(void *fixture)
{
	ARG_UNUSED(fixture);
	fakes_reset();
	zassert_equal(hw_adc_init(), 0, "init deveria dar certo");
}

ZTEST_SUITE(hw_adc_submissao, NULL, NULL, preparar, NULL, NULL);

ZTEST(hw_adc_submissao, test_falha_ao_submeter_trava_e_vence_a_amostra)
{
	struct hw_adc_sample s = intocada;

	fake_conv.concluir = true;
	fake_conv.codigo = 900U;
	zassert_equal(hw_adc_poll(0, &s), 0);

	/* A amostra da entrada chega, mas a submissao da saida falha. */
	fake_conv.rc = -EBUSY;
	zassert_equal(hw_adc_poll(10, &s), -EBUSY,
		      "a falha de submissao vale mais que a amostra");
	zassert_equal(fake_adc_read_async_fake.call_count, 2);
	zassert_equal(fake_canais[1], BIT(CANAL_SAIDA));

	/* Travado: o driver volta a aceitar, mas nada e submetido. */
	fake_conv.rc = 0;
	zassert_equal(hw_adc_poll(20, &s), -EBUSY);
	zassert_equal(hw_adc_poll(1000, &s), -EBUSY);
	zassert_equal(fake_adc_read_async_fake.call_count, 2);
}
```
