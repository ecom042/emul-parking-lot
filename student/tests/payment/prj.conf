## CMakeLists.txt
```
cmake_minimum_required(VERSION 3.20.0)
list(APPEND BOARD_ROOT ${CMAKE_CURRENT_SOURCE_DIR}/../../../hardware)
list(APPEND DTS_ROOT ${CMAKE_CURRENT_SOURCE_DIR}/../../../hardware)
find_package(Zephyr REQUIRED HINTS $ENV{ZEPHYR_BASE})
project(parking_test_payment)
target_include_directories(app PRIVATE ../../src)
target_sources(app PRIVATE src/test_payment.c ../../src/payment.c ../../src/line.c)
```

## prj.conf
```kconfig
CONFIG_ZTEST=y
CONFIG_CONSOLE=y
CONFIG_UART_CONSOLE=y
CONFIG_PRINTK=y
CONFIG_SERIAL=y
CONFIG_PM=n
CONFIG_SYS_CLOCK_TICKS_PER_SEC=1000
```

## src/test_payment.c
```c
#include <errno.h>
#include <stdio.h>
#include <string.h>

#include <zephyr/fff.h>
#include <zephyr/ztest.h>

#include "payment.h"

DEFINE_FFF_GLOBALS;
FAKE_VALUE_FUNC(int, fake_send, const uint8_t *, size_t);

static struct payment payment;
static char sent[5][PAYMENT_FRAME_MAX];
static unsigned int sent_count;
static int send_error;

static int remember_send(const uint8_t *data, size_t len)
{
	zassert_true(sent_count < ARRAY_SIZE(sent));
	zassert_true(len < sizeof(sent[0]));
	memcpy(sent[sent_count], data, len);
	sent[sent_count++][len] = '\0';
	return send_error;
}

static void before_each(void *fixture)
{
	ARG_UNUSED(fixture);
	RESET_FAKE(fake_send);
	FFF_RESET_HISTORY();
	fake_send_fake.custom_fake = remember_send;
	sent_count = 0;
	send_error = 0;
	payment_init(&payment, fake_send);
}

static void result(char *frame, unsigned int charge_index, const char *fields)
{
	const char *uuid = sent[charge_index] + strlen("P1 CHARGE ");

	(void)snprintf(frame, PAYMENT_FRAME_MAX, "P1 RESULT %.36s %s\n", uuid, fields);
}

static enum payment_event feed(const char *frame, int64_t now_ms)
{
	for (const char *byte = frame; *byte != '\0'; byte++) {
		enum payment_event event = payment_receive(&payment, (uint8_t)*byte, now_ms);

		if (event != PAYMENT_NONE) {
			zassert_equal(byte[1], '\0', "event before end of frame");
			return event;
		}
	}
	return PAYMENT_NONE;
}

ZTEST(payment, test_charge_and_fragmented_confirmation)
{
	char frame[PAYMENT_FRAME_MAX];

	zassert_ok(payment_begin(&payment, "ABC1D23", 300, 10));
	zassert_str_equal(sent[0], "P1 CHARGE 00000000-0000-4000-8000-000000000001 ABC1D23 300 BRL\n");
	zassert_equal(payment_begin(&payment, "XYZ9A87", 400, 11), -EBUSY);
	result(frame, 0, "PAID 300 BRL");

	for (size_t i = 0; i < strlen(frame) - 1; i++) {
		zassert_equal(payment_receive(&payment, frame[i], 20 + (int64_t)i), PAYMENT_NONE);
	}
	zassert_equal(payment_receive(&payment, '\n', 999), PAYMENT_PAID);
	zassert_equal(feed(frame, 1000), PAYMENT_NONE, "duplicate authorization");
	zassert_equal(payment_poll(&payment, 1010), PAYMENT_NONE);
	payment_cancel(&payment);
	zassert_equal(sent_count, 1);
}

ZTEST(payment, test_three_identical_sends_then_cancel)
{
	char frame[PAYMENT_FRAME_MAX];

	zassert_ok(payment_begin(&payment, "ABC1D23", 400, 0));
	zassert_equal(payment_poll(&payment, 999), PAYMENT_NONE);
	zassert_equal(sent_count, 1);
	zassert_equal(payment_poll(&payment, 1000), PAYMENT_NONE);
	zassert_equal(sent_count, 2);
	zassert_equal(payment_poll(&payment, 2000), PAYMENT_NONE);
	zassert_equal(sent_count, 3);
	zassert_str_equal(sent[0], sent[1]);
	zassert_str_equal(sent[0], sent[2]);
	zassert_equal(payment_poll(&payment, 2999), PAYMENT_NONE);

	result(frame, 0, "PAID 400 BRL");
	zassert_equal(feed(frame, 3000), PAYMENT_NONE, "result at deadline");
	zassert_equal(payment_poll(&payment, 3000), PAYMENT_DENIED);
	zassert_equal(sent_count, 4);
	zassert_str_equal(sent[3], "P1 CANCEL 00000000-0000-4000-8000-000000000001\n");
	zassert_equal(feed(frame, 3001), PAYMENT_NONE);
	zassert_equal(payment_poll(&payment, 4000), PAYMENT_NONE);
	zassert_equal(sent_count, 4);
}

ZTEST(payment, test_fragment_started_before_retry_remains_valid)
{
	char frame[PAYMENT_FRAME_MAX];

	zassert_ok(payment_begin(&payment, "ABC1234", 1000000, 0));
	result(frame, 0, "PAID 1000000 BRL");
	zassert_equal(payment_receive(&payment, frame[0], 950), PAYMENT_NONE);
	zassert_equal(payment_poll(&payment, 1000), PAYMENT_NONE);
	zassert_equal(feed(frame + 1, 1300), PAYMENT_PAID);
	zassert_equal(sent_count, 2);
	zassert_str_equal(sent[0], sent[1]);
}

ZTEST(payment, test_transport_error_reuses_charge)
{
	char frame[PAYMENT_FRAME_MAX];

	send_error = -EIO;
	zassert_ok(payment_begin(&payment, "ABC1D23", 200, 0));
	send_error = 0;
	zassert_equal(payment_poll(&payment, 1000), PAYMENT_NONE);
	zassert_equal(sent_count, 2);
	zassert_str_equal(sent[0], sent[1]);

	result(frame, 0, "PAID 200 BRL");
	zassert_equal(feed(frame, 1010), PAYMENT_PAID);
	zassert_equal(sent_count, 2);
}

ZTEST(payment, test_payment_cancellation_invalidates_current_uuid)
{
	char frame[PAYMENT_FRAME_MAX];

	zassert_ok(payment_begin(&payment, "ABC1D23", 200, 0));
	payment_cancel(&payment);
	payment_cancel(&payment);
	zassert_equal(sent_count, 2);
	zassert_str_equal(sent[1], "P1 CANCEL 00000000-0000-4000-8000-000000000001\n");
	zassert_ok(payment_begin(&payment, "ABC1D23", 200, 10));
	zassert_not_equal(strcmp(sent[0], sent[2]), 0);

	result(frame, 0, "PAID 200 BRL");
	zassert_equal(feed(frame, 20), PAYMENT_NONE, "stale UUID");
	result(frame, 2, "CANCELLED 200 BRL");
	zassert_equal(feed(frame, 30), PAYMENT_DENIED);
	zassert_equal(sent_count, 4);
	zassert_str_equal(sent[3], "P1 CANCEL 00000000-0000-4000-8000-000000000002\n");
	result(frame, 2, "PAID 200 BRL");
	zassert_equal(feed(frame, 40), PAYMENT_NONE);
}

ZTEST(payment, test_noncanonical_and_unrelated_results)
{
	static const char *const fields[] = {
		"PAID broken BRL",
		"PAID 0200 BRL",
		"PAID 201 BRL",
		"PAID 200 USD",
		"PAID  200 BRL",
		"PAID 200 BRL ",
		"PAID 200 BRL\r",
		"PAID 200 BRL\t",
		"CANCELLED 201 BRL",
	};
	char frame[PAYMENT_FRAME_MAX];

	zassert_ok(payment_begin(&payment, "ABC1D23", 200, 0));
	zassert_equal(feed("\nP1 ERROR FRAME\n", 1), PAYMENT_NONE);
	for (size_t i = 0; i < ARRAY_SIZE(fields); i++) {
		result(frame, 0, fields[i]);
		zassert_equal(feed(frame, 2), PAYMENT_NONE, "accepted %s", fields[i]);
	}
	zassert_equal(sent_count, 1);
	result(frame, 0, "PAID 200 BRL");
	zassert_equal(feed(frame, 3), PAYMENT_PAID);
}

ZTEST(payment, test_timeout_and_rx_loss_resynchronization)
{
	char frame[PAYMENT_FRAME_MAX];
	char oversized[PAYMENT_FRAME_MAX + 3];

	zassert_ok(payment_begin(&payment, "ABC1D23", 200, 0));
	result(frame, 0, "PAID 200 BRL");
	zassert_equal(payment_receive(&payment, frame[0], 10), PAYMENT_NONE);
	zassert_equal(payment_poll(&payment, 1000), PAYMENT_NONE);
	zassert_equal(feed(frame + 1, 1010), PAYMENT_NONE, "expired frame accepted");

	memset(oversized, 'x', sizeof(oversized) - 2);
	oversized[sizeof(oversized) - 2] = '\n';
	oversized[sizeof(oversized) - 1] = '\0';
	zassert_equal(feed(oversized, 1011), PAYMENT_NONE);
	zassert_equal(feed("P1 partial", 1012), PAYMENT_NONE);
	payment_rx_lost(&payment);
	zassert_equal(feed(frame, 1013), PAYMENT_PAID);
}

ZTEST(payment, test_reset_clears_pending_charge_and_partial_frame)
{
	char frame[PAYMENT_FRAME_MAX];

	zassert_ok(payment_begin(&payment, "ABC1D23", 200, 0));
	result(frame, 0, "PAID 200 BRL");
	zassert_equal(payment_receive(&payment, frame[0], 1), PAYMENT_NONE);
	payment_init(&payment, fake_send);
	zassert_equal(feed(frame, 2), PAYMENT_NONE);
	zassert_equal(payment_poll(&payment, 1000), PAYMENT_NONE);
	zassert_equal(sent_count, 1);
	zassert_ok(payment_begin(&payment, "ABC1D23", 200, 1001));
	zassert_str_equal(sent[0], sent[1], "the equipment resets its namespace too");
}

ZTEST(payment, test_invalid_requests_do_not_send)
{
	zassert_equal(payment_begin(&payment, NULL, 200, 0), -EINVAL);
	zassert_equal(payment_begin(&payment, "bad", 200, 0), -EINVAL);
	zassert_equal(payment_begin(&payment, "ABC1D23", 0, 0), -EINVAL);
	zassert_equal(payment_begin(&payment, "ABC1D23", 1000001, 0), -EINVAL);
	payment.serial = UINT32_MAX;
	zassert_equal(payment_begin(&payment, "ABC1D23", 200, 0), -EOVERFLOW);
	zassert_equal(sent_count, 0);
}

ZTEST_SUITE(payment, NULL, NULL, before_each, NULL, NULL);
```

## src/test_payment_parser.c
```c
/*
 * test_payment_parser.c — analisador P1 (REQ-11, REQ-05) e UUID.
 * Lógica pura, sem falsos. Garante principalmente que NADA malformado vira RESULT.
 */
#include <string.h>

#include <zephyr/ztest.h>

#include "payment_parser.h"
#include "payment_uuid.h"

#define UUID "3f2a9c10-7b4e-4d21-9a6f-0c5e8b7d12c1"

static struct payment_parser parser;
static struct payment_frame frame;

static void reset_parser(void *fixture)
{
	ARG_UNUSED(fixture);
	payment_parser_init(&parser);
	memset(&frame, 0, sizeof(frame));
}

static enum payment_frame_kind feed_text(const char *text, int64_t now)
{
	enum payment_frame_kind last = PAYMENT_FRAME_NONE;

	for (const char *p = text; *p != '\0'; ++p) {
		enum payment_frame_kind kind = payment_parser_feed(&parser, (uint8_t)*p, now, &frame);

		if (kind != PAYMENT_FRAME_NONE) {
			last = kind;
		}
	}
	return last;
}

ZTEST_SUITE(payment_parser, NULL, NULL, reset_parser, NULL, NULL);

ZTEST(payment_parser, test_paid_result_fields)
{
	zassert_equal(feed_text("P1 RESULT " UUID " PAID 400 BRL\n", 0), PAYMENT_FRAME_RESULT);
	zassert_str_equal(frame.uuid, UUID);
	zassert_equal(frame.status, PAYMENT_STATUS_PAID);
	zassert_equal(frame.amount, 400U);
}

ZTEST(payment_parser, test_cancelled_result_and_amount_limits)
{
	zassert_equal(feed_text("P1 RESULT " UUID " CANCELLED 1 BRL\n", 0), PAYMENT_FRAME_RESULT);
	zassert_equal(frame.status, PAYMENT_STATUS_CANCELLED);
	zassert_equal(frame.amount, 1U);
	zassert_equal(feed_text("P1 RESULT " UUID " PAID 1000000 BRL\n", 0), PAYMENT_FRAME_RESULT);
	zassert_equal(frame.amount, 1000000U);
}

ZTEST(payment_parser, test_error_frames_for_every_known_code)
{
	static const char *const lines[] = {
		"P1 ERROR FRAME\n", "P1 ERROR TIMEOUT\n", "P1 ERROR CAPACITY\n",
		"P1 ERROR CONFLICT\n", "P1 ERROR UNKNOWN\n",
	};

	for (size_t i = 0U; i < ARRAY_SIZE(lines); ++i) {
		zassert_equal(feed_text(lines[i], 0), PAYMENT_FRAME_ERROR);
	}
	zassert_equal(feed_text("P1 ERROR BOGUS\n", 0), PAYMENT_FRAME_INVALID);
}

ZTEST(payment_parser, test_invalid_lines_never_become_results)
{
	static const char *const bad[] = {
		"\n",
		"HELLO\n",
		"P2 RESULT " UUID " PAID 400 BRL\n",              /* versão errada */
		"P1RESULT " UUID " PAID 400 BRL\n",               /* sem espaço */
		"P1 STATUS " UUID " PAID 400 BRL\n",              /* verbo desconhecido */
		"P1 RESULT " UUID " PAID broken BRL\n",           /* valor quebrado (modelo MALFORMED) */
		"P1 RESULT " UUID " PAID 0 BRL\n",                /* valor zero */
		"P1 RESULT " UUID " PAID 0400 BRL\n",             /* zero à esquerda */
		"P1 RESULT " UUID " PAID 1000001 BRL\n",          /* acima do limite */
		"P1 RESULT " UUID " PAID 12345678901 BRL\n",      /* 11 dígitos */
		"P1 RESULT " UUID " PAID -400 BRL\n",
		"P1 RESULT " UUID " PAID 400 USD\n",              /* moeda errada */
		"P1 RESULT " UUID " PAID 400 BRL \n",             /* espaço no fim */
		"P1 RESULT " UUID " PAID 400 BRL extra\n",
		"P1 RESULT " UUID " PAID 400\n",                  /* sem moeda */
		"P1 RESULT " UUID " paid 400 BRL\n",              /* minúscula */
		"P1 RESULT " UUID " REFUNDED 400 BRL\n",          /* status desconhecido */
		"P1 RESULT " UUID "  PAID 400 BRL\n",             /* dois espaços */
		"P1 RESULT " UUID "PAID 400 BRL\n",               /* sem espaço depois do UUID */
		"P1 RESULT 3F2A9C10-7B4E-4D21-9A6F-0C5E8B7D12C1 PAID 400 BRL\n", /* UUID maiúsculo */
		"P1 RESULT 3f2a9c10-7b4e-4d21-9a6f-0c5e8b7d12c PAID 400 BRL\n",  /* UUID curto */
		"P1 RESULT 3f2a9c107b4e-4d21-9a6f-0c5e8b7d12c1x PAID 400 BRL\n", /* hífen faltando */
		"P1 RESULT 3f2a9c10-7b4e-4d21-9a6f-0c5e8b7d12g1 PAID 400 BRL\n", /* não é hexa */
		"P1 RESULT " UUID "\n",                           /* corta depois do UUID */
		"P1 ERROR\n",
		"P1 ERROR FRAME extra\n",
	};

	for (size_t i = 0U; i < ARRAY_SIZE(bad); ++i) {
		zassert_equal(feed_text(bad[i], (int64_t)i), PAYMENT_FRAME_INVALID, "linha %u",
			      (unsigned int)i);
	}
	zassert_equal(feed_text("P1 ERROR FRAME\n", 100), PAYMENT_FRAME_ERROR); /* ainda sincronizado */
}

ZTEST(payment_parser, test_cr_is_forbidden_because_p1_ends_in_lf_only)
{
	zassert_equal(feed_text("P1 ERROR FRAME\r\n", 0), PAYMENT_FRAME_INVALID);
	zassert_equal(feed_text("P1 ERROR FRAME\n", 1), PAYMENT_FRAME_ERROR);
}

ZTEST(payment_parser, test_forbidden_byte_discards_through_lf_then_resyncs)
{
	zassert_equal(payment_parser_feed(&parser, 'P', 0, &frame), PAYMENT_FRAME_NONE);
	zassert_equal(payment_parser_feed(&parser, 0x01, 0, &frame), PAYMENT_FRAME_NONE);
	zassert_equal(payment_parser_feed(&parser, 0x80, 0, &frame), PAYMENT_FRAME_NONE);
	/* uma linha que "parece" boa, mas está dentro do trecho descartado */
	zassert_equal(feed_text("P1 ERROR FRAME\n", 0), PAYMENT_FRAME_INVALID);
	zassert_equal(feed_text("P1 ERROR FRAME\n", 1), PAYMENT_FRAME_ERROR);

	/* byte acima de 126 (DEL = 127) numa linha limpa também invalida a linha toda */
	zassert_equal(payment_parser_feed(&parser, 'P', 2, &frame), PAYMENT_FRAME_NONE);
	zassert_equal(payment_parser_feed(&parser, 0x7F, 2, &frame), PAYMENT_FRAME_NONE);
	zassert_true(parser.discarding);
	zassert_equal(feed_text("1 ERROR FRAME\n", 2), PAYMENT_FRAME_INVALID);
	zassert_equal(feed_text("P1 ERROR FRAME\n", 3), PAYMENT_FRAME_ERROR);
}

ZTEST(payment_parser, test_frame_limit_is_128_bytes_with_the_lf)
{
	for (int i = 0; i < 127; ++i) {
		zassert_equal(payment_parser_feed(&parser, 'A', 0, &frame), PAYMENT_FRAME_NONE);
	}
	zassert_false(parser.discarding);
	zassert_equal(parser.len, 127U);
	zassert_equal(payment_parser_feed(&parser, '\n', 0, &frame), PAYMENT_FRAME_INVALID); /* cabe */

	for (int i = 0; i < 127; ++i) {
		zassert_equal(payment_parser_feed(&parser, 'A', 1, &frame), PAYMENT_FRAME_NONE);
	}
	zassert_equal(payment_parser_feed(&parser, 'A', 1, &frame), PAYMENT_FRAME_NONE);
	zassert_true(parser.discarding); /* o 128º byte não foi LF: estourou */
	zassert_equal(feed_text("\n", 1), PAYMENT_FRAME_INVALID);
	zassert_equal(feed_text("P1 ERROR FRAME\n", 2), PAYMENT_FRAME_ERROR);
}

ZTEST(payment_parser, test_partial_line_deadline_counts_from_first_byte)
{
	zassert_equal(feed_text("P1 RESULT ", 0), PAYMENT_FRAME_NONE);
	zassert_equal(feed_text(UUID " PAID ", 600), PAYMENT_FRAME_NONE);
	zassert_equal(feed_text("400 BRL\n", 999), PAYMENT_FRAME_RESULT); /* a tempo */

	zassert_equal(feed_text("P1 RESULT ", 2000), PAYMENT_FRAME_NONE);
	zassert_equal(feed_text(UUID " PAID 400 BRL\n", 3000), PAYMENT_FRAME_INVALID); /* venceu */
	zassert_equal(feed_text("P1 ERROR FRAME\n", 3010), PAYMENT_FRAME_ERROR);
}

ZTEST(payment_parser, test_expire_on_idle_parser_and_explicit_expire)
{
	payment_parser_expire(&parser, 100000);
	zassert_equal(feed_text("P1 ERROR FRAME\n", 100000), PAYMENT_FRAME_ERROR);
	zassert_equal(feed_text("P1", 200000), PAYMENT_FRAME_NONE);
	payment_parser_expire(&parser, 200999);
	zassert_equal(parser.len, 2U);
	payment_parser_expire(&parser, 201000);
	zassert_true(parser.discarding);
	zassert_equal(feed_text("\n", 201001), PAYMENT_FRAME_INVALID);
}

ZTEST(payment_parser, test_valid_prefix_without_lf_is_never_executed)
{
	zassert_equal(feed_text("P1 RESULT " UUID " PAID 400 BRL", 0), PAYMENT_FRAME_NONE);
}

/* ---- UUID ---- */

ZTEST(payment_parser, test_plate_validation)
{
	zassert_true(payment_plate_valid("ABC1D23"));
	zassert_true(payment_plate_valid("ABC1234"));
	zassert_false(payment_plate_valid("abc1d23"));
	zassert_false(payment_plate_valid("1BC1D23"));
	zassert_false(payment_plate_valid("ABCDD23"));
	zassert_false(payment_plate_valid("ABC1#23"));
	zassert_false(payment_plate_valid("ABC1DA3"));
	zassert_false(payment_plate_valid("ABC1D2A"));
	zassert_false(payment_plate_valid("ABC1D2"));
	zassert_false(payment_plate_valid("ABC1D234")); /* 8 caracteres: 8ª posição não é NUL */
}

ZTEST(payment_parser, test_generated_uuids_are_valid_and_unique)
{
	char first[PAYMENT_UUID_SIZE];
	char second[PAYMENT_UUID_SIZE];

	payment_uuid_make(0U, first);
	payment_uuid_make(1U, second);
	zassert_true(payment_uuid_valid(first));
	zassert_true(payment_uuid_valid(second));
	zassert_true(strcmp(first, second) != 0);
	zassert_equal(first[14], '4'); /* forma de UUID v4 */
	zassert_true(strchr("89ab", first[19]) != NULL);
	/* os 12 últimos dígitos carregam o contador (unicidade por construção) */
	payment_uuid_make(0xABCDEF012345ULL, second);
	zassert_str_equal(&second[24], "abcdef012345");
}

ZTEST(payment_parser, test_uuid_validation_rejects_bad_shapes)
{
	zassert_true(payment_uuid_valid(UUID));
	zassert_false(payment_uuid_valid(UUID "0"));       /* longo demais */
	zassert_false(payment_uuid_valid("3f2a9c10"));     /* curto */
	zassert_false(payment_uuid_valid("3F2A9C10-7B4E-4D21-9A6F-0C5E8B7D12C1"));
	zassert_true(payment_uuid_prefix_valid(UUID " resto"));
}
```

## src/test_tariff.c
```c
/*
 * test_tariff.c — tarifa (REQ-12): 200 + (unidades - 1) * 100, com
 * unidades = max(1, ceil(tempo / unidade)), e assistência acima de 9999 unidades.
 * Função pura: nenhum falso necessário.
 */
#include <zephyr/ztest.h>

#include "tariff.h"

ZTEST_SUITE(tariff, NULL, NULL, NULL, NULL, NULL);

static uint32_t amount_for(int64_t elapsed, uint32_t unit)
{
	uint32_t amount = 0U;

	zassert_true(tariff_compute(1000, 1000 + elapsed, unit, &amount));
	return amount;
}

ZTEST(tariff, test_example_from_the_challenge)
{
	/* 2,5 s com unidade de 1000 ms: 3 unidades = 400 centavos (BRL 4.00) */
	zassert_equal(amount_for(2500, 1000), 400U);
}

ZTEST(tariff, test_minimum_is_one_unit)
{
	zassert_equal(amount_for(0, 1000), 200U);
	zassert_equal(amount_for(1, 1000), 200U);
	zassert_equal(amount_for(1000, 1000), 200U); /* exatamente 1 unidade */
}

ZTEST(tariff, test_rounds_up_to_the_next_unit)
{
	zassert_equal(amount_for(1001, 1000), 300U);
	zassert_equal(amount_for(2000, 1000), 300U);
	zassert_equal(amount_for(2001, 1000), 400U);
	zassert_equal(amount_for(120001, 60000), 400U); /* unidade padrão do Kconfig */
}

ZTEST(tariff, test_limit_9999_units_is_exactly_the_terminal_maximum)
{
	uint32_t amount = 0U;

	zassert_equal(amount_for(9999 * 1000, 1000), 1000000U);
	zassert_false(tariff_compute(0, 9999 * 1000 + 1, 1000, &amount));
	zassert_equal(amount, 0U); /* não é alterado em caso de erro */
}

ZTEST(tariff, test_invalid_inputs)
{
	uint32_t amount = 0U;

	zassert_false(tariff_compute(0, 100, 0, &amount)); /* unidade zero */
	zassert_true(tariff_compute(500, 100, 1000, &amount)); /* relógio voltou: 1 unidade */
	zassert_equal(amount, 200U);
	zassert_false(tariff_compute(0, INT64_MAX, 1000, &amount)); /* sem estouro de conta */
}
```
