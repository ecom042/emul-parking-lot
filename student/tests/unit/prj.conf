## CMakeLists.txt
```
# Suite de testes de unidade (ztest + FFF), compilada para a mesma placa e
# executada no Renode por scripts/firmware-coverage.py. As linhas de
# student/src que ela executa contam para a cobertura se a suíte passar.
#
# É uma suíte só (o curso só procura student/tests/<suíte>/), com uma
# subpasta por módulo testado: fsm/, e depois as dos outros módulos.
cmake_minimum_required(VERSION 3.20.0)
list(APPEND BOARD_ROOT ${CMAKE_CURRENT_SOURCE_DIR}/../../../hardware)
list(APPEND DTS_ROOT ${CMAKE_CURRENT_SOURCE_DIR}/../../../hardware)
find_package(Zephyr REQUIRED HINTS $ENV{ZEPHYR_BASE})
project(parking_student_unit)

target_sources(app PRIVATE src/test_exemplo.c)

# fsm/lane: motor genérico da máquina de estados.
target_include_directories(app PRIVATE ../../src/include)
target_sources(app PRIVATE
	fsm/test_lane.c
	../../src/fsm/src/lane.c
)

# fsm/lanes: as duas faixas, suas filas e events_post().
target_sources(app PRIVATE
	fsm/test_lanes.c
	../../src/fsm/src/lanes.c
)

# services/signals: luzes e buzzer. hw/indicator é falsificado pelo FFF no
# teste; hw/lane_hw é o real (só dados do devicetree).
target_sources(app PRIVATE
	signals/test_signals.c
	../../src/services/src/signals.c
	../../src/hw/src/lane_hw.c
)

# services/barrier: motor + fins de curso. hw/motor e hw/sensor são falsos do
# FFF; events_post() é o real (fsm/lanes.c), lido pela fila da faixa.
target_sources(app PRIVATE
	barrier/test_barrier.c
	../../src/services/src/barrier.c
)

# services/camera: reconhecimento de placa. hw/uart_line é falso do FFF (não
# listar hw/src/uart_line.c); events_post() é o real, lido pela fila da faixa.
target_sources(app PRIVATE
	camera/test_camera.c
	../../src/services/src/camera.c
)

# services/distance: aquisição do ADC4. hw/adc4 é falso do FFF (não listar
# hw/src/adc4.c); events_post() é o real, lido pela fila da faixa.
target_sources(app PRIVATE
	distance/test_distance.c
	../../src/services/src/distance.c
)

# services/screen: tela de cobrança. hw/st7789 é falso do FFF (não listar
# hw/src/st7789.c); text.c e lane_hw.c são os reais (já listados).
target_sources(app PRIVATE
	screen/test_screen.c
	../../src/services/src/screen.c
)

# services/payment: cobrança no terminal P1. hw/uart_line é falso do FFF (não
# listar hw/src/uart_line.c); events_post() é o real, lido pela fila da faixa.
target_sources(app PRIVATE
	payment/test_payment.c
	../../src/services/src/payment.c
)

# services/presence: histerese 683/1024 sobre chan_distance e o feixe.
# hw/sensor é falso do FFF (definido em barrier/test_barrier.c); o canal é o
# real de distance.c (já listado); events_post() é o real.
target_sources(app PRIVATE
	presence/test_presence.c
	../../src/services/src/presence.c
)

# services/sessions: tabela de vagas compartilhada pelas duas faixas (sem
# falsos: só o mutex do kernel).
target_sources(app PRIVATE
	sessions/test_sessions.c
	../../src/services/src/sessions.c
)

# services/tariff: valor da cobrança (lógica pura, sem falsos).
target_sources(app PRIVATE
	tariff/test_tariff.c
	../../src/services/src/tariff.c
)

# Erros de programação (id de faixa inválido) disparam o __ASSERT do módulo;
# o hook do ztest transforma o assert esperado no fim do teste.
target_sources(app PRIVATE asserts/test_asserts.c)

# Lógica pura dos protocolos (sem hardware, sem falsos): wire, line_framer,
# camera_proto, p1_proto e text.
target_sources(app PRIVATE
	wire/test_wire.c
	line_framer/test_line_framer.c
	camera_proto/test_camera_proto.c
	p1_proto/test_p1_proto.c
	text/test_text.c
	../../src/services/src/wire.c
	../../src/services/src/line_framer.c
	../../src/services/src/camera_proto.c
	../../src/services/src/p1_proto.c
	../../src/services/src/text.c
)
# hw/lane_hw: equipamento de cada faixa vindo do devicetree (lane_hw.c já está
# na lista do signals acima).
target_sources(app PRIVATE lane_hw/test_lane_hw.c)
# Não inclua main.c: a suíte tem o próprio ponto de entrada (ztest).
```

## prj.conf
```kconfig
CONFIG_ZTEST=y
CONFIG_CONSOLE=y
CONFIG_UART_CONSOLE=y
CONFIG_PRINTK=y
CONFIG_SERIAL=y
CONFIG_PM=n
CONFIG_GPIO=y
CONFIG_SPI=y
CONFIG_ADC=y
CONFIG_ZBUS=y
# Expected asserts end the test thread instead of halting (tests of
# programming errors: invalid lane, NULL handler).
CONFIG_ZTEST_ASSERT_HOOK=y
CONFIG_ASSERT_TEST=y
```

## src/main.c
```c
/*
 * Unit tests for session, camera, and payment modules.
 *
 * Uses ztest framework with FFF (Fake Function Framework) to mock
 * the hardware abstraction layer.
 *
 * SPDX-License-Identifier: Apache-2.0
 */

#include <zephyr/ztest.h>
#include <zephyr/fff.h>
#include <string.h>

#include "session.h"
#include "camera.h"
#include "payment.h"

DEFINE_FFF_GLOBALS;

/* ── Fake functions for hw.h ─────────────────────────────────────── */

FAKE_VALUE_FUNC(int, hw_uart_camera_send, lane_id_t, const uint8_t *, size_t);
FAKE_VALUE_FUNC(int, hw_uart_payment_send, const uint8_t *, size_t);

/* ══════════════════════════════════════════════════════════════════
 * Session tests
 * ══════════════════════════════════════════════════════════════════ */

ZTEST_SUITE(session_suite, NULL, NULL, NULL, NULL, NULL);

ZTEST(session_suite, test_session_init_empty)
{
	session_init();
	zassert_equal(session_count(), 0, "Session table should start empty");
	zassert_false(session_is_full(), "Should not be full when empty");
}

ZTEST(session_suite, test_session_create_and_find)
{
	session_init();

	int rc = session_create("ABC1D23", 1000);
	zassert_equal(rc, 0, "Create should succeed");
	zassert_equal(session_count(), 1, "Should have 1 session");
	zassert_true(session_has_plate("ABC1D23"), "Should find the plate");

	session_t *s = session_find("ABC1D23");
	zassert_not_null(s, "Session pointer should not be NULL");
	zassert_equal(s->entry_time_ms, 1000, "Entry time should match");
}

ZTEST(session_suite, test_session_remove)
{
	session_init();
	session_create("ABC1D23", 1000);

	int rc = session_remove("ABC1D23");
	zassert_equal(rc, 0, "Remove should succeed");
	zassert_equal(session_count(), 0, "Should have 0 sessions");
	zassert_false(session_has_plate("ABC1D23"),
		      "Should not find removed plate");
}

ZTEST(session_suite, test_session_remove_nonexistent)
{
	session_init();
	int rc = session_remove("XYZ9A99");
	zassert_equal(rc, -1, "Remove nonexistent should fail");
}

ZTEST(session_suite, test_session_duplicate)
{
	session_init();
	session_create("ABC1D23", 1000);
	int rc = session_create("ABC1D23", 2000);
	zassert_equal(rc, -1, "Duplicate create should fail");
	zassert_equal(session_count(), 1, "Should still have 1 session");
}

ZTEST(session_suite, test_session_capacity)
{
	session_init();

	char plates[][8] = {"AAA1A00", "BBB2B00", "CCC3C00", "DDD4D00",
			    "EEE5E00", "FFF6F00", "GGG7G00", "HHH8H00"};

	for (int i = 0; i < CONFIG_PARKING_CAPACITY; i++) {
		int rc = session_create(plates[i], (int64_t)(i * 1000));
		zassert_equal(rc, 0, "Create %d should succeed", i);
	}

	zassert_true(session_is_full(), "Should be full at capacity");

	/* One more should fail */
	if (CONFIG_PARKING_CAPACITY < 8) {
		int rc = session_create(plates[CONFIG_PARKING_CAPACITY], 99000);
		zassert_equal(rc, -1, "Create above capacity should fail");
	}
}

ZTEST(session_suite, test_session_clear)
{
	session_init();
	session_create("ABC1D23", 1000);
	session_create("DEF4G56", 2000);
	zassert_equal(session_count(), 2, "Should have 2 sessions");

	session_clear();
	zassert_equal(session_count(), 0, "Should have 0 after clear");
}

/* ══════════════════════════════════════════════════════════════════
 * Camera tests
 * ══════════════════════════════════════════════════════════════════ */

ZTEST_SUITE(camera_suite, NULL, NULL, NULL, NULL, NULL);

ZTEST(camera_suite, test_plate_validation_valid)
{
	zassert_true(camera_validate_plate("ABC1D23"), "ABC1D23 is valid");
	zassert_true(camera_validate_plate("XYZ9A00"), "XYZ9A00 is valid");
	zassert_true(camera_validate_plate("ABC1234"), "ABC1234 is valid");
}

ZTEST(camera_suite, test_plate_validation_invalid)
{
	zassert_false(camera_validate_plate("abc1D23"), "lowercase invalid");
	zassert_false(camera_validate_plate("AB1CD23"), "wrong format");
	zassert_false(camera_validate_plate("ABCDEFG"), "no digits");
	zassert_false(camera_validate_plate("ABC1D2"), "too short");
	zassert_false(camera_validate_plate("ABC1D234"), "too long");
	zassert_false(camera_validate_plate(""), "empty");
}

ZTEST(camera_suite, test_camera_init)
{
	camera_ctx_t ctx;
	camera_init(&ctx, LANE_ENTRY);

	zassert_equal(ctx.state, CAMERA_STATE_IDLE, "Should start idle");
	zassert_equal(ctx.lane, LANE_ENTRY, "Should be entry lane");
	zassert_equal(ctx.rx_len, 0, "Buffer should be empty");
}

ZTEST(camera_suite, test_camera_ok_and_plate_response)
{
	camera_ctx_t ctx;
	camera_init(&ctx, LANE_ENTRY);

	RESET_FAKE(hw_uart_camera_send);
	hw_uart_camera_send_fake.return_val = 0;

	camera_start_capture(&ctx);
	zassert_equal(ctx.state, CAMERA_STATE_WAIT_OK,
		      "Should be waiting for OK");

	/* Feed OK response */
	const char *ok = "OK\r\n";
	camera_rx_feed(&ctx, (const uint8_t *)ok, strlen(ok));
	zassert_equal(ctx.state, CAMERA_STATE_WAIT_PLATE,
		      "Should be waiting for plate after OK");

	/* Feed plate response with matching ID */
	char plate_resp[64];
	snprintf(plate_resp, sizeof(plate_resp),
		 "+PLATE:%u,\"ABC1D23\",93\r\n", ctx.capture_id);
	camera_rx_feed(&ctx, (const uint8_t *)plate_resp, strlen(plate_resp));

	zassert_equal(ctx.state, CAMERA_STATE_DONE, "Should be done");
	zassert_true(ctx.plate_valid, "Plate should be valid");
	zassert_mem_equal(ctx.plate, "ABC1D23", 7, "Plate should match");
	zassert_equal(ctx.confidence, 93, "Confidence should be 93");
}

ZTEST(camera_suite, test_camera_low_confidence_retry)
{
	camera_ctx_t ctx;
	camera_init(&ctx, LANE_ENTRY);

	RESET_FAKE(hw_uart_camera_send);
	hw_uart_camera_send_fake.return_val = 0;

	camera_start_capture(&ctx);
	uint32_t first_id = ctx.capture_id;

	/* OK + low confidence plate */
	const char *ok = "OK\r\n";
	camera_rx_feed(&ctx, (const uint8_t *)ok, strlen(ok));

	char plate_resp[64];
	snprintf(plate_resp, sizeof(plate_resp),
		 "+PLATE:%u,\"ABC1D23\",60\r\n", first_id);
	camera_rx_feed(&ctx, (const uint8_t *)plate_resp, strlen(plate_resp));

	/* Should have moved to next attempt with new ID */
	zassert_true(ctx.capture_id > first_id,
		     "Should have new capture ID after low confidence");
	zassert_equal(ctx.attempt, 1, "Should be on second attempt");
}

ZTEST(camera_suite, test_camera_wrong_id_ignored)
{
	camera_ctx_t ctx;
	camera_init(&ctx, LANE_ENTRY);

	RESET_FAKE(hw_uart_camera_send);
	hw_uart_camera_send_fake.return_val = 0;

	camera_start_capture(&ctx);

	const char *ok = "OK\r\n";
	camera_rx_feed(&ctx, (const uint8_t *)ok, strlen(ok));

	/* Feed plate with wrong ID */
	const char *wrong = "+PLATE:999999,\"ABC1D23\",93\r\n";
	camera_rx_feed(&ctx, (const uint8_t *)wrong, strlen(wrong));

	zassert_equal(ctx.state, CAMERA_STATE_WAIT_PLATE,
		      "Should still be waiting (wrong ID ignored)");
}

ZTEST(camera_suite, test_camera_malformed_response)
{
	camera_ctx_t ctx;
	camera_init(&ctx, LANE_ENTRY);

	RESET_FAKE(hw_uart_camera_send);
	hw_uart_camera_send_fake.return_val = 0;

	camera_start_capture(&ctx);

	const char *ok = "OK\r\n";
	camera_rx_feed(&ctx, (const uint8_t *)ok, strlen(ok));

	/* Malformed plate (bad format) */
	char resp[64];
	snprintf(resp, sizeof(resp), "+PLATE:%u,\"abc1234\",93\r\n",
		 ctx.capture_id);
	camera_rx_feed(&ctx, (const uint8_t *)resp, strlen(resp));

	zassert_equal(ctx.state, CAMERA_STATE_WAIT_PLATE,
		      "Should still be waiting (malformed plate)");
}

/* ══════════════════════════════════════════════════════════════════
 * Payment tests
 * ══════════════════════════════════════════════════════════════════ */

ZTEST_SUITE(payment_suite, NULL, NULL, NULL, NULL, NULL);

ZTEST(payment_suite, test_tariff_calculation_minimum)
{
	/* Under 1 unit: should be minimum 200 */
	int32_t amount = payment_calc_tariff(500, 1000);
	zassert_equal(amount, 200, "0.5s / 1s unit = 1 unit = 200 centavos");
}

ZTEST(payment_suite, test_tariff_calculation_exact_unit)
{
	int32_t amount = payment_calc_tariff(1000, 1000);
	zassert_equal(amount, 200, "1s / 1s unit = 1 unit = 200 centavos");
}

ZTEST(payment_suite, test_tariff_calculation_multiple_units)
{
	/* 2500ms / 1000ms = ceil(2.5) = 3 units */
	int32_t amount = payment_calc_tariff(2500, 1000);
	zassert_equal(amount, 400, "2.5s / 1s unit = 3 units = 400 centavos");
}

ZTEST(payment_suite, test_tariff_calculation_overflow)
{
	/* Very long time: >9999 units should return -1 */
	int32_t amount = payment_calc_tariff(10000000LL, 1000);
	zassert_equal(amount, -1, "10000 units should overflow");
}

ZTEST(payment_suite, test_tariff_calculation_zero_elapsed)
{
	int32_t amount = payment_calc_tariff(0, 1000);
	zassert_equal(amount, 200, "0ms elapsed = minimum 200 centavos");
}

ZTEST(payment_suite, test_tariff_60s_unit)
{
	/* At default 60000ms unit */
	int32_t amount = payment_calc_tariff(60000, 60000);
	zassert_equal(amount, 200, "60s / 60s = 1 unit = 200");

	amount = payment_calc_tariff(60001, 60000);
	zassert_equal(amount, 300, "60.001s / 60s = 2 units = 300");
}

ZTEST(payment_suite, test_payment_init)
{
	payment_ctx_t ctx;
	payment_init(&ctx);

	zassert_equal(ctx.state, PAYMENT_STATE_IDLE, "Should start idle");
	zassert_equal(ctx.rx_len, 0, "Buffer should be empty");
}

ZTEST(payment_suite, test_payment_uuid_format)
{
	char uuid[37];
	payment_generate_uuid(uuid, sizeof(uuid));

	zassert_equal(strlen(uuid), 36, "UUID should be 36 chars");
	zassert_equal(uuid[8], '-', "UUID dash at pos 8");
	zassert_equal(uuid[13], '-', "UUID dash at pos 13");
	zassert_equal(uuid[18], '-', "UUID dash at pos 18");
	zassert_equal(uuid[23], '-', "UUID dash at pos 23");
}

ZTEST(payment_suite, test_payment_paid_response)
{
	payment_ctx_t ctx;
	payment_init(&ctx);

	RESET_FAKE(hw_uart_payment_send);
	hw_uart_payment_send_fake.return_val = 0;

	payment_start_charge(&ctx, "ABC1D23", 400);
	zassert_equal(ctx.state, PAYMENT_STATE_WAIT_RESULT,
		      "Should be waiting for result");

	/* Feed PAID response */
	char resp[128];
	snprintf(resp, sizeof(resp), "P1 RESULT %s PAID 400 BRL\n", ctx.uuid);
	payment_rx_feed(&ctx, (const uint8_t *)resp, strlen(resp));

	zassert_equal(ctx.state, PAYMENT_STATE_PAID, "Should be paid");
	zassert_true(ctx.paid, "Paid flag should be set");
}

ZTEST(payment_suite, test_payment_cancelled_response)
{
	payment_ctx_t ctx;
	payment_init(&ctx);

	RESET_FAKE(hw_uart_payment_send);
	hw_uart_payment_send_fake.return_val = 0;

	payment_start_charge(&ctx, "ABC1D23", 400);

	char resp[128];
	snprintf(resp, sizeof(resp), "P1 RESULT %s CANCELLED 400 BRL\n",
		 ctx.uuid);
	payment_rx_feed(&ctx, (const uint8_t *)resp, strlen(resp));

	zassert_equal(ctx.state, PAYMENT_STATE_FAILED,
		      "Should be failed on CANCELLED");
	zassert_false(ctx.paid, "Paid flag should not be set");
}

ZTEST(payment_suite, test_payment_wrong_uuid_ignored)
{
	payment_ctx_t ctx;
	payment_init(&ctx);

	RESET_FAKE(hw_uart_payment_send);
	hw_uart_payment_send_fake.return_val = 0;

	payment_start_charge(&ctx, "ABC1D23", 400);

	const char *resp = "P1 RESULT 00000000-0000-0000-0000-000000000000"
			   " PAID 400 BRL\n";
	payment_rx_feed(&ctx, (const uint8_t *)resp, strlen(resp));

	zassert_equal(ctx.state, PAYMENT_STATE_WAIT_RESULT,
		      "Should still be waiting (wrong UUID)");
}

ZTEST(payment_suite, test_payment_wrong_amount_ignored)
{
	payment_ctx_t ctx;
	payment_init(&ctx);

	RESET_FAKE(hw_uart_payment_send);
	hw_uart_payment_send_fake.return_val = 0;

	payment_start_charge(&ctx, "ABC1D23", 400);

	char resp[128];
	snprintf(resp, sizeof(resp), "P1 RESULT %s PAID 999 BRL\n", ctx.uuid);
	payment_rx_feed(&ctx, (const uint8_t *)resp, strlen(resp));

	zassert_equal(ctx.state, PAYMENT_STATE_WAIT_RESULT,
		      "Should still be waiting (wrong amount)");
}

ZTEST(payment_suite, test_payment_cr_rejected)
{
	payment_ctx_t ctx;
	payment_init(&ctx);

	RESET_FAKE(hw_uart_payment_send);
	hw_uart_payment_send_fake.return_val = 0;

	payment_start_charge(&ctx, "ABC1D23", 400);

	/* Response with CR (should be rejected in payment protocol) */
	char resp[128];
	snprintf(resp, sizeof(resp), "P1 RESULT %s PAID 400 BRL\r\n",
		 ctx.uuid);
	payment_rx_feed(&ctx, (const uint8_t *)resp, strlen(resp));

	/* CR is stripped, so LF should still terminate correctly */
	zassert_equal(ctx.state, PAYMENT_STATE_PAID,
		      "CR is ignored, LF terminates");
}
```

## src/test_exemplo.c
```c
/*
 * Exemplo de suíte ztest + FFF. Apague-o quando tiver as suas suítes.
 *
 * Ideia: o código de controle chama uma camada fina de hardware sua (por
 * exemplo, uma função que liga o motor). No firmware, essa camada chama os
 * drivers do Zephyr. No teste, o FFF a substitui por uma função falsa, que
 * registra as chamadas e devolve o que você quiser, inclusive erros que os
 * drivers reais nunca produzem no laboratório (-EIO, -EBUSY...). Assim os
 * caminhos de erro também são testados e cobertos.
 *
 * Aqui a "camada de hardware" e o "código de controle" estão no próprio
 * arquivo só para o exemplo compilar sozinho.
 */
#include <errno.h>
#include <stdbool.h>

#include <zephyr/fff.h>
#include <zephyr/ztest.h>

DEFINE_FFF_GLOBALS;

/** Camada de hardware falsa: no projeto real, declarada num .h seu. */
FAKE_VALUE_FUNC(int, exemplo_motor_ligar, bool);

/** "Código de controle" sob teste: liga o motor e repassa um erro. */
static int exemplo_abrir(void)
{
	int rc = exemplo_motor_ligar(true);

	if (rc != 0) {
		return rc;
	}
	return 0;
}

static void reiniciar_falsos(void *fixture)
{
	ARG_UNUSED(fixture);
	RESET_FAKE(exemplo_motor_ligar);
	FFF_RESET_HISTORY();
}

ZTEST_SUITE(exemplo, NULL, NULL, reiniciar_falsos, NULL, NULL);

ZTEST(exemplo, test_abrir_liga_o_motor)
{
	zassert_ok(exemplo_abrir());
	zassert_equal(exemplo_motor_ligar_fake.call_count, 1);
	zassert_true(exemplo_motor_ligar_fake.arg0_val);
}

ZTEST(exemplo, test_abrir_repassa_erro_do_driver)
{
	exemplo_motor_ligar_fake.return_val = -EIO;
	zassert_equal(exemplo_abrir(), -EIO);
}
```

## src/test_gate.c
```c
#include <errno.h>

#include <zephyr/fff.h>
#include <zephyr/ztest.h>

#include "gate.h"

FAKE_VALUE_FUNC(int, gate_write, void *, enum gate_output, bool);

static struct gate gate;
static const struct gate_inputs closed = { .lower = true };
static const struct gate_inputs opened = { .upper = true };
static const struct gate_inputs between = { 0 };

static void reset_gate(void *fixture)
{
	ARG_UNUSED(fixture);
	RESET_FAKE(gate_write);
	FFF_RESET_HISTORY();
	gate = (struct gate) { .write = gate_write };
}

static void assert_write(unsigned int index, enum gate_output output, bool active)
{
	zassert_true(gate_write_fake.call_count > index);
	zassert_equal(gate_write_fake.arg1_history[index], output);
	zassert_equal(gate_write_fake.arg2_history[index], active);
}

static void open_gate(void)
{
	zassert_true(gate_open(&gate, closed, 0));
	gate_step(&gate, opened, 2000);
	zassert_equal(gate.state, GATE_OPEN);
}

ZTEST_SUITE(gate_safety, NULL, NULL, reset_gate, NULL, NULL);

ZTEST(gate_safety, test_limits_stop_motor_and_green_follows_stop)
{
	open_gate();
	assert_write(2, GATE_DIRECTION, true);
	assert_write(3, GATE_ENABLE, true);
	assert_write(4, GATE_ENABLE, false);
	assert_write(6, GATE_GREEN, true);

	zassert_true(gate_close(&gate, opened, 2100));
	assert_write(7, GATE_GREEN, false);
	assert_write(8, GATE_RED, true);
	assert_write(9, GATE_DIRECTION, false);
	gate_step(&gate, closed, 4200);
	assert_write(11, GATE_ENABLE, false);
	zassert_equal(gate.state, GATE_CLOSED);
}

ZTEST(gate_safety, test_startup_without_lower_does_not_home)
{
	gate_step(&gate, between, 0);
	zassert_equal(gate.state, GATE_ASSISTANCE);
	assert_write(0, GATE_ENABLE, false);
	assert_write(3, GATE_BUZZER, true);
	zassert_true(gate.latched);
}

ZTEST(gate_safety, test_contradictory_limits_latch)
{
	gate_step(&gate, (struct gate_inputs) { .upper = true, .lower = true }, 10);
	gate_step(&gate, closed, 109);
	zassert_true(gate.buzzing);
	gate_step(&gate, closed, 110);
	assert_write(4, GATE_BUZZER, false);
	zassert_false(gate_rearm(&gate, closed, true));
	zassert_false(gate_open(&gate, closed, 111));
}

ZTEST(gate_safety, test_opening_timeout_stops_motor)
{
	zassert_true(gate_open(&gate, closed, 0));
	gate_step(&gate, between, GATE_MOTION_MS - 1);
	zassert_equal(gate.state, GATE_OPENING);
	gate_step(&gate, between, GATE_MOTION_MS);
	assert_write(4, GATE_ENABLE, false);
	zassert_equal(gate.state, GATE_ASSISTANCE);
	zassert_true(gate.latched);
}

ZTEST(gate_safety, test_closing_timeout_stops_motor)
{
	open_gate();
	zassert_true(gate_close(&gate, opened, 2100));
	gate_step(&gate, between, 2100 + GATE_MOTION_MS);
	assert_write(11, GATE_ENABLE, false);
	zassert_equal(gate.state, GATE_ASSISTANCE);
}

ZTEST(gate_safety, test_beam_blocks_close_then_stops_moving_gate)
{
	struct gate_inputs blocked = { .upper = true, .beam = true };

	open_gate();
	zassert_false(gate_close(&gate, blocked, 2010));
	zassert_equal(gate_write_fake.call_count, 7);
	zassert_true(gate_close(&gate, opened, 2100));
	gate_step(&gate, blocked, 2110);
	assert_write(11, GATE_ENABLE, false);
	zassert_equal(gate.state, GATE_ASSISTANCE);
	zassert_false(gate_close(&gate, opened, 2300));
}

ZTEST(gate_safety, test_rearm_requires_gone_vehicle_and_clear_beam)
{
	struct gate_inputs blocked = { .lower = true, .beam = true };

	gate_assist(&gate, 0, false);
	gate_step(&gate, closed, 100);
	zassert_false(gate_rearm(&gate, closed, false));
	zassert_false(gate_rearm(&gate, blocked, true));
	zassert_true(gate_rearm(&gate, closed, true));
	zassert_equal(gate.state, GATE_CLOSED);
}

ZTEST(gate_safety, test_output_failure_requests_assistance)
{
	gate_write_fake.return_val = -EIO;
	zassert_false(gate_open(&gate, closed, 0));
	assert_write(1, GATE_ENABLE, false);
	assert_write(3, GATE_RED, true);
	zassert_equal(gate.state, GATE_ASSISTANCE);
	zassert_true(gate.latched);
}
```

## src/test_lane.c
```c
#include <errno.h>

#include <zephyr/fff.h>
#include <zephyr/sys/util.h>
#include <zephyr/ztest.h>

#include "lane.h"

DEFINE_FFF_GLOBALS;

FAKE_VALUE_FUNC(int, fake_motor, enum parking_lane_id, enum parking_motor);
FAKE_VALUE_FUNC(int, fake_signal, enum parking_lane_id, bool);
FAKE_VALUE_FUNC(int, fake_buzzer, enum parking_lane_id, bool);
FAKE_VALUE_FUNC(int, fake_request, const struct parking_request *);
FAKE_VALUE_FUNC(int, fake_passage, enum parking_lane_id, uint32_t, int64_t);
FAKE_VOID_FUNC(fake_cancel, enum parking_lane_id, uint32_t);

static const struct parking_io io = {
	.motor = fake_motor, .signal = fake_signal, .buzzer = fake_buzzer,
};
static const struct parking_services services = {
	.request = fake_request, .passage = fake_passage, .cancel = fake_cancel,
};
static struct parking_lane lane;
static struct parking_inputs inputs;
static struct parking_request last_request;

static int remember_request(const struct parking_request *request)
{
	last_request = *request;
	return fake_request_fake.return_val;
}

static void before_each(void *fixture)
{
	ARG_UNUSED(fixture);
	RESET_FAKE(fake_motor);
	RESET_FAKE(fake_signal);
	RESET_FAKE(fake_buzzer);
	RESET_FAKE(fake_request);
	RESET_FAKE(fake_passage);
	RESET_FAKE(fake_cancel);
	FFF_RESET_HISTORY();
	fake_request_fake.custom_fake = remember_request;
	last_request = (struct parking_request){0};
	inputs = (struct parking_inputs){ .lower = true, .distance = { .valid = true } };
	parking_lane_init(&lane, PARKING_ENTRY, &io, 20);
}

static void step(int64_t now_ms, uint16_t raw)
{
	inputs.distance.raw = raw;
	inputs.distance.sampled_ms = now_ms;
	parking_lane_step(&lane, &inputs, &services, now_ms);
}

static void reply(enum parking_reply_kind kind, uint32_t transaction, unsigned int attempt)
{
	const struct parking_reply message = {
		.kind = kind, .lane = lane.id, .transaction = transaction,
		.attempt = attempt, .plate = "ABC1D23",
	};
	parking_lane_receive(&lane, &message);
}

static void begin_open(enum parking_reply_kind allowed)
{
	step(20, 682);
	reply(PARKING_PLATE, last_request.transaction, 1);
	step(100, 682);
	reply(allowed, last_request.transaction, 0);
	step(200, 682);
	zassert_equal(lane.state, PARKING_OPENING);
	zassert_equal(fake_motor_fake.arg1_val, PARKING_OPEN);
}

static void reach_upper(void)
{
	inputs.lower = false;
	inputs.upper = true;
	FFF_RESET_HISTORY();
	step(2200, 682);
	zassert_equal(lane.state, PARKING_PASSAGE);
	zassert_equal(fake_motor_fake.arg1_val, PARKING_STOP);
	zassert_true(fake_signal_fake.arg1_val);
	zassert_true(fff.call_history[0] == (fff_function_t)fake_motor);
	zassert_true(fff.call_history[1] == (fff_function_t)fake_signal);
}

static void clear_passage(void)
{
	inputs.beam = true;
	step(2300, 1025);
	zassert_equal(fake_passage_fake.call_count, 0);
	inputs.beam = false;
	step(2400, 1024);
	zassert_equal(fake_passage_fake.call_count, 0);
	step(2500, 1025);
}

ZTEST_SUITE(parking_lane, NULL, NULL, before_each, NULL, NULL);

ZTEST(parking_lane, test_startup_without_lower_does_not_home)
{
	inputs.lower = false;
	step(19, 600);
	zassert_equal(lane.state, PARKING_STARTUP);
	zassert_equal(fake_motor_fake.call_count, 0);
	step(20, 600);
	zassert_equal(lane.state, PARKING_ASSISTANCE);
	zassert_true(lane.latched);
	zassert_equal(fake_motor_fake.arg1_val, PARKING_STOP);
	zassert_false(fake_signal_fake.arg1_val);
	zassert_true(fake_buzzer_fake.arg1_val);
	step(119, 1025);
	zassert_true(fake_buzzer_fake.arg1_val);
	step(120, 1025);
	zassert_false(fake_buzzer_fake.arg1_val);
	zassert_equal(fake_buzzer_fake.call_count, 2);
	zassert_equal(fake_request_fake.call_count, 0);
}

ZTEST(parking_lane, test_contradiction_latches_only_affected_lane)
{
	inputs.upper = true;
	step(20, 600);
	inputs.upper = false;
	step(150, 1025);
	zassert_equal(lane.state, PARKING_ASSISTANCE);
	zassert_true(lane.latched);
	zassert_equal(fake_buzzer_fake.call_count, 2);

	struct parking_lane other;
	parking_lane_init(&other, PARKING_EXIT, &io, 20);
	inputs.distance.raw = 682;
	parking_lane_step(&other, &inputs, &services, 151);
	zassert_equal(other.state, PARKING_IDENTIFYING);
	zassert_equal(last_request.lane, PARKING_EXIT);
	zassert_equal(fake_motor_fake.call_count, 1);
}

ZTEST(parking_lane, test_no_services_cannot_authorize)
{
	inputs.distance.raw = 682;
	inputs.distance.sampled_ms = 20;
	parking_lane_step(&lane, &inputs, NULL, 20);
	zassert_equal(lane.state, PARKING_IDLE);
	zassert_equal(fake_motor_fake.call_count, 0);
	zassert_equal(fake_request_fake.call_count, 0);
}

ZTEST(parking_lane, test_presence_and_capture_deadlines)
{
	step(20, 683);
	zassert_equal(lane.state, PARKING_IDLE);
	inputs.distance.raw = 682;
	parking_lane_step(&lane, &inputs, &services, 120);
	zassert_equal(fake_request_fake.call_count, 0);
	step(121, 682);
	uint32_t transaction = last_request.transaction;
	zassert_equal(last_request.deadline_ms, 1121);
	reply(PARKING_NO_PLATE, transaction, 1);
	step(150, 700);
	zassert_equal(last_request.attempt, 2);
	reply(PARKING_PLATE, transaction, 1);
	step(1149, 700);
	zassert_equal(fake_request_fake.call_count, 2);
	step(1150, 700);
	zassert_equal(last_request.attempt, 3);
	step(2150, 700);
	zassert_equal(lane.state, PARKING_ASSISTANCE);
	zassert_equal(fake_request_fake.call_count, 3);
	zassert_equal(fake_cancel_fake.arg1_val, transaction);
	step(2250, 682);
	zassert_equal(lane.state, PARKING_ASSISTANCE);
	inputs.beam = true;
	step(2251, 1025);
	zassert_equal(lane.state, PARKING_ASSISTANCE);
	inputs.beam = false;
	step(2252, 1025);
	zassert_equal(lane.state, PARKING_IDLE);
	step(2253, 682);
	zassert_not_equal(last_request.transaction, transaction);
	zassert_equal(last_request.attempt, 1);
}

ZTEST(parking_lane, test_exit_requires_current_paid_and_fresh_distance)
{
	parking_lane_init(&lane, PARKING_EXIT, &io, 20);
	step(20, 682);
	uint32_t transaction = last_request.transaction;
	reply(PARKING_PLATE, transaction, 1);
	step(100, 682);
	zassert_equal(last_request.kind, PARKING_AUTHORIZE_EXIT);
	zassert_mem_equal(last_request.plate, "ABC1D23", PARKING_PLATE_SIZE);
	reply(PARKING_EXIT_PAID, transaction + 1, 0);
	reply(PARKING_ENTRY_ALLOWED, transaction, 0);
	step(150, 682);
	zassert_equal(fake_motor_fake.call_count, 0);
	reply(PARKING_EXIT_PAID, transaction, 0);
	parking_lane_step(&lane, &inputs, &services, 250);
	zassert_equal(fake_motor_fake.call_count, 0);
	step(251, 1025);
	zassert_equal(lane.state, PARKING_ASSISTANCE);
	zassert_equal(fake_cancel_fake.arg1_val, transaction);
	zassert_equal(fake_motor_fake.arg1_val, PARKING_STOP);
	zassert_true(fake_buzzer_fake.arg1_val);
}

ZTEST(parking_lane, test_entry_commits_only_at_completed_passage)
{
	begin_open(PARKING_ENTRY_ALLOWED);
	zassert_equal(last_request.kind, PARKING_AUTHORIZE_ENTRY);
	uint32_t transaction = last_request.transaction;
	reach_upper();
	step(2201, 1025);
	zassert_equal(fake_passage_fake.call_count, 0);
	clear_passage();
	zassert_equal(fake_passage_fake.call_count, 1);
	zassert_equal(fake_passage_fake.arg1_val, transaction);
	zassert_equal(fake_passage_fake.arg2_val, 2500);
	zassert_equal(fake_motor_fake.arg1_val, PARKING_CLOSE);
	zassert_false(fake_signal_fake.arg1_val);
	inputs.upper = false;
	inputs.lower = true;
	step(4600, 1025);
	zassert_equal(lane.state, PARKING_IDLE);
	zassert_equal(fake_motor_fake.arg1_val, PARKING_STOP);
	zassert_equal(fake_passage_fake.call_count, 1);
}

ZTEST(parking_lane, test_beam_racing_close_defers_enable_without_recommit)
{
	begin_open(PARKING_ENTRY_ALLOWED);
	reach_upper();
	fake_motor_fake.return_val = -EAGAIN;
	clear_passage();
	zassert_equal(lane.state, PARKING_WAIT_CLEAR);
	unsigned int motor_calls = fake_motor_fake.call_count;
	inputs.beam = true;
	step(2600, 1025);
	zassert_equal(fake_motor_fake.call_count, motor_calls);
	inputs.beam = false;
	fake_motor_fake.return_val = 0;
	step(2700, 1025);
	zassert_equal(lane.state, PARKING_CLOSING);
	zassert_equal(fake_passage_fake.call_count, 1);
}

ZTEST(parking_lane, test_session_commit_failure_stops_cycle)
{
	begin_open(PARKING_ENTRY_ALLOWED);
	reach_upper();
	fake_passage_fake.return_val = -EIO;
	clear_passage();
	zassert_equal(lane.state, PARKING_ASSISTANCE);
	zassert_equal(fake_passage_fake.call_count, 1);
	zassert_equal(fake_motor_fake.arg1_val, PARKING_STOP);
	zassert_false(fake_signal_fake.arg1_val);
	zassert_equal(fake_cancel_fake.arg1_val, last_request.transaction);
}

ZTEST(parking_lane, test_obstruction_edge_stops_closing_and_latches)
{
	begin_open(PARKING_ENTRY_ALLOWED);
	reach_upper();
	clear_passage();
	inputs.upper = false;
	inputs.beam_rose = true;
	step(2650, 1025);
	zassert_equal(lane.state, PARKING_ASSISTANCE);
	zassert_equal(fake_motor_fake.arg1_val, PARKING_STOP);
	zassert_false(fake_signal_fake.arg1_val);
	zassert_true(lane.latched);
	unsigned int motor_calls = fake_motor_fake.call_count;
	inputs.beam_rose = false;
	step(2750, 1025);
	zassert_equal(fake_motor_fake.call_count, motor_calls);
	zassert_equal(fake_buzzer_fake.call_count, 2);
}

ZTEST(parking_lane, test_jam_stops_at_motion_deadline)
{
	begin_open(PARKING_ENTRY_ALLOWED);
	step(2699, 682);
	zassert_equal(lane.state, PARKING_OPENING);
	step(2700, 682);
	zassert_equal(lane.state, PARKING_ASSISTANCE);
	zassert_true(lane.latched);
	zassert_equal(fake_motor_fake.arg1_val, PARKING_STOP);
	zassert_false(fake_signal_fake.arg1_val);
}

ZTEST(parking_lane, test_missing_lower_latches_after_close_deadline)
{
	begin_open(PARKING_ENTRY_ALLOWED);
	reach_upper();
	clear_passage();
	inputs.upper = false;
	step(4999, 1025);
	zassert_equal(lane.state, PARKING_CLOSING);
	step(5000, 1025);
	zassert_equal(lane.state, PARKING_ASSISTANCE);
	zassert_equal(fake_motor_fake.arg1_val, PARKING_STOP);
	inputs.lower = true;
	step(5100, 1025);
	zassert_equal(lane.state, PARKING_ASSISTANCE);
}

ZTEST(parking_lane, test_held_beam_times_out_without_session_or_close)
{
	begin_open(PARKING_ENTRY_ALLOWED);
	reach_upper();
	inputs.beam = true;
	step(12199, 1025);
	zassert_equal(lane.state, PARKING_PASSAGE);
	step(12200, 1025);
	zassert_equal(lane.state, PARKING_ASSISTANCE);
	zassert_equal(fake_passage_fake.call_count, 0);
	zassert_equal(fake_motor_fake.call_count, 3);
	zassert_equal(fake_motor_fake.arg1_val, PARKING_STOP);
}

ZTEST(parking_lane, test_adc_fault_invalidates_authorized_motion)
{
	parking_lane_init(&lane, PARKING_EXIT, &io, 20);
	begin_open(PARKING_EXIT_PAID);
	inputs.adc_fault = true;
	step(300, 682);
	zassert_equal(lane.state, PARKING_ASSISTANCE);
	zassert_equal(fake_motor_fake.arg1_val, PARKING_STOP);
	zassert_equal(fake_cancel_fake.call_count, 1);
	inputs.adc_fault = false;
	step(400, 1025);
	zassert_equal(lane.state, PARKING_ASSISTANCE);
}

ZTEST(parking_lane, test_motor_driver_error_prevents_green)
{
	begin_open(PARKING_ENTRY_ALLOWED);
	inputs.lower = false;
	inputs.upper = true;
	fake_motor_fake.return_val = -EIO;
	step(2200, 682);
	zassert_equal(lane.state, PARKING_ASSISTANCE);
	zassert_true(lane.safe_outputs_pending);
	zassert_equal(fake_signal_fake.call_count, 1);
	zassert_false(fake_signal_fake.arg1_val);
	fake_motor_fake.return_val = 0;
	step(2201, 682);
	zassert_false(lane.safe_outputs_pending);
	zassert_equal(fake_signal_fake.call_count, 2);
	zassert_equal(fake_motor_fake.arg1_val, PARKING_STOP);
}

ZTEST(parking_lane, test_capture_queue_failure_cancels_and_stays_red)
{
	fake_request_fake.return_val = -ENOMSG;
	step(20, 682);
	zassert_equal(fake_request_fake.call_count, 1);
	zassert_equal(last_request.kind, PARKING_CAPTURE);
	zassert_equal(lane.state, PARKING_ASSISTANCE);
	zassert_equal(fake_cancel_fake.arg1_val, last_request.transaction);
	zassert_equal(lane.transaction, 0);
	zassert_equal(fake_motor_fake.arg1_val, PARKING_STOP);
	zassert_false(fake_signal_fake.arg1_val);
	zassert_true(fake_buzzer_fake.arg1_val);
}

ZTEST(parking_lane, test_authorization_queue_failure_cancels_without_opening)
{
	step(20, 682);
	uint32_t transaction = last_request.transaction;

	reply(PARKING_PLATE, transaction, 1);
	fake_request_fake.return_val = -ENOMSG;
	step(100, 682);
	zassert_equal(fake_request_fake.call_count, 2);
	zassert_equal(last_request.kind, PARKING_AUTHORIZE_ENTRY);
	zassert_equal(lane.state, PARKING_ASSISTANCE);
	zassert_equal(fake_cancel_fake.arg1_val, transaction);
	zassert_equal(fake_motor_fake.call_count, 1);
	zassert_equal(fake_motor_fake.arg1_val, PARKING_STOP);
}

ZTEST(parking_lane, test_only_first_matching_reply_is_used_before_deadline)
{
	step(20, 682);
	uint32_t transaction = last_request.transaction;
	struct parking_reply answer = {
		.kind = PARKING_PLATE, .lane = PARKING_EXIT, .transaction = transaction,
		.attempt = 1, .plate = "ABC1D23",
	};

	parking_lane_receive(&lane, &answer);
	answer.lane = PARKING_ENTRY;
	answer.plate[PARKING_PLATE_SIZE - 1] = 'X';
	parking_lane_receive(&lane, &answer);
	reply(PARKING_DENIED, transaction, 1);
	step(50, 682);
	zassert_equal(lane.state, PARKING_IDENTIFYING);
	zassert_equal(fake_request_fake.call_count, 1);

	reply(PARKING_PLATE, transaction, 1);
	reply(PARKING_NO_PLATE, transaction, 1);
	step(100, 682);
	zassert_equal(lane.state, PARKING_AUTHORIZING);
	zassert_equal(last_request.kind, PARKING_AUTHORIZE_ENTRY);
	reply(PARKING_ENTRY_ALLOWED, transaction, 1);
	step(150, 682);
	zassert_equal(fake_motor_fake.call_count, 0);

	reply(PARKING_ENTRY_ALLOWED, transaction, 0);
	step(1100, 682);
	zassert_equal(lane.state, PARKING_ASSISTANCE);
	zassert_equal(fake_motor_fake.call_count, 1);
	zassert_equal(fake_motor_fake.arg1_val, PARKING_STOP);
	zassert_equal(fake_cancel_fake.arg1_val, transaction);
}

ZTEST(parking_lane, test_invalid_and_future_distance_samples_do_not_start_capture)
{
	inputs.distance.valid = false;
	step(20, 682);
	zassert_equal(lane.state, PARKING_IDLE);
	zassert_equal(fake_request_fake.call_count, 0);

	inputs.distance.valid = true;
	inputs.distance.sampled_ms = 22;
	parking_lane_step(&lane, &inputs, &services, 21);
	zassert_equal(lane.state, PARKING_IDLE);
	zassert_equal(fake_request_fake.call_count, 0);

	parking_lane_step(&lane, &inputs, &services, 22);
	zassert_equal(lane.state, PARKING_IDENTIFYING);
	zassert_equal(fake_request_fake.call_count, 1);
}

ZTEST(parking_lane, test_open_command_error_immediately_orders_stop)
{
	step(20, 682);
	uint32_t transaction = last_request.transaction;
	reply(PARKING_PLATE, transaction, 1);
	step(100, 682);

	int motor_results[] = { -EIO, 0 };

	SET_RETURN_SEQ(fake_motor, motor_results, ARRAY_SIZE(motor_results));
	reply(PARKING_ENTRY_ALLOWED, transaction, 0);
	step(200, 682);
	zassert_equal(lane.state, PARKING_ASSISTANCE);
	zassert_true(lane.latched);
	zassert_equal(fake_motor_fake.call_count, 2);
	zassert_equal(fake_motor_fake.arg1_history[0], PARKING_OPEN);
	zassert_equal(fake_motor_fake.arg1_history[1], PARKING_STOP);
	zassert_equal(fake_signal_fake.call_count, 1);
	zassert_false(fake_signal_fake.arg1_val);
}

ZTEST(parking_lane, test_failed_green_switch_cancels_passage)
{
	begin_open(PARKING_ENTRY_ALLOWED);
	inputs.lower = false;
	inputs.upper = true;
	int signal_results[] = { -EIO, 0 };

	SET_RETURN_SEQ(fake_signal, signal_results, ARRAY_SIZE(signal_results));
	step(2200, 682);
	zassert_equal(lane.state, PARKING_ASSISTANCE);
	zassert_true(lane.latched);
	zassert_equal(fake_motor_fake.arg1_val, PARKING_STOP);
	zassert_equal(fake_signal_fake.call_count, 2);
	zassert_true(fake_signal_fake.arg1_history[0]);
	zassert_false(fake_signal_fake.arg1_history[1]);
	zassert_equal(fake_passage_fake.call_count, 0);
}

ZTEST(parking_lane, test_failed_red_switch_keeps_motor_off_and_retries_safe_outputs)
{
	begin_open(PARKING_ENTRY_ALLOWED);
	reach_upper();
	fake_signal_fake.return_val = -EIO;
	clear_passage();
	zassert_equal(fake_passage_fake.call_count, 1);
	zassert_equal(lane.state, PARKING_ASSISTANCE);
	zassert_true(lane.safe_outputs_pending);
	zassert_equal(fake_motor_fake.arg1_val, PARKING_STOP);
	zassert_equal(fake_cancel_fake.call_count, 0);

	fake_signal_fake.return_val = 0;
	step(2501, 1025);
	zassert_false(lane.safe_outputs_pending);
	zassert_true(lane.latched);
	zassert_equal(fake_motor_fake.arg1_val, PARKING_STOP);
	zassert_false(fake_signal_fake.arg1_val);
	zassert_equal(fake_passage_fake.call_count, 1);
}

ZTEST(parking_lane, test_buzzer_failure_latches_assistance_with_closed_barrier)
{
	step(20, 682);
	reply(PARKING_PLATE, last_request.transaction, 1);
	step(100, 682);

	int buzzer_results[] = { -EIO, -EIO, 0 };

	SET_RETURN_SEQ(fake_buzzer, buzzer_results, ARRAY_SIZE(buzzer_results));
	reply(PARKING_DENIED, last_request.transaction, 0);
	step(200, 682);
	zassert_equal(lane.state, PARKING_ASSISTANCE);
	zassert_true(lane.latched);
	zassert_equal(fake_buzzer_fake.arg0_history[0], PARKING_ENTRY);
	zassert_true(fake_buzzer_fake.arg1_history[0]);

	step(300, 1025);
	zassert_true(lane.buzz_on);
	zassert_equal(fake_buzzer_fake.call_count, 2);
	step(301, 1025);
	zassert_false(lane.buzz_on);
	zassert_equal(fake_buzzer_fake.call_count, 3);
	zassert_false(fake_buzzer_fake.arg1_val);
	zassert_equal(lane.state, PARKING_ASSISTANCE);
	zassert_equal(fake_motor_fake.arg1_val, PARKING_STOP);
}

ZTEST(parking_lane, test_beam_reappearing_after_passage_does_not_extend_deadline)
{
	begin_open(PARKING_ENTRY_ALLOWED);
	reach_upper();
	fake_motor_fake.return_val = -EAGAIN;
	clear_passage();
	zassert_equal(lane.state, PARKING_WAIT_CLEAR);
	unsigned int motor_calls = fake_motor_fake.call_count;

	inputs.beam = true;
	fake_motor_fake.return_val = 0;
	step(12199, 1025);
	zassert_equal(lane.state, PARKING_WAIT_CLEAR);
	zassert_equal(fake_motor_fake.call_count, motor_calls);

	step(12200, 1025);
	zassert_equal(lane.state, PARKING_ASSISTANCE);
	zassert_true(lane.latched);
	zassert_equal(fake_motor_fake.call_count, motor_calls + 1);
	zassert_equal(fake_motor_fake.arg1_val, PARKING_STOP);
	zassert_equal(fake_passage_fake.call_count, 1);
}
```

## src/test_parking.c
```c
#include <string.h>

#include <zephyr/fff.h>
#include <zephyr/ztest.h>

#include "parking.h"
#include "distance.h"
#include "gate.h"

FAKE_VALUE_FUNC(bool, distance_read, unsigned int, int64_t, uint16_t *);
FAKE_VALUE_FUNC(bool, distance_faulted);
FAKE_VALUE_FUNC(int, capture_start, enum parking_lane_id, int64_t);
FAKE_VOID_FUNC(capture_cancel, enum parking_lane_id);
FAKE_VALUE_FUNC(int, payment_start, const char *, int64_t);
FAKE_VALUE_FUNC(enum equipment_result, payment_poll, int64_t);
FAKE_VOID_FUNC(payment_cancel);
FAKE_VALUE_FUNC(int, motor_write, void *, enum gate_output, bool);

static uint16_t codes[PARKING_LANES];
static const char plate[PARKING_PLATE_SIZE] = "ABC1D23";

static bool read_code(unsigned int lane, int64_t now, uint16_t *code)
{
	ARG_UNUSED(now);
	*code = codes[lane];
	return true;
}

static enum equipment_result accept_plate(enum parking_lane_id lane, int64_t now,
					   char captured[PARKING_PLATE_SIZE])
{
	ARG_UNUSED(lane);
	ARG_UNUSED(now);
	memcpy(captured, plate, sizeof(plate));
	return EQUIPMENT_OK;
}

static const struct parking_equipment adapter = {
	.capture_start = capture_start,
	.capture_poll = accept_plate,
	.capture_cancel = capture_cancel,
	.payment_start = payment_start,
	.payment_poll = payment_poll,
	.payment_cancel = payment_cancel,
};

static void tick(enum parking_lane_id id, struct gate *gate, struct gate_inputs input,
		 uint16_t code, int64_t now)
{
	codes[id] = code;
	gate_step(gate, input, now);
	parking_step(id, gate, input, false, now);
}

ZTEST_SUITE(parking_flow, NULL, NULL, NULL, NULL, NULL);

ZTEST(parking_flow, test_passage_records_entry_and_paid_exit_frees_slot)
{
	struct gate entry = { .write = motor_write };
	struct gate exit_gate = { .write = motor_write };
	struct gate_inputs closed = { .lower = true };
	struct gate_inputs open = { .upper = true };
	struct gate_inputs beam = { .upper = true, .beam = true };

	distance_read_fake.custom_fake = read_code;
	parking_set_equipment(&adapter);

	tick(PARKING_ENTRY, &entry, closed, 682, 0);
	zassert_equal(capture_start_fake.call_count, 1);
	tick(PARKING_ENTRY, &entry, closed, 1025, 10);
	zassert_equal(capture_cancel_fake.call_count, 1);
	tick(PARKING_ENTRY, &entry, closed, 682, 20);
	tick(PARKING_ENTRY, &entry, closed, 682, 25);
	zassert_equal(entry.state, GATE_OPENING);
	tick(PARKING_ENTRY, &entry, open, 682, 2025);
	tick(PARKING_ENTRY, &entry, open, 1025, 2030);
	zassert_equal(entry.state, GATE_OPEN);
	tick(PARKING_ENTRY, &entry, beam, 1025, 2040);
	zassert_equal(entry.state, GATE_OPEN);
	tick(PARKING_ENTRY, &entry, open, 1025, 2050);
	zassert_equal(entry.state, GATE_CLOSING);

	tick(PARKING_EXIT, &exit_gate, closed, 682, 2060);
	tick(PARKING_EXIT, &exit_gate, closed, 682, 2070);
	zassert_equal(payment_start_fake.call_count, 1);
	zassert_mem_equal(payment_start_fake.arg0_val, plate, sizeof(plate));
	zassert_equal(payment_start_fake.arg1_val, 2050);
	tick(PARKING_EXIT, &exit_gate, closed, 682, 2080);
	zassert_equal(exit_gate.state, GATE_CLOSED);
	payment_poll_fake.return_val = EQUIPMENT_OK;
	tick(PARKING_EXIT, &exit_gate, closed, 682, 2090);
	zassert_equal(exit_gate.state, GATE_OPENING);
	tick(PARKING_EXIT, &exit_gate, open, 682, 4090);
	tick(PARKING_EXIT, &exit_gate, beam, 682, 4100);
	tick(PARKING_EXIT, &exit_gate, open, 1025, 4110);
	zassert_equal(exit_gate.state, GATE_CLOSING);

	tick(PARKING_ENTRY, &entry, closed, 1025, 4120);
	tick(PARKING_ENTRY, &entry, closed, 682, 4130);
	tick(PARKING_ENTRY, &entry, closed, 682, 4140);
	zassert_equal(entry.state, GATE_OPENING);
}
```
