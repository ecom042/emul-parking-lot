## CMakeLists.txt
```
# Suíte "logica": módulos puros (tarifa, sessões, montador de linhas,
# protocolos, fonte) e os que só usam hw.h (display, ADC), com hw.h falso.
cmake_minimum_required(VERSION 3.20.0)
list(APPEND BOARD_ROOT ${CMAKE_CURRENT_SOURCE_DIR}/../../../hardware)
list(APPEND DTS_ROOT ${CMAKE_CURRENT_SOURCE_DIR}/../../../hardware)
find_package(Zephyr REQUIRED HINTS $ENV{ZEPHYR_BASE})
project(parking_unit_logica)
target_include_directories(app PRIVATE ../../src)
target_sources(app PRIVATE
  src/fakes.c
  src/test_tariff.c
  src/test_sessions.c
  src/test_line_parser.c
  src/test_protocol.c
  src/test_display.c
  src/test_adc_sampler.c
  ../../src/tariff.c
  ../../src/sessions.c
  ../../src/line_parser.c
  ../../src/protocol.c
  ../../src/font.c
  ../../src/display.c
  ../../src/adc_sampler.c
)
```

## prj.conf
```kconfig
CONFIG_ZTEST=y
CONFIG_CONSOLE=y
CONFIG_UART_CONSOLE=y
CONFIG_PRINTK=y
CONFIG_SERIAL=y
CONFIG_PM=n
CONFIG_ZTEST_STACK_SIZE=4096
```

## src/fakes.c
```c
#include "fakes.h"

DEFINE_FFF_GLOBALS;

DEFINE_FAKE_VALUE_FUNC(int, hw_disp_reset, bool);
DEFINE_FAKE_VALUE_FUNC(int, hw_disp_write, bool, uint8_t *, size_t);
DEFINE_FAKE_VOID_FUNC(hw_sleep_ms, int32_t);
DEFINE_FAKE_VALUE_FUNC(int, hw_adc_start, enum lane_id);
DEFINE_FAKE_VALUE_FUNC(int, hw_adc_check, uint16_t *);

void fakes_reset(void)
{
	RESET_FAKE(hw_disp_reset);
	RESET_FAKE(hw_disp_write);
	RESET_FAKE(hw_sleep_ms);
	RESET_FAKE(hw_adc_start);
	RESET_FAKE(hw_adc_check);
	FFF_RESET_HISTORY();
}
```

## src/fakes.h
```c
/* Falsos do FFF para as funções de hw.h usadas por display.c e adc_sampler.c. */
#ifndef FAKES_H_
#define FAKES_H_

#include <zephyr/fff.h>

#include "hw.h"

DECLARE_FAKE_VALUE_FUNC(int, hw_disp_reset, bool);
DECLARE_FAKE_VALUE_FUNC(int, hw_disp_write, bool, uint8_t *, size_t);
DECLARE_FAKE_VOID_FUNC(hw_sleep_ms, int32_t);
DECLARE_FAKE_VALUE_FUNC(int, hw_adc_start, enum lane_id);
DECLARE_FAKE_VALUE_FUNC(int, hw_adc_check, uint16_t *);

/** Zera todos os falsos e o histórico. */
void fakes_reset(void);

#endif
```

## src/test_adc_sampler.c
```c
/* Escalonador do ADC4: uma conversão por vez, alternando, com prazo de 100 ms. */
#include <errno.h>

#include <zephyr/ztest.h>

#include "adc_sampler.h"
#include "fakes.h"

static uint16_t next_raw;
static int next_rc;

static int check_fake(uint16_t *raw)
{
	if (next_rc == 0) {
		*raw = next_raw;
	}
	return next_rc;
}

static void before(void *f)
{
	ARG_UNUSED(f);
	fakes_reset();
	adc_sampler_reset();
	hw_adc_check_fake.custom_fake = check_fake;
	next_raw = 0;
	next_rc = -EINPROGRESS;
}

ZTEST_SUITE(adc_sampler, NULL, NULL, before, NULL, NULL);

ZTEST(adc_sampler, test_alterna_canais)
{
	struct adc_sample s;

	/* 1a volta: dispara a entrada, sem amostra. */
	zassert_false(adc_sampler_poll(0, &s));
	zassert_equal(hw_adc_start_fake.call_count, 1);
	zassert_equal(hw_adc_start_fake.arg0_history[0], LANE_ENTRY);

	/* Pendente: nada novo e nenhum disparo a mais (uma por vez). */
	zassert_false(adc_sampler_poll(2, &s));
	zassert_equal(hw_adc_start_fake.call_count, 1);

	/* Terminou: entrega a amostra da entrada e dispara a saída. */
	next_rc = 0;
	next_raw = 546;
	zassert_true(adc_sampler_poll(4, &s));
	zassert_equal(s.lane, LANE_ENTRY);
	zassert_equal(s.code, 546);
	zassert_equal(hw_adc_start_fake.arg0_history[1], LANE_EXIT);

	next_raw = 4095;
	zassert_true(adc_sampler_poll(6, &s));
	zassert_equal(s.lane, LANE_EXIT);
	zassert_equal(s.code, 4095);
	zassert_false(adc_sampler_failed());
}

ZTEST(adc_sampler, test_prazo_de_100_ms)
{
	struct adc_sample s;

	adc_sampler_poll(1000, &s);
	zassert_false(adc_sampler_poll(1099, &s));
	zassert_false(adc_sampler_failed());
	zassert_false(adc_sampler_poll(1100, &s));
	zassert_true(adc_sampler_failed());
	/* Travada: uma conclusão atrasada não rearma nada. */
	next_rc = 0;
	zassert_false(adc_sampler_poll(1200, &s));
	zassert_equal(hw_adc_start_fake.call_count, 1);
}

ZTEST(adc_sampler, test_erro_do_driver_na_conclusao)
{
	struct adc_sample s;

	adc_sampler_poll(0, &s);
	next_rc = -EIO;
	zassert_false(adc_sampler_poll(2, &s));
	zassert_true(adc_sampler_failed());
}

ZTEST(adc_sampler, test_amostra_impossivel)
{
	struct adc_sample s;

	adc_sampler_poll(0, &s);
	next_rc = 0;
	next_raw = 4096;
	zassert_false(adc_sampler_poll(2, &s));
	zassert_true(adc_sampler_failed());
}

ZTEST(adc_sampler, test_erro_ao_disparar)
{
	struct adc_sample s;

	hw_adc_start_fake.return_val = -EBUSY;
	zassert_false(adc_sampler_poll(0, &s));
	zassert_true(adc_sampler_failed());
}

ZTEST(adc_sampler, test_erro_ao_disparar_depois_de_amostra)
{
	struct adc_sample s;

	adc_sampler_poll(0, &s);
	next_rc = 0;
	next_raw = 100;
	hw_adc_start_fake.return_val = -EIO;
	/* A amostra que terminou ainda é entregue; a falha vale dali em diante. */
	zassert_true(adc_sampler_poll(2, &s));
	zassert_equal(s.code, 100);
	zassert_true(adc_sampler_failed());
}
```

## src/test_display.c
```c
/*
 * Display: sequência de inicialização, tela de cobrança e erros de SPI.
 * hw_disp_write é falso: registramos os comandos (D/C baixo) enviados.
 */
#include <errno.h>
#include <string.h>

#include <zephyr/ztest.h>

#include "display.h"
#include "fakes.h"
#include "font.h"

/* Comandos enviados (bytes com D/C baixo), em ordem. */
static uint8_t cmds[64];
static size_t ncmds;
/* Falha na escrita número fail_at (1 = primeira); 0 = nunca falha. */
static int fail_at;
static int writes;
/* Algum pixel aceso (diferente de preto) foi enviado? */
static bool lit;

static int write_fake(bool data, uint8_t *buf, size_t len)
{
	writes++;
	if (fail_at != 0 && writes == fail_at) {
		return -EIO;
	}
	if (!data && ncmds < sizeof(cmds)) {
		cmds[ncmds++] = buf[0];
	}
	/* Só as linhas de pixels (240 x 2 bytes), não os parâmetros. */
	for (size_t i = 0; data && len == DISPLAY_WIDTH * 2 && i < len; i++) {
		lit = lit || buf[i] != 0;
	}
	return 0;
}

static void before(void *f)
{
	ARG_UNUSED(f);
	fakes_reset();
	hw_disp_write_fake.custom_fake = write_fake;
	ncmds = 0;
	fail_at = 0;
	writes = 0;
	lit = false;
}

ZTEST_SUITE(display, NULL, NULL, before, NULL, NULL);

ZTEST(display, test_inicializacao)
{
	static const uint8_t expected[] = {ST7789_SWRESET, ST7789_SLPOUT, ST7789_COLMOD,
					   ST7789_MADCTL,  ST7789_DISPON, ST7789_CASET,
					   ST7789_RASET,   ST7789_RAMWR};

	zassert_ok(display_init());
	/* Reset por hardware: ativo, depois solto. */
	zassert_equal(hw_disp_reset_fake.call_count, 2);
	zassert_true(hw_disp_reset_fake.arg0_history[0]);
	zassert_false(hw_disp_reset_fake.arg0_history[1]);
	/* Esperas da folha de dados: 10, 120, 150 e 120 ms. */
	zassert_equal(hw_sleep_ms_fake.call_count, 4);
	zassert_equal(hw_sleep_ms_fake.arg0_history[2], 150);
	zassert_equal(ncmds, sizeof(expected));
	zassert_mem_equal(cmds, expected, sizeof(expected));
	zassert_false(lit, "tela inicial preta");
}

ZTEST(display, test_inicializacao_falha_no_reset)
{
	hw_disp_reset_fake.return_val = -EIO;
	zassert_equal(display_init(), -EIO);
	zassert_equal(hw_disp_write_fake.call_count, 0, "nada depois da falha");
}

static int reset_fake(bool asserted)
{
	return asserted ? 0 : -EIO;
}

ZTEST(display, test_inicializacao_falha_ao_soltar_reset)
{
	hw_disp_reset_fake.custom_fake = reset_fake;
	zassert_equal(display_init(), -EIO);
	zassert_equal(hw_disp_write_fake.call_count, 0);
}

ZTEST(display, test_inicializacao_falha_em_cada_escrita)
{
	/*
	 * 12 escritas de comando/parâmetro (SWRESET, SLPOUT, COLMOD+1,
	 * MADCTL+1, DISPON, CASET+1, RASET+1, RAMWR) e então os pixels.
	 */
	for (int n = 1; n <= 13; n++) {
		before(NULL);
		fail_at = n;
		zassert_equal(display_init(), -EIO, "falha na escrita %d", n);
		zassert_equal(writes, n, "parou na primeira falha (%d)", n);
	}
}

ZTEST(display, test_tela_de_cobranca)
{
	zassert_ok(display_show_plate("ABC1D23"));
	zassert_true(lit);
	/* 4 faixas, cada uma com CASET, RASET, RAMWR. */
	zassert_equal(ncmds, 12);
	ncmds = 0;
	zassert_ok(display_show_amount(400));
	zassert_equal(ncmds, 9);
}

ZTEST(display, test_tela_de_cobranca_falhas)
{
	/*
	 * Cada faixa: 5 escritas de janela + uma por linha de pixels (24 na
	 * escala 3, 16 na escala 2). Falha na primeira escrita de cada faixa.
	 */
	static const int band_start[] = {1, 30, 59, 80};

	for (int n = 0; n < 4; n++) {
		before(NULL);
		fail_at = band_start[n];
		zassert_equal(display_show_plate("ABC1D23"), -EIO, "faixa %d", n);
		zassert_equal(writes, band_start[n]);
	}
	for (int n = 0; n < 3; n++) {
		before(NULL);
		fail_at = band_start[n];
		zassert_equal(display_show_amount(400), -EIO, "faixa %d", n);
		zassert_equal(writes, band_start[n]);
	}
}

ZTEST(display, test_janela_falha_em_raset_e_ramwr)
{
	fail_at = 3; /* CASET, parâmetros, RASET */
	zassert_equal(display_text_band(0, 2, "A", COLOR_WHITE), -EIO);
	before(NULL);
	fail_at = 5; /* ..., parâmetros do RASET, RAMWR */
	zassert_equal(display_text_band(0, 2, "A", COLOR_WHITE), -EIO);
}

ZTEST(display, test_texto_longo_e_cortado)
{
	/* 40 caracteres em escala 2 não cabem em 240 px: corta sem estourar. */
	zassert_ok(display_text_band(0, 2, "AAAAAAAAAAAAAAAAAAAAAAAAAAAAAAAAAAAAAAAA", COLOR_WHITE));
	zassert_true(lit);
}

ZTEST(display, test_formata_valor)
{
	char buf[16];

	zassert_equal(display_format_amount(buf, sizeof(buf), 400), 8);
	zassert_str_equal(buf, "BRL 4.00");
	zassert_true(display_format_amount(buf, sizeof(buf), 1000000) > 0);
	zassert_str_equal(buf, "BRL 10000.00");
	display_format_amount(buf, sizeof(buf), 205);
	zassert_str_equal(buf, "BRL 2.05");
	zassert_equal(display_format_amount(buf, 4, 400), -1);
}

ZTEST(display, test_fonte)
{
	static const uint8_t zero[FONT_HEIGHT] = {0x0e, 0x11, 0x13, 0x15, 0x19, 0x11, 0x0e};
	const uint8_t *blank = font_glyph(' ');

	zassert_mem_equal(font_glyph('0'), zero, FONT_HEIGHT);
	zassert_equal(font_glyph('.')[6], 0x0c);
	zassert_equal(font_glyph('Z')[0], 0x1f);
	zassert_equal(font_glyph('?'), blank, "desconhecido vira espaço");
	zassert_equal(font_glyph('a'), blank);
	zassert_equal(font_glyph('/'), blank);
	zassert_equal(font_glyph(':'), blank);
	zassert_equal(font_glyph('@'), blank);
	zassert_equal(font_glyph('['), blank);
}
```

## src/test_line_parser.c
```c
/* Montador de linhas: quadros completos, malformados, longos e atrasados. */
#include <string.h>

#include <zephyr/ztest.h>

#include "line_parser.h"

/** Entrega uma string inteira; devolve o resultado do último byte. */
static int feed(struct line_parser *lp, const char *s, int64_t now)
{
	int r = -1;

	for (size_t i = 0; s[i] != '\0'; i++) {
		r = line_parser_feed(lp, (uint8_t)s[i], now);
	}
	return r;
}

ZTEST_SUITE(line_parser, NULL, NULL, NULL, NULL, NULL);

ZTEST(line_parser, test_camera_crlf)
{
	struct line_parser lp;

	line_parser_init(&lp, LINE_CRLF);
	zassert_equal(feed(&lp, "OK\r\n", 0), 2);
	zassert_str_equal(lp.buf, "OK");
}

ZTEST(line_parser, test_fragmentos)
{
	struct line_parser lp;

	line_parser_init(&lp, LINE_CRLF);
	/* Pedaços de 8 bytes a cada 10 ms, como a câmera manda. */
	zassert_equal(feed(&lp, "+PLATE:1", 0), -1);
	zassert_equal(feed(&lp, ",\"ABC1D2", 10), -1);
	zassert_equal(feed(&lp, "3\",93\r\n", 20), 21);
	zassert_str_equal(lp.buf, "+PLATE:1,\"ABC1D23\",93");
}

ZTEST(line_parser, test_camera_sem_cr_e_cr_no_meio)
{
	struct line_parser lp;

	line_parser_init(&lp, LINE_CRLF);
	zassert_equal(feed(&lp, "OK\n", 0), -1);
	zassert_equal(feed(&lp, "O\rK\r\n", 0), -1);
	zassert_equal(feed(&lp, "\n", 0), -1, "linha vazia");
	zassert_equal(feed(&lp, "\r\n", 0), -1, "só CR LF");
	zassert_equal(feed(&lp, "OK\r\n", 0), 2, "volta a sincronizar");
}

ZTEST(line_parser, test_nao_imprimivel)
{
	struct line_parser lp;

	line_parser_init(&lp, LINE_LF);
	zassert_equal(feed(&lp, "P1 \x01X\n", 0), -1);
	zassert_equal(feed(&lp, "P1 \x7fX\n", 0), -1);
}

ZTEST(line_parser, test_terminal_lf_e_cr_proibido)
{
	struct line_parser lp;

	line_parser_init(&lp, LINE_LF);
	zassert_equal(feed(&lp, "P1 ERROR FRAME\n", 0), 14);
	zassert_equal(feed(&lp, "P1 ERROR FRAME\r\n", 0), -1);
}

ZTEST(line_parser, test_quadro_longo_descartado_ate_lf)
{
	struct line_parser lp;
	char longa[200];

	line_parser_init(&lp, LINE_LF);
	/* 127 bytes + LF = 128: ainda cabe. */
	memset(longa, 'A', 127);
	longa[127] = '\0';
	zassert_equal(feed(&lp, longa, 0), -1);
	zassert_equal(line_parser_feed(&lp, '\n', 0), 127);
	/* 128 bytes + LF = 129: descartado, mesmo terminando "bem". */
	memset(longa, 'A', 128);
	longa[128] = '\0';
	feed(&lp, longa, 0);
	zassert_equal(line_parser_feed(&lp, '\n', 0), -1);
	zassert_equal(feed(&lp, "OK\n", 0), 2, "a linha seguinte vale");
	/* Já descartando: o prazo de montagem não muda nada. */
	memset(longa, 'A', 150);
	longa[150] = '\0';
	feed(&lp, longa, 0);
	line_parser_poll(&lp, 5000);
	zassert_true(lp.discarding);
	zassert_equal(feed(&lp, "\nOK\n", 5000), 2);
}

ZTEST(line_parser, test_prazo_de_montagem)
{
	struct line_parser lp;

	line_parser_init(&lp, LINE_CRLF);
	feed(&lp, "+PLATE:1,", 100);
	line_parser_poll(&lp, 1099);
	zassert_false(lp.discarding, "ainda dentro de 1000 ms");
	line_parser_poll(&lp, 1100);
	zassert_true(lp.discarding);
	/* O resto da linha atrasada é descartado, inclusive o terminador. */
	zassert_equal(feed(&lp, "\"ABC1D23\",93\r\n", 1110), -1);
	zassert_equal(feed(&lp, "OK\r\n", 1120), 2);
	/* Sem linha começada, o prazo não faz nada. */
	line_parser_poll(&lp, 99999);
	zassert_false(lp.discarding);
}
```

## src/test_protocol.c
```c
/* Mensagens da câmera (AT) e do terminal (P1). */
#include <string.h>

#include <zephyr/ztest.h>

#include "protocol.h"

#define UUID_A "3f2a9c10-7b4e-4d21-9a6f-0c5e8b7d12c1"

ZTEST_SUITE(protocol, NULL, NULL, NULL, NULL, NULL);

ZTEST(protocol, test_placas)
{
	zassert_true(plate_is_valid("ABC1D23", 7));
	zassert_true(plate_is_valid("ABC1234", 7));
	zassert_false(plate_is_valid("ABC1D2", 6));
	zassert_false(plate_is_valid("aBC1D23", 7));
	zassert_false(plate_is_valid("A1C1D23", 7));
	zassert_false(plate_is_valid("AB11D23", 7));
	zassert_false(plate_is_valid("ABCAD23", 7));
	zassert_false(plate_is_valid("ABC1-23", 7));
	zassert_false(plate_is_valid("ABC1DX3", 7));
	zassert_false(plate_is_valid("ABC1D2X", 7));
}

ZTEST(protocol, test_uuid)
{
	zassert_true(uuid_is_valid(UUID_A, 36));
	zassert_false(uuid_is_valid(UUID_A, 35));
	zassert_false(uuid_is_valid("3F2A9C10-7b4e-4d21-9a6f-0c5e8b7d12c1", 36));
	zassert_false(uuid_is_valid("3f2a9c10x7b4e-4d21-9a6f-0c5e8b7d12c1", 36));
	zassert_false(uuid_is_valid("3f2a9c1-07b4e-4d21-9a6f-0c5e8b7d12c1", 36));
}

ZTEST(protocol, test_decimal_canonico)
{
	uint32_t v = 0;

	zassert_true(parse_canonical_u32("0", 1, 0, 100, &v));
	zassert_equal(v, 0);
	zassert_true(parse_canonical_u32("100", 3, 0, 100, &v));
	zassert_false(parse_canonical_u32("101", 3, 0, 100, &v));
	zassert_false(parse_canonical_u32("0", 1, 1, 100, &v));
	zassert_false(parse_canonical_u32("07", 2, 0, 100, &v), "zero à esquerda");
	zassert_false(parse_canonical_u32("", 0, 0, 100, &v));
	zassert_false(parse_canonical_u32("1234567890", 10, 0, CAPTURE_ID_MAX, &v));
	zassert_false(parse_canonical_u32("1a", 2, 0, 100, &v));
	zassert_false(parse_canonical_u32("-1", 2, 0, 100, &v));
}

ZTEST(protocol, test_formata_captura)
{
	char buf[32];

	zassert_equal(camera_format_capture(buf, sizeof(buf), 17), 15);
	zassert_str_equal(buf, "AT+CAPTURE=17\r\n");
	zassert_equal(camera_format_capture(buf, 5, 17), -1, "não cabe");
}

ZTEST(protocol, test_placa_valida)
{
	struct plate_result r;

	zassert_ok(camera_parse_plate("+PLATE:17,\"ABC1D23\",93", &r));
	zassert_equal(r.capture_id, 17);
	zassert_str_equal(r.plate, "ABC1D23");
	zassert_equal(r.confidence, 93);
	zassert_ok(camera_parse_plate("+PLATE:1,\"ABC1234\",0", &r));
	zassert_equal(r.confidence, 0);
}

ZTEST(protocol, test_placa_malformada)
{
	struct plate_result r = {.capture_id = 5};
	const char *const bad[] = {
		"OK",
		"ERROR",
		"+PLATE:17",
		"+PLATE:17,ABC1D23,93",
		"+PLATE:17,\"ABC1D2\",93",
		"+PLATE:17,\"ABC1D23\"93",
		"+PLATE:017,\"ABC1D23\",93",
		"+PLATE:0,\"ABC1D23\",93",
		"+PLATE:17,\"abc1d23\",93",
		"+PLATE:17,\"ABC1D23\",101",
		"+PLATE:17,\"ABC1D23\",",
		"+PLATE:17,\"ABC1D23\",9 3",
		"+PLATE:17,\"AB",
	};

	for (size_t i = 0; i < ARRAY_SIZE(bad); i++) {
		zassert_equal(camera_parse_plate(bad[i], &r), -1, "%s", bad[i]);
	}
	zassert_equal(r.capture_id, 5, "saída intocada");
}

ZTEST(protocol, test_cobranca_e_cancelamento)
{
	char buf[128];

	zassert_true(payment_format_charge(buf, sizeof(buf), UUID_A, "ABC1D23", 400) > 0);
	zassert_str_equal(buf, "P1 CHARGE " UUID_A " ABC1D23 400 BRL\n");
	zassert_true(payment_format_cancel(buf, sizeof(buf), UUID_A) > 0);
	zassert_str_equal(buf, "P1 CANCEL " UUID_A "\n");
	zassert_equal(payment_format_charge(buf, 10, UUID_A, "ABC1D23", 400), -1);
}

ZTEST(protocol, test_uuid_gerado_e_valido_e_unico)
{
	char a[UUID_LEN + 1];
	char b[UUID_LEN + 1];

	uuid_make(a, 1, 5000);
	uuid_make(b, 2, 5000);
	zassert_true(uuid_is_valid(a, strlen(a)));
	zassert_true(uuid_is_valid(b, strlen(b)));
	zassert_true(strcmp(a, b) != 0);
}

ZTEST(protocol, test_resultado_valido)
{
	struct payment_result r;

	zassert_ok(payment_parse_result("P1 RESULT " UUID_A " PAID 400 BRL", &r));
	zassert_str_equal(r.uuid, UUID_A);
	zassert_equal(r.status, PAYMENT_PAID);
	zassert_equal(r.amount, 400);
	zassert_ok(payment_parse_result("P1 RESULT " UUID_A " CANCELLED 400 BRL", &r));
	zassert_equal(r.status, PAYMENT_CANCELLED);
}

ZTEST(protocol, test_resultado_malformado)
{
	struct payment_result r;
	const char *const bad[] = {
		"P1 RESULT " UUID_A " PAID broken BRL", /* falha MALFORMED do modelo */
		"P1 RESULT " UUID_A " PAID 400 USD",
		"P1 RESULT " UUID_A " PAID 0400 BRL",
		"P1 RESULT " UUID_A " PAID 0 BRL",
		"P1 RESULT " UUID_A " PAID 1000001 BRL",
		"P1 RESULT " UUID_A " REFUSED 400 BRL",
		"P1 RESULT " UUID_A "  PAID 400 BRL",
		"P1 RESULT " UUID_A " PAID 400 BRL extra",
		"P1 RESULT " UUID_A " PAID 400",
		"P2 RESULT " UUID_A " PAID 400 BRL",
		"P1 RESUME " UUID_A " PAID 400 BRL",
		"P1 RESULT 3F2A9C10-7B4E-4D21-9A6F-0C5E8B7D12C1 PAID 400 BRL",
		"P1 ERROR TIMEOUT",
	};

	for (size_t i = 0; i < ARRAY_SIZE(bad); i++) {
		zassert_equal(payment_parse_result(bad[i], &r), -1, "%s", bad[i]);
	}
}
```

## src/test_sessions.c
```c
/* Tabela de sessões compartilhada pelas duas faixas. */
#include <errno.h>
#include <stdio.h>

#include <zephyr/ztest.h>

#include "sessions.h"

static void before(void *f)
{
	ARG_UNUSED(f);
	sessions_reset();
}

ZTEST_SUITE(sessions, NULL, NULL, before, NULL, NULL);

ZTEST(sessions, test_entra_e_sai)
{
	int64_t t = 0;

	zassert_false(sessions_contains("ABC1D23"));
	zassert_ok(sessions_add("ABC1D23", 1234));
	zassert_true(sessions_contains("ABC1D23"));
	zassert_equal(sessions_count(), 1);
	zassert_ok(sessions_entry_time("ABC1D23", &t));
	zassert_equal(t, 1234);
	zassert_ok(sessions_remove("ABC1D23"));
	zassert_false(sessions_contains("ABC1D23"));
	zassert_equal(sessions_count(), 0);
}

ZTEST(sessions, test_placa_repetida)
{
	zassert_ok(sessions_add("ABC1D23", 0));
	zassert_equal(sessions_add("ABC1D23", 5), -EEXIST);
	zassert_equal(sessions_count(), 1);
}

ZTEST(sessions, test_lotado)
{
	char plate[8];

	for (int i = 0; i < CONFIG_PARKING_CAPACITY; i++) {
		zassert_true(sessions_has_space());
		snprintf(plate, sizeof(plate), "AAA%04d", i);
		zassert_ok(sessions_add(plate, i));
	}
	zassert_false(sessions_has_space());
	zassert_equal(sessions_add("ZZZ9Z99", 0), -ENOSPC);
	/* Liberar uma vaga permite entrar de novo. */
	zassert_ok(sessions_remove("AAA0000"));
	zassert_true(sessions_has_space());
	zassert_ok(sessions_add("ZZZ9Z99", 0));
}

ZTEST(sessions, test_placa_sem_sessao)
{
	int64_t t = 99;

	zassert_equal(sessions_entry_time("ABC1D23", &t), -ENOENT);
	zassert_equal(t, 99);
	zassert_equal(sessions_remove("ABC1D23"), -ENOENT);
}
```

## src/test_tariff.c
```c
/* Tarifa: 200 + (unidades - 1) * 100, unidades = max(1, ceil(t / u)). */
#include <errno.h>

#include <zephyr/ztest.h>

#include "tariff.h"

ZTEST_SUITE(tariff, NULL, NULL, NULL, NULL, NULL);

ZTEST(tariff, test_exemplo_do_enunciado)
{
	uint32_t v = 0;

	/* 2,5 s com unidade de 1 s = 3 unidades = 400 centavos (BRL 4.00). */
	zassert_ok(tariff_amount(2500, 1000, &v));
	zassert_equal(v, 400);
}

ZTEST(tariff, test_minimo_uma_unidade)
{
	uint32_t v = 0;

	zassert_ok(tariff_amount(0, 60000, &v));
	zassert_equal(v, 200);
}

ZTEST(tariff, test_limite_da_unidade)
{
	uint32_t v = 0;

	/* Exemplo da especificação: 60000 ms custa 200, 60001 ms custa 300. */
	zassert_ok(tariff_amount(60000, 60000, &v));
	zassert_equal(v, 200);
	zassert_ok(tariff_amount(60001, 60000, &v));
	zassert_equal(v, 300);
}

ZTEST(tariff, test_maior_valor_e_estouro)
{
	uint32_t v = 0;

	zassert_ok(tariff_amount(9999LL * 1000, 1000, &v));
	zassert_equal(v, 1000000);
	v = 7;
	zassert_equal(tariff_amount(9999LL * 1000 + 1, 1000, &v), -ERANGE);
	zassert_equal(v, 7, "valor não pode mudar no erro");
}

ZTEST(tariff, test_argumentos_invalidos)
{
	uint32_t v = 0;

	zassert_equal(tariff_amount(1000, 0, &v), -EINVAL);
	zassert_equal(tariff_amount(-1, 1000, &v), -EINVAL);
}
```
