## CMakeLists.txt
```
# Suite ztest + FFF do display de pagamento (st7789.c) e da fonte (font.c).
# Compila o st7789.c real com src/shim.h incluido a forca: o shim inclui os
# headers dos drivers e redireciona spi_*_dt e gpio_*_dt para falsos do FFF
# (src/fakes.c), que registram o que passaria pelo barramento SPI. O kernel
# (k_msgq, k_thread, k_msleep) e o real.
cmake_minimum_required(VERSION 3.20.0)
list(APPEND BOARD_ROOT ${CMAKE_CURRENT_SOURCE_DIR}/../../../hardware)
list(APPEND DTS_ROOT ${CMAKE_CURRENT_SOURCE_DIR}/../../../hardware)
find_package(Zephyr REQUIRED HINTS $ENV{ZEPHYR_BASE})
project(parking_test_st7789)
target_include_directories(app PRIVATE ../../src src)
target_sources(app PRIVATE src/fakes.c src/test_st7789.c src/test_font.c)
target_sources(app PRIVATE
	../../src/st7789.c
	../../src/font.c
)
set_source_files_properties(../../src/st7789.c PROPERTIES
	COMPILE_OPTIONS "-include;${CMAKE_CURRENT_SOURCE_DIR}/src/shim.h")
```

## prj.conf
```kconfig
CONFIG_ZTEST=y
CONFIG_CONSOLE=y
CONFIG_UART_CONSOLE=y
CONFIG_PRINTK=y
CONFIG_SERIAL=y
CONFIG_GPIO=y
CONFIG_SPI=y
CONFIG_PM=n
CONFIG_ZTEST_STACK_SIZE=2048
# O ultimo teste acha a thread "display" por nome (k_thread_foreach) para
# encerra-la e recriar com st7789_start(), como num boot novo.
CONFIG_THREAD_NAME=y
CONFIG_THREAD_MONITOR=y
```

## src/fakes.c
```c
/* SPDX-License-Identifier: Apache-2.0 */
#include <string.h>

#include "fakes.h"

DEFINE_FFF_GLOBALS;

DEFINE_FAKE_VALUE_FUNC(bool, fake_spi_is_ready_dt, const struct spi_dt_spec *);
DEFINE_FAKE_VALUE_FUNC(int, fake_spi_write_dt, const struct spi_dt_spec *,
		       const struct spi_buf_set *);
DEFINE_FAKE_VALUE_FUNC(bool, fake_gpio_is_ready_dt, const struct gpio_dt_spec *);
DEFINE_FAKE_VALUE_FUNC(int, fake_gpio_pin_configure_dt, const struct gpio_dt_spec *,
		       gpio_flags_t);
DEFINE_FAKE_VALUE_FUNC(int, fake_gpio_pin_set_dt, const struct gpio_dt_spec *, int);

#define DISPLAY DT_ALIAS(payment_display)

#define CMD_CASET 0x2a
#define CMD_RASET 0x2b
#define CMD_RAMWR 0x2c

const struct gpio_dt_spec pino_ref[PINO_COUNT] = {
	[PINO_DC] = GPIO_DT_SPEC_GET(DISPLAY, dc_gpios),
	[PINO_RESET] = GPIO_DT_SPEC_GET(DISPLAY, reset_gpios),
};

static const struct spi_dt_spec spi_ref =
	SPI_DT_SPEC_GET(DISPLAY, SPI_OP_MODE_CONTROLLER | SPI_WORD_SET(8));

struct barramento bus;

static bool spi_ok;
static int falha_n;
static int falha_rc;
static bool pronto[PINO_COUNT];
static int erro_config[PINO_COUNT];

/* Estado do decodificador: ultimo comando e o pixel corrente da janela. */
static int ultimo_cmd;
static int caset = -1;
static int raset = -1;
static uint32_t pixel;
static uint8_t meio_pixel;
static bool tem_meio;

void spi_falha_na_escrita(int n, int rc)
{
	falha_n = n;
	falha_rc = rc;
}

void spi_pronto(bool p)
{
	spi_ok = p;
}

void pino_pronto(enum pino_disp p, bool sim)
{
	pronto[p] = sim;
}

void pino_erro_config(enum pino_disp p, int rc)
{
	erro_config[p] = rc;
}

bool pino_e(const struct gpio_dt_spec *spec, enum pino_disp p)
{
	return spec->port == pino_ref[p].port && spec->pin == pino_ref[p].pin;
}

/* Indice do pino do display, ou PINO_COUNT (e conta como spec errado). */
static enum pino_disp achar(const struct gpio_dt_spec *spec)
{
	for (int p = 0; p < PINO_COUNT; p++) {
		if (pino_e(spec, p)) {
			return p;
		}
	}
	bus.spec_errado++;
	return PINO_COUNT;
}

static uint16_t coord(const struct cmd_reg *c, int alto, int baixo)
{
	return (uint16_t)((c->dados[alto] << 8) | c->dados[baixo]);
}

static void abre_janela(void)
{
	struct janela_reg *j;
	uint16_t h;

	if (bus.n_jan >= MAX_JANELAS || caset < 0 || raset < 0) {
		bus.estouro++;
		return;
	}
	j = &bus.jan[bus.n_jan++];
	memset(j, 0, sizeof(*j));
	j->x0 = coord(&bus.cmds[caset], 0, 1);
	j->x1 = coord(&bus.cmds[caset], 2, 3);
	j->y0 = coord(&bus.cmds[raset], 0, 1);
	j->y1 = coord(&bus.cmds[raset], 2, 3);
	h = (uint16_t)(j->y1 - j->y0 + 1);
	j->escala = (h % 7 == 0) ? (uint8_t)(h / 7) : 0;
	pixel = 0;
	tem_meio = false;
}

static void recebe_pixel(struct janela_reg *j, uint16_t cor)
{
	uint32_t w = (uint32_t)(j->x1 - j->x0 + 1);
	uint32_t h = (uint32_t)(j->y1 - j->y0 + 1);
	uint32_t x = pixel % w;
	uint32_t y = pixel / w;

	pixel++;
	if (y >= h) {
		j->excesso++;
		return;
	}
	if (cor == 0x0000) {
		return;
	}
	if (cor != 0xffff) {
		j->outros++;
		return;
	}
	j->acesos++;
	if (j->escala != 0 && x % j->escala == 0 && y % j->escala == 0 &&
	    x / j->escala < ST7789_WIDTH) {
		j->col[x / j->escala] |= (uint8_t)(1U << (y / j->escala));
	}
}

static void recebe_dado(uint8_t b)
{
	struct cmd_reg *c;
	struct janela_reg *j;

	if (bus.n_cmds == 0) {
		bus.dados_soltos++;
		return;
	}
	if (ultimo_cmd == CMD_RAMWR) {
		if (bus.n_jan == 0) {
			return;
		}
		j = &bus.jan[bus.n_jan - 1];
		j->bytes++;
		if (tem_meio) {
			recebe_pixel(j, (uint16_t)((meio_pixel << 8) | b));
		} else {
			meio_pixel = b;
		}
		tem_meio = !tem_meio;
		return;
	}
	c = &bus.cmds[bus.n_cmds - 1];
	if (c->n < sizeof(c->dados)) {
		c->dados[c->n] = b;
	}
	c->n++;
}

static void recebe_cmd(uint8_t b)
{
	if (bus.n_cmds >= MAX_CMDS) {
		bus.estouro++;
		return;
	}
	memset(&bus.cmds[bus.n_cmds], 0, sizeof(bus.cmds[0]));
	bus.cmds[bus.n_cmds].cmd = b;
	if (b == CMD_CASET) {
		caset = bus.n_cmds;
	} else if (b == CMD_RASET) {
		raset = bus.n_cmds;
	}
	bus.n_cmds++;
	ultimo_cmd = b;
	if (b == CMD_RAMWR) {
		abre_janela();
	}
}

static int write_custom(const struct spi_dt_spec *spec, const struct spi_buf_set *set)
{
	bus.escritas++;
	if (spec->bus != spi_ref.bus || spec->config.slave != spi_ref.config.slave ||
	    spec->config.operation != spi_ref.config.operation) {
		bus.spec_errado++;
	}
	if (falha_n != 0 && bus.escritas == falha_n) {
		return falha_rc;
	}
	for (size_t i = 0; i < set->count; i++) {
		const uint8_t *p = set->buffers[i].buf;

		for (size_t k = 0; k < set->buffers[i].len; k++) {
			if (bus.dc == 0) {
				recebe_cmd(p[k]);
			} else {
				recebe_dado(p[k]);
			}
		}
	}
	return 0;
}

static bool spi_ready_custom(const struct spi_dt_spec *spec)
{
	if (spec->bus != spi_ref.bus) {
		bus.spec_errado++;
	}
	return spi_ok;
}

static bool gpio_ready_custom(const struct gpio_dt_spec *spec)
{
	enum pino_disp p = achar(spec);

	return p < PINO_COUNT && pronto[p];
}

static int configure_custom(const struct gpio_dt_spec *spec, gpio_flags_t flags)
{
	enum pino_disp p = achar(spec);

	ARG_UNUSED(flags);
	return p < PINO_COUNT ? erro_config[p] : -EINVAL;
}

static int set_custom(const struct gpio_dt_spec *spec, int value)
{
	enum pino_disp p = achar(spec);

	if (p == PINO_DC) {
		bus.dc = value;
	} else if (p == PINO_RESET) {
		if (bus.n_reset < MAX_RESET) {
			bus.reset_nivel[bus.n_reset] = value;
		}
		bus.n_reset++;
	}
	return 0;
}

void fakes_reset(void)
{
	RESET_FAKE(fake_spi_is_ready_dt);
	RESET_FAKE(fake_spi_write_dt);
	RESET_FAKE(fake_gpio_is_ready_dt);
	RESET_FAKE(fake_gpio_pin_configure_dt);
	RESET_FAKE(fake_gpio_pin_set_dt);
	FFF_RESET_HISTORY();
	fake_spi_is_ready_dt_fake.custom_fake = spi_ready_custom;
	fake_spi_write_dt_fake.custom_fake = write_custom;
	fake_gpio_is_ready_dt_fake.custom_fake = gpio_ready_custom;
	fake_gpio_pin_configure_dt_fake.custom_fake = configure_custom;
	fake_gpio_pin_set_dt_fake.custom_fake = set_custom;

	memset(&bus, 0, sizeof(bus));
	bus.dc = -1;
	spi_ok = true;
	falha_n = 0;
	falha_rc = 0;
	for (int p = 0; p < PINO_COUNT; p++) {
		pronto[p] = true;
		erro_config[p] = 0;
	}
	ultimo_cmd = -1;
	caset = -1;
	raset = -1;
	pixel = 0;
	tem_meio = false;
}
```

## src/fakes.h
```c
/* SPDX-License-Identifier: Apache-2.0 */
/*
 * Falsos do FFF para os drivers usados por st7789.c (SPI e os pinos D/C e
 * reset) e um registro do que passaria pelo barramento: cada byte escrito com
 * D/C baixo e um comando, com D/C alto e parametro do ultimo comando ou, depois
 * de RAMWR, pixel da janela aberta por CASET/RASET.
 *
 * Os falsos rodam na thread do display: so registram, nunca chamam zassert.
 * Os testes conferem o registro depois de dar tempo a thread.
 */
#ifndef TEST_ST7789_FAKES_H_
#define TEST_ST7789_FAKES_H_

#include <stdbool.h>
#include <stdint.h>

#include <zephyr/drivers/gpio.h>
#include <zephyr/drivers/spi.h>
#include <zephyr/fff.h>

#include "st7789.h"

DECLARE_FAKE_VALUE_FUNC(bool, fake_spi_is_ready_dt, const struct spi_dt_spec *);
DECLARE_FAKE_VALUE_FUNC(int, fake_spi_write_dt, const struct spi_dt_spec *,
			const struct spi_buf_set *);
DECLARE_FAKE_VALUE_FUNC(bool, fake_gpio_is_ready_dt, const struct gpio_dt_spec *);
DECLARE_FAKE_VALUE_FUNC(int, fake_gpio_pin_configure_dt, const struct gpio_dt_spec *,
			gpio_flags_t);
DECLARE_FAKE_VALUE_FUNC(int, fake_gpio_pin_set_dt, const struct gpio_dt_spec *, int);

/** Pinos do display, na ordem de pino_ref. */
enum pino_disp {
	PINO_DC,
	PINO_RESET,
	PINO_COUNT,
};

/** Specs de referencia, montados pelo mesmo alias do devicetree. */
extern const struct gpio_dt_spec pino_ref[PINO_COUNT];

#define MAX_CMDS    32
#define MAX_JANELAS 8
#define MAX_RESET   8

/** Um comando e os primeiros parametros dele. */
struct cmd_reg {
	uint8_t cmd;
	uint8_t dados[4];
	uint8_t n; /* total de bytes de parametro recebidos */
};

/** Uma janela aberta por RAMWR e os pixels escritos nela. */
struct janela_reg {
	uint16_t x0;
	uint16_t x1;
	uint16_t y0;
	uint16_t y1;
	uint8_t escala;   /* altura / 7 (0 se a altura nao for multipla de 7) */
	uint32_t bytes;   /* bytes de pixel recebidos */
	uint32_t acesos;  /* pixels 0xffff */
	uint32_t outros;  /* pixels que nao sao 0x0000 nem 0xffff */
	uint32_t excesso; /* pixels alem de largura x altura */
	/* Pixel do canto de cada bloco escala x escala, por coluna: bit r e a
	 * linha r do glifo, como em font.c.
	 */
	uint8_t col[ST7789_WIDTH];
};

/** Tudo o que os falsos viram desde o ultimo fakes_reset(). */
struct barramento {
	struct cmd_reg cmds[MAX_CMDS];
	int n_cmds;
	struct janela_reg jan[MAX_JANELAS];
	int n_jan;
	int escritas;        /* chamadas a spi_write_dt, inclusive as que falharam */
	int dados_soltos;    /* bytes com D/C alto sem comando antes */
	int estouro;         /* comandos ou janelas alem do registro */
	int spec_errado;     /* spi_dt_spec ou pino que nao e do display */
	int reset_nivel[MAX_RESET];
	int n_reset;
	int dc;              /* ultimo nivel escrito em D/C (-1: nenhum) */
};

extern struct barramento bus;

/** Faz a @p n -esima escrita SPI (contando de 1 desde o reset) devolver @p rc. */
void spi_falha_na_escrita(int n, int rc);

/** Valor devolvido por spi_is_ready_dt. */
void spi_pronto(bool pronto);

/** Valor devolvido por gpio_is_ready_dt para o pino @p p. */
void pino_pronto(enum pino_disp p, bool pronto);

/** Valor devolvido por gpio_pin_configure_dt para o pino @p p. */
void pino_erro_config(enum pino_disp p, int rc);

/** true se @p spec e o pino @p p do display. */
bool pino_e(const struct gpio_dt_spec *spec, enum pino_disp p);

/** Volta tudo ao padrao: drivers prontos, sem erros, registro vazio. */
void fakes_reset(void);

#endif /* TEST_ST7789_FAKES_H_ */
```

## src/shim.h
```c
/* SPDX-License-Identifier: Apache-2.0 */
/*
 * Incluido a forca antes de st7789.c (veja CMakeLists.txt). Primeiro inclui
 * os headers reais que st7789.c usa; como eles tem include guard, a inclusao
 * dentro de st7789.c nao muda nada. Depois redireciona as chamadas de driver
 * para os falsos do FFF. A logica de st7789.c nao muda.
 */
#ifndef TEST_ST7789_SHIM_H_
#define TEST_ST7789_SHIM_H_

#include <zephyr/device.h>
#include <zephyr/drivers/gpio.h>
#include <zephyr/drivers/spi.h>
#include <zephyr/kernel.h>

#include "fakes.h"

#define spi_is_ready_dt       fake_spi_is_ready_dt
#define spi_write_dt          fake_spi_write_dt
#define gpio_is_ready_dt      fake_gpio_is_ready_dt
#define gpio_pin_configure_dt fake_gpio_pin_configure_dt
#define gpio_pin_set_dt       fake_gpio_pin_set_dt

#endif /* TEST_ST7789_SHIM_H_ */
```

## src/test_font.c
```c
/* SPDX-License-Identifier: Apache-2.0 */
/*
 * Fonte 5x7 (font.c): os caracteres da tabela tem glifo, os outros nao.
 */
#include <string.h>

#include <zephyr/ztest.h>

#include "font.h"

static const char tabela[] = " ABCDEFGHIJKLMNOPQRSTUVWXYZ0123456789.-";

ZTEST_SUITE(font, NULL, NULL, NULL, NULL, NULL);

static void confere_glifo(char c, const uint8_t esperado[FONT_COLS])
{
	const uint8_t *g = font_glyph(c);

	zassert_not_null(g, "'%c' sem glifo", c);
	zassert_mem_equal(g, esperado, FONT_COLS, "glifo de '%c' errado", c);
}

ZTEST(font, test_glifos_conferidos_a_mao)
{
	static const uint8_t espaco[FONT_COLS] = { 0x00, 0x00, 0x00, 0x00, 0x00 };
	static const uint8_t a[FONT_COLS] = { 0x7e, 0x09, 0x09, 0x09, 0x7e };
	static const uint8_t z[FONT_COLS] = { 0x61, 0x51, 0x49, 0x45, 0x43 };
	static const uint8_t zero[FONT_COLS] = { 0x3e, 0x51, 0x49, 0x45, 0x3e };
	static const uint8_t nove[FONT_COLS] = { 0x06, 0x49, 0x49, 0x29, 0x1e };
	static const uint8_t ponto[FONT_COLS] = { 0x00, 0x00, 0x60, 0x60, 0x00 };
	static const uint8_t hifen[FONT_COLS] = { 0x00, 0x08, 0x08, 0x08, 0x00 };

	confere_glifo(' ', espaco);
	confere_glifo('A', a);
	confere_glifo('Z', z);
	confere_glifo('0', zero);
	confere_glifo('9', nove);
	confere_glifo('.', ponto);
	confere_glifo('-', hifen);
}

ZTEST(font, test_toda_a_tabela_tem_glifo_proprio_de_sete_linhas)
{
	for (size_t i = 0; i < sizeof(tabela) - 1; i++) {
		const uint8_t *g = font_glyph(tabela[i]);

		zassert_not_null(g, "'%c' sem glifo", tabela[i]);
		for (int col = 0; col < FONT_COLS; col++) {
			zassert_equal(g[col] & 0x80, 0, "'%c' usa a oitava linha",
				      tabela[i]);
		}
		/* Dois caracteres diferentes nunca tem o mesmo desenho. */
		for (size_t k = 0; k < i; k++) {
			zassert_true(memcmp(g, font_glyph(tabela[k]), FONT_COLS) != 0,
				     "'%c' e '%c' iguais", tabela[i], tabela[k]);
		}
	}
}

ZTEST(font, test_caracteres_fora_da_tabela_nao_tem_glifo)
{
	/* Vizinhos de cada faixa da tabela, minusculas, controle e bytes com o
	 * bit 7 ligado (char negativo).
	 */
	static const char fora[] = {
		'\0', '\n', '!', '+', ',', '/', ':', '@', '[', '`',
		'a', 'z', '{', '\x7f', (char)0x80, (char)0xc3, (char)0xff,
	};

	for (size_t i = 0; i < sizeof(fora); i++) {
		zassert_is_null(font_glyph(fora[i]), "0x%02x tem glifo",
				(unsigned int)(uint8_t)fora[i]);
	}
}
```

## src/test_st7789.c
```c
/* SPDX-License-Identifier: Apache-2.0 */
/*
 * Display de pagamento (st7789.c) com SPI e pinos falsos (FFF). A thread do
 * display e a real: os testes enfileiram pedidos, dormem para ela trabalhar e
 * conferem o que os falsos registraram no barramento (veja fakes.h) e os
 * numeros publicados por st7789_done() e st7789_failed().
 *
 * A thread e o estado do modulo sao estaticos: por isso os testes tem numero
 * no nome (o ztest os roda em ordem alfabetica). O 00 cria a thread com o SPI
 * fora do ar, entao a inicializacao do boot falha; de 02 a 13 cada pedido
 * tenta de novo e falha de um jeito; o 14 inicializa; dali em diante so se
 * desenha. O ultimo teste recria a thread com os drivers prontos para ver a
 * inicializacao do boot dar certo.
 */
#include <errno.h>
#include <stdio.h>
#include <string.h>

#include <zephyr/kernel.h>
#include <zephyr/ztest.h>

#include "fakes.h"
#include "font.h"
#include "st7789.h"

#define CMD_SWRESET 0x01
#define CMD_SLPOUT  0x11
#define CMD_DISPON  0x29
#define CMD_CASET   0x2a
#define CMD_RASET   0x2b
#define CMD_RAMWR   0x2c
#define CMD_COLMOD  0x3a
#define CMD_MADCTL  0x36

#define FILA 4 /* FILA_DISPLAY em st7789.c */

/* Escritas SPI da inicializacao: SWRESET, SLPOUT, COLMOD + 0x55,
 * MADCTL + 0x00, DISPON.
 */
#define ESCRITAS_INIT 7

/* Escritas de um texto: CASET + dados, RASET + dados, RAMWR, e uma por linha
 * de pixels (7 linhas do glifo, cada uma repetida escala vezes).
 */
#define ESCRITAS_TEXTO(escala) (5 + FONT_ROWS * (escala))

/* Ultimo numero de pedido devolvido pelo modulo e ultimo que falhou. */
static uint32_t emitidos;
static uint32_t ultima_falha;

static void preparar(void *fixture)
{
	ARG_UNUSED(fixture);
	fakes_reset();
}

ZTEST_SUITE(st7789, NULL, NULL, preparar, NULL, NULL);

/* ---- Auxiliares --------------------------------------------------------- */

/* A inicializacao dorme 10 + 120 + 150 + 120 = 400 ms. */
static void esperar_init(void)
{
	k_sleep(K_MSEC(600));
}

/* Desenhar nao dorme: basta a thread do display rodar. */
static void esperar_desenho(void)
{
	k_sleep(K_MSEC(100));
}

static void confere_cmd(int i, uint8_t cmd, uint8_t n)
{
	zassert_true(i < bus.n_cmds, "comando %d nao enviado (so %d)", i, bus.n_cmds);
	zassert_equal(bus.cmds[i].cmd, cmd, "comando %d: 0x%02x, esperado 0x%02x", i,
		      bus.cmds[i].cmd, cmd);
	zassert_equal(bus.cmds[i].n, n, "comando 0x%02x com %u bytes, esperado %u", cmd,
		      bus.cmds[i].n, n);
}

static void confere_coords(int i, uint8_t cmd, uint16_t ini, uint16_t fim)
{
	const uint8_t *d = bus.cmds[i].dados;

	confere_cmd(i, cmd, 4);
	zassert_equal((d[0] << 8) | d[1], ini, "0x%02x comeca em %u, esperado %u", cmd,
		      (d[0] << 8) | d[1], ini);
	zassert_equal((d[2] << 8) | d[3], fim, "0x%02x termina em %u, esperado %u", cmd,
		      (d[2] << 8) | d[3], fim);
}

/* Sequencia de inicializacao completa nos 5 primeiros comandos. */
static void confere_init(void)
{
	zassert_equal(fake_gpio_pin_configure_dt_fake.call_count, 2);
	zassert_true(pino_e(fake_gpio_pin_configure_dt_fake.arg0_history[0], PINO_DC));
	zassert_true(pino_e(fake_gpio_pin_configure_dt_fake.arg0_history[1], PINO_RESET));
	zassert_equal(fake_gpio_pin_configure_dt_fake.arg1_history[0], GPIO_OUTPUT_INACTIVE);
	zassert_equal(fake_gpio_pin_configure_dt_fake.arg1_history[1], GPIO_OUTPUT_INACTIVE);

	/* Reset ativo em baixo: 1 prende, 0 solta. */
	zassert_equal(bus.n_reset, 2);
	zassert_equal(bus.reset_nivel[0], 1);
	zassert_equal(bus.reset_nivel[1], 0);

	confere_cmd(0, CMD_SWRESET, 0);
	confere_cmd(1, CMD_SLPOUT, 0);
	confere_cmd(2, CMD_COLMOD, 1);
	zassert_equal(bus.cmds[2].dados[0], 0x55, "COLMOD deve pedir RGB565");
	confere_cmd(3, CMD_MADCTL, 1);
	zassert_equal(bus.cmds[3].dados[0], 0x00);
	confere_cmd(4, CMD_DISPON, 0);
}

/* Pixels acesos que o texto deve ter: bits do glifo vezes escala ao quadrado. */
static uint32_t acesos_esperados(const char *s, uint8_t escala)
{
	uint32_t n = 0;

	for (size_t i = 0; s[i] != '\0'; i++) {
		const uint8_t *g = font_glyph(s[i]);

		for (int col = 0; g != NULL && col < FONT_COLS; col++) {
			for (int linha = 0; linha < FONT_ROWS; linha++) {
				n += (g[col] >> linha) & 1U;
			}
		}
	}
	return n * escala * escala;
}

/* Le o texto desenhado na janela comparando cada celula com a fonte.
 * Celula apagada vira espaco; desenho que nao e glifo vira '#'.
 */
static void decodifica(const struct janela_reg *j, char *out, size_t tam)
{
	static const char tabela[] = " ABCDEFGHIJKLMNOPQRSTUVWXYZ0123456789.-";
	size_t n = (size_t)(j->x1 - j->x0 + 1) / (FONT_ADVANCE * j->escala);
	size_t i;

	for (i = 0; i < n && i + 1 < tam; i++) {
		const uint8_t *cel = &j->col[i * FONT_ADVANCE];

		out[i] = '#';
		if (cel[FONT_COLS] != 0) {
			continue; /* a coluna de espacamento tem que ficar apagada */
		}
		for (size_t k = 0; k < sizeof(tabela) - 1; k++) {
			if (memcmp(cel, font_glyph(tabela[k]), FONT_COLS) == 0) {
				out[i] = tabela[k];
				break;
			}
		}
	}
	out[i] = '\0';
}

/* Confere a janela @p jan e os comandos que a abriram (a partir de @p cmd0):
 * @p s centralizado na linha @p y com a escala dada, lido como @p visto.
 */
static void confere_texto(int jan, int cmd0, const char *s, const char *visto,
			  uint8_t escala, uint16_t y)
{
	uint16_t w = (uint16_t)(strlen(s) * FONT_ADVANCE * escala);
	uint16_t h = (uint16_t)(FONT_ROWS * escala);
	uint16_t x = (uint16_t)((ST7789_WIDTH - w) / 2);
	const struct janela_reg *j;
	char lido[32];

	confere_coords(cmd0, CMD_CASET, x, x + w - 1);
	confere_coords(cmd0 + 1, CMD_RASET, y, y + h - 1);
	confere_cmd(cmd0 + 2, CMD_RAMWR, 0);

	zassert_true(jan < bus.n_jan, "janela %d nao aberta", jan);
	j = &bus.jan[jan];
	zassert_equal(j->escala, escala);
	zassert_equal(j->bytes, (uint32_t)w * h * 2, "'%s': %u bytes, esperado %u", s,
		      j->bytes, (uint32_t)w * h * 2);
	zassert_equal(j->excesso, 0);
	zassert_equal(j->outros, 0, "so branco e preto");
	zassert_equal(j->acesos, acesos_esperados(s, escala), "'%s': %u acesos, esperado %u",
		      s, j->acesos, acesos_esperados(s, escala));
	decodifica(j, lido, sizeof(lido));
	zassert_str_equal(lido, visto, "lido '%s', esperado '%s'", lido, visto);
}

/* Os tres textos da cobranca a partir da janela @p jan e do comando @p cmd0. */
static void confere_cobranca(int jan, int cmd0, const char *valor)
{
	confere_texto(jan, cmd0, valor, valor, 3, 120);
	confere_texto(jan + 1, cmd0 + 3, "SIMULATED PAYMENT", "SIMULATED PAYMENT", 2, 200);
	confere_texto(jan + 2, cmd0 + 6, "NOT PIX", "NOT PIX", 2, 240);
}

/* Nada de lixo no barramento. */
static void confere_barramento_limpo(void)
{
	zassert_equal(bus.dados_soltos, 0);
	zassert_equal(bus.estouro, 0);
	zassert_equal(bus.spec_errado, 0);
}

/* Enfileira a placa e confere que o numero e o seguinte ao ultimo. */
static uint32_t pede_placa(const char *plate)
{
	uint32_t t = 0;

	zassert_equal(st7789_show_plate(plate, &t), 0, "placa '%s' recusada", plate);
	zassert_equal(t, emitidos + 1U, "numero %u, esperado %u", t, emitidos + 1U);
	emitidos = t;
	return t;
}

/* Enfileira a cobranca e confere que o numero e o seguinte ao ultimo. */
static uint32_t pede_cobranca(uint32_t cents)
{
	uint32_t t = 0;

	zassert_equal(st7789_show_charge(cents, &t), 0, "%u centavos recusados", cents);
	zassert_equal(t, emitidos + 1U, "numero %u, esperado %u", t, emitidos + 1U);
	emitidos = t;
	return t;
}

/* O pedido @p t terminou, com falha ou desenhado. Uma falha publica o numero
 * em st7789_failed(); um pedido desenhado nao mexe na ultima falha.
 */
static void confere_fim(uint32_t t, bool falhou)
{
	if (falhou) {
		ultima_falha = t;
	}
	zassert_equal(st7789_done(), t, "concluido %u, esperado %u", st7789_done(), t);
	zassert_equal(st7789_failed(), ultima_falha, "falho %u, esperado %u",
		      st7789_failed(), ultima_falha);
}

/* ---- Boot sem SPI, pedidos recusados e inicializacao que falha ---------- */

ZTEST(st7789, test_00_boot_sem_spi_pronto_nao_inicializa)
{
	spi_pronto(false);
	zassert_equal(st7789_start(), 0);
	/* O teste roda numa thread cooperativa: a do display so comeca no sleep. */
	zassert_equal(fake_spi_is_ready_dt_fake.call_count, 0);

	esperar_desenho();
	/* A thread tentou inicializar sozinha, sem pedido nenhum, e desistiu
	 * antes de tocar nos pinos.
	 */
	zassert_equal(fake_spi_is_ready_dt_fake.call_count, 1);
	zassert_equal(fake_gpio_is_ready_dt_fake.call_count, 0);
	zassert_equal(fake_gpio_pin_configure_dt_fake.call_count, 0);
	zassert_equal(bus.n_reset, 0);
	zassert_equal(bus.escritas, 0);
	/* A falha do boot nao e de pedido nenhum. */
	zassert_equal(st7789_done(), 0);
	zassert_equal(st7789_failed(), 0);
	confere_barramento_limpo();
}

ZTEST(st7789, test_01_pedido_invalido_e_recusado_sem_gastar_numero)
{
	uint32_t t = 0xdeadU;

	zassert_equal(st7789_show_plate(NULL, &t), -EINVAL);
	zassert_equal(st7789_show_plate("", &t), -EINVAL);
	zassert_equal(st7789_show_plate("ABC123", &t), -EINVAL);
	zassert_equal(st7789_show_plate("ABCD1234", &t), -EINVAL);
	zassert_equal(st7789_show_plate("ABC1D23", NULL), -EINVAL);
	zassert_equal(st7789_show_charge(400, NULL), -EINVAL);
	zassert_equal(t, 0xdeadU, "pedido recusado nao recebe numero");
	esperar_desenho();

	/* Nada chegou a thread: ela nem tentou inicializar de novo. */
	zassert_equal(fake_spi_is_ready_dt_fake.call_count, 0);
	zassert_equal(bus.escritas, 0);
	zassert_equal(st7789_done(), 0);
	zassert_equal(st7789_failed(), 0);
	/* O primeiro pedido aceito (no proximo teste) ainda recebe o 1. */
}

ZTEST(st7789, test_02_fila_cheia_nao_gasta_numero_e_cada_pedido_tenta_inicializar)
{
	uint32_t t = 0xdeadU;
	uint32_t c;

	spi_pronto(false);

	/* A thread ja espera na fila: o primeiro pedido vai direto para ela e
	 * os FILA seguintes ocupam a fila (numeros 1 a FILA + 1).
	 */
	for (int i = 0; i < FILA + 1; i++) {
		(void)pede_placa("ABC1D23");
	}
	zassert_equal(emitidos, FILA + 1);
	zassert_equal(st7789_show_plate("ABC1D23", &t), -ENOMSG);
	zassert_equal(st7789_show_charge(400, &t), -ENOMSG);
	zassert_equal(t, 0xdeadU, "pedido recusado nao recebe numero");
	zassert_equal(st7789_done(), 0, "nada termina antes de a thread rodar");

	esperar_init();
	/* Cada pedido tentou inicializar, desistiu antes dos pinos e falhou. */
	zassert_equal(fake_spi_is_ready_dt_fake.call_count, FILA + 1);
	zassert_equal(fake_gpio_is_ready_dt_fake.call_count, 0);
	zassert_equal(fake_gpio_pin_configure_dt_fake.call_count, 0);
	zassert_equal(bus.n_reset, 0);
	zassert_equal(bus.escritas, 0);
	confere_fim(emitidos, true);

	/* A fila esvaziou: a cobranca volta a ser aceita, com o numero seguinte
	 * ao ultimo aceito (as recusas nao gastaram numero), e tenta de novo.
	 */
	c = pede_cobranca(400);
	zassert_equal(c, FILA + 2);
	esperar_init();
	zassert_equal(fake_spi_is_ready_dt_fake.call_count, FILA + 2);
	zassert_equal(bus.escritas, 0);
	confere_fim(c, true);
	confere_barramento_limpo();
}

ZTEST(st7789, test_03_pino_dc_nao_pronto)
{
	uint32_t t;

	pino_pronto(PINO_DC, false);
	t = pede_placa("ABC1D23");
	esperar_init();

	zassert_equal(fake_spi_is_ready_dt_fake.call_count, 1);
	zassert_equal(fake_gpio_is_ready_dt_fake.call_count, 1);
	zassert_true(pino_e(fake_gpio_is_ready_dt_fake.arg0_history[0], PINO_DC));
	zassert_equal(fake_gpio_pin_configure_dt_fake.call_count, 0);
	zassert_equal(bus.escritas, 0);
	confere_fim(t, true);
	confere_barramento_limpo();
}

ZTEST(st7789, test_04_pino_reset_nao_pronto)
{
	uint32_t t;

	pino_pronto(PINO_RESET, false);
	t = pede_placa("ABC1D23");
	esperar_init();

	zassert_equal(fake_gpio_is_ready_dt_fake.call_count, 2);
	zassert_true(pino_e(fake_gpio_is_ready_dt_fake.arg0_history[0], PINO_DC));
	zassert_true(pino_e(fake_gpio_is_ready_dt_fake.arg0_history[1], PINO_RESET));
	zassert_equal(fake_gpio_pin_configure_dt_fake.call_count, 0);
	zassert_equal(bus.escritas, 0);
	confere_fim(t, true);
	confere_barramento_limpo();
}

ZTEST(st7789, test_05_erro_ao_configurar_dc)
{
	uint32_t t;

	pino_erro_config(PINO_DC, -EIO);
	t = pede_placa("ABC1D23");
	esperar_init();

	/* Desiste no primeiro pino: o reset nem e configurado nem pulsado. */
	zassert_equal(fake_gpio_pin_configure_dt_fake.call_count, 1);
	zassert_true(pino_e(fake_gpio_pin_configure_dt_fake.arg0_history[0], PINO_DC));
	zassert_equal(fake_gpio_pin_set_dt_fake.call_count, 0);
	zassert_equal(bus.escritas, 0);
	confere_fim(t, true);
	confere_barramento_limpo();
}

ZTEST(st7789, test_06_erro_ao_configurar_reset)
{
	uint32_t t;

	pino_erro_config(PINO_RESET, -EIO);
	t = pede_cobranca(400);
	esperar_init();

	zassert_equal(fake_gpio_pin_configure_dt_fake.call_count, 2);
	zassert_true(pino_e(fake_gpio_pin_configure_dt_fake.arg0_history[1], PINO_RESET));
	zassert_equal(fake_gpio_pin_set_dt_fake.call_count, 0);
	zassert_equal(bus.escritas, 0);
	confere_fim(t, true);
	confere_barramento_limpo();
}

/* Faz a escrita @p n da inicializacao falhar e confere que ela parou ali: os
 * comandos antes dela foram enviados, a placa nao foi desenhada e o pedido
 * terminou com falha.
 */
static void falha_na_init(int n, int cmds_enviados)
{
	uint32_t t;

	spi_falha_na_escrita(n, -EIO);
	t = pede_placa("ABC1D23");
	esperar_init();

	zassert_equal(bus.n_reset, 2, "o reset por hardware vem antes do SPI");
	zassert_equal(bus.escritas, n, "%d escritas, esperado %d", bus.escritas, n);
	zassert_equal(bus.n_cmds, cmds_enviados);
	zassert_equal(bus.n_jan, 0, "nada pode ser desenhado");
	confere_fim(t, true);
	confere_barramento_limpo();
}

ZTEST(st7789, test_07_erro_spi_no_swreset)
{
	falha_na_init(1, 0);
}

ZTEST(st7789, test_08_erro_spi_no_slpout)
{
	falha_na_init(2, 1);
	confere_cmd(0, CMD_SWRESET, 0);
}

ZTEST(st7789, test_09_erro_spi_no_comando_colmod)
{
	falha_na_init(3, 2);
	confere_cmd(1, CMD_SLPOUT, 0);
}

ZTEST(st7789, test_10_erro_spi_no_dado_do_colmod)
{
	/* O comando passou e o parametro falhou: MADCTL nao pode vir depois. */
	falha_na_init(4, 3);
	confere_cmd(2, CMD_COLMOD, 0);
}

ZTEST(st7789, test_11_erro_spi_no_comando_madctl)
{
	falha_na_init(5, 3);
	confere_cmd(2, CMD_COLMOD, 1);
}

ZTEST(st7789, test_12_erro_spi_no_dado_do_madctl)
{
	falha_na_init(6, 4);
	confere_cmd(3, CMD_MADCTL, 0);
}

ZTEST(st7789, test_13_erro_spi_no_dispon)
{
	falha_na_init(7, 4);
	confere_cmd(3, CMD_MADCTL, 1);
}

/* ---- Inicializacao no pedido e desenho --------------------------------- */

ZTEST(st7789, test_14_inicializa_no_pedido_seguinte_e_desenha_a_placa)
{
	uint32_t t = pede_placa("ABC1D23");

	/* Reset preso 10 ms e solto; aos 50 ms ainda corre a recuperacao de
	 * 120 ms: nenhum comando saiu e o pedido nao terminou.
	 */
	k_sleep(K_MSEC(50));
	zassert_equal(bus.n_reset, 2);
	zassert_equal(bus.escritas, 0, "comando durante a recuperacao do reset");
	zassert_equal(st7789_done(), t - 1U, "pedido concluido durante a inicializacao");

	esperar_init();
	/* Depois de todas as falhas a inicializacao recomeca do zero. */
	confere_init();
	zassert_equal(bus.n_cmds, 5 + 3);
	zassert_equal(bus.n_jan, 1);
	confere_texto(0, 5, "ABC1D23", "ABC1D23", 4, 40);
	zassert_equal(bus.escritas, ESCRITAS_INIT + ESCRITAS_TEXTO(4));
	/* Desenhado: conclui sem mexer na ultima falha (a do teste anterior). */
	confere_fim(t, false);
	zassert_equal(st7789_failed(), t - 1U);
	confere_barramento_limpo();
}

ZTEST(st7789, test_15_ja_inicializado_nao_inicializa_de_novo)
{
	uint32_t t = pede_placa("XYZ9876");

	esperar_desenho();

	zassert_equal(fake_spi_is_ready_dt_fake.call_count, 0);
	zassert_equal(fake_gpio_pin_configure_dt_fake.call_count, 0);
	zassert_equal(bus.n_reset, 0);
	zassert_equal(bus.n_cmds, 3);
	confere_texto(0, 0, "XYZ9876", "XYZ9876", 4, 40);
	zassert_equal(bus.escritas, ESCRITAS_TEXTO(4));
	confere_fim(t, false);
	confere_barramento_limpo();
}

ZTEST(st7789, test_16_caractere_fora_da_fonte_fica_apagado)
{
	/* '?' e 'q' nao estao na fonte: a celula sai apagada, como um espaco. */
	uint32_t t = pede_placa("A?-1.q2");

	esperar_desenho();

	confere_texto(0, 0, "A?-1.q2", "A -1. 2", 4, 40);
	confere_fim(t, false);
	confere_barramento_limpo();
}

ZTEST(st7789, test_17_cobranca_em_reais_com_centavos)
{
	uint32_t t = pede_cobranca(400);

	esperar_desenho();

	zassert_equal(bus.n_cmds, 9);
	zassert_equal(bus.n_jan, 3);
	confere_cobranca(0, 0, "BRL 4.00");
	zassert_equal(bus.escritas, ESCRITAS_TEXTO(3) + 2 * ESCRITAS_TEXTO(2));
	confere_fim(t, false);
	confere_barramento_limpo();
}

ZTEST(st7789, test_18_formato_do_valor)
{
	static const struct {
		uint32_t cents;
		const char *texto;
	} casos[] = {
		{ 0, "BRL 0.00" },
		{ 5, "BRL 0.05" },
		{ 99, "BRL 0.99" },
		{ 100, "BRL 1.00" },
		{ 12345, "BRL 123.45" },
		{ 1000000, "BRL 10000.00" },
		/* O maior que cabe: 13 caracteres x 18 px = 234 px. */
		{ 99999999, "BRL 999999.99" },
	};

	for (size_t i = 0; i < ARRAY_SIZE(casos); i++) {
		uint32_t t;

		fakes_reset();
		t = pede_cobranca(casos[i].cents);
		esperar_desenho();
		zassert_equal(bus.n_jan, 3, "%u centavos", casos[i].cents);
		confere_cobranca(0, 0, casos[i].texto);
		confere_fim(t, false);
		confere_barramento_limpo();
	}
}

ZTEST(st7789, test_19_valor_que_nao_cabe_na_tela_falha_sem_desenhar_o_status)
{
	static const uint32_t grandes[] = { 100000000U, UINT32_MAX };

	/* "BRL 1000000.00" tem 14 caracteres x 18 px = 252 px > 240: a janela
	 * do valor e recusada antes de qualquer escrita e a cobranca para ali,
	 * sem o status: o pedido termina com falha.
	 */
	for (size_t i = 0; i < ARRAY_SIZE(grandes); i++) {
		uint32_t t;

		fakes_reset();
		t = pede_cobranca(grandes[i]);
		esperar_desenho();
		zassert_equal(bus.escritas, 0, "%u centavos", grandes[i]);
		zassert_equal(bus.n_cmds, 0);
		zassert_equal(bus.n_jan, 0);
		confere_fim(t, true);
		confere_barramento_limpo();
	}
}

ZTEST(st7789, test_20_ordem_placa_e_valor_no_barramento)
{
	uint32_t antes = emitidos;
	uint32_t p = pede_placa("BRA2E19");
	uint32_t c = pede_cobranca(1250);

	zassert_equal(c, p + 1U);
	zassert_equal(st7789_done(), antes, "nada termina antes de a thread rodar");
	esperar_desenho();

	/* Placa primeiro, depois valor e status; a conclusao e a da cobranca. */
	zassert_equal(bus.n_jan, 4);
	confere_texto(0, 0, "BRA2E19", "BRA2E19", 4, 40);
	confere_cobranca(1, 3, "BRL 12.50");
	confere_fim(c, false);
	confere_barramento_limpo();
}

/* ---- Erros de SPI durante o desenho ------------------------------------ */

ZTEST(st7789, test_21_erro_spi_ao_abrir_a_janela_da_placa)
{
	/* Escritas 1 a 5: CASET, dados, RASET, dados, RAMWR. A falha para o
	 * texto ali; os comandos antes dela foram enviados.
	 */
	static const int cmds_enviados[] = { 0, 1, 1, 2, 2 };
	uint32_t t;

	for (int n = 1; n <= 5; n++) {
		fakes_reset();
		spi_falha_na_escrita(n, -EIO);
		t = pede_placa("ABC1D23");
		esperar_desenho();
		zassert_equal(bus.escritas, n, "falha na escrita %d", n);
		zassert_equal(bus.n_cmds, cmds_enviados[n - 1], "falha na escrita %d", n);
		zassert_equal(bus.n_jan, 0, "falha na escrita %d", n);
		confere_fim(t, true);
		confere_barramento_limpo();
	}
	confere_cmd(0, CMD_CASET, 4);
	confere_cmd(1, CMD_RASET, 4);

	/* O erro nao estraga o display: o proximo pedido sai inteiro. */
	fakes_reset();
	t = pede_placa("ABC1D23");
	esperar_desenho();
	confere_texto(0, 0, "ABC1D23", "ABC1D23", 4, 40);
	confere_fim(t, false);
}

ZTEST(st7789, test_22_erro_spi_nos_pixels_da_placa)
{
	const uint32_t bytes_linha = 7 * FONT_ADVANCE * 4 * 2;
	uint32_t t;

	/* Primeira linha de pixels. */
	spi_falha_na_escrita(6, -EIO);
	t = pede_placa("ABC1D23");
	esperar_desenho();
	zassert_equal(bus.escritas, 6);
	zassert_equal(bus.n_jan, 1);
	zassert_equal(bus.jan[0].bytes, 0);
	confere_fim(t, true);

	/* Linha 15 de 28: as 14 anteriores chegaram, nenhuma depois. */
	fakes_reset();
	spi_falha_na_escrita(5 + 15, -EIO);
	t = pede_placa("ABC1D23");
	esperar_desenho();
	zassert_equal(bus.escritas, 5 + 15);
	zassert_equal(bus.jan[0].bytes, 14 * bytes_linha);
	confere_fim(t, true);
	confere_barramento_limpo();
}

ZTEST(st7789, test_23_erro_spi_no_valor_para_a_cobranca)
{
	/* Falha na primeira linha de pixels do valor: o status nao vem. */
	uint32_t t;

	spi_falha_na_escrita(6, -EIO);
	t = pede_cobranca(400);
	esperar_desenho();
	zassert_equal(bus.escritas, 6);
	zassert_equal(bus.n_cmds, 3);
	zassert_equal(bus.n_jan, 1);
	zassert_equal(bus.jan[0].bytes, 0);
	confere_fim(t, true);
	confere_barramento_limpo();
}

ZTEST(st7789, test_24_erro_spi_no_simulated_payment_para_a_cobranca)
{
	/* Falha no CASET do segundo texto: o valor saiu inteiro, o resto nao. */
	uint32_t t;

	spi_falha_na_escrita(ESCRITAS_TEXTO(3) + 1, -EIO);
	t = pede_cobranca(400);
	esperar_desenho();
	zassert_equal(bus.escritas, ESCRITAS_TEXTO(3) + 1);
	zassert_equal(bus.n_cmds, 3);
	zassert_equal(bus.n_jan, 1);
	confere_texto(0, 0, "BRL 4.00", "BRL 4.00", 3, 120);
	confere_fim(t, true);
	confere_barramento_limpo();
}

ZTEST(st7789, test_25_erro_spi_no_not_pix_e_a_cobranca_seguinte_sai_inteira)
{
	/* Falha na primeira linha de pixels do terceiro texto: valor e
	 * SIMULATED PAYMENT inteiros, NOT PIX sem pixel, pedido com falha.
	 */
	uint32_t t;

	spi_falha_na_escrita(ESCRITAS_TEXTO(3) + ESCRITAS_TEXTO(2) + 6, -EIO);
	t = pede_cobranca(400);
	esperar_desenho();
	zassert_equal(bus.escritas, ESCRITAS_TEXTO(3) + ESCRITAS_TEXTO(2) + 6);
	zassert_equal(bus.n_jan, 3);
	confere_texto(0, 0, "BRL 4.00", "BRL 4.00", 3, 120);
	confere_texto(1, 3, "SIMULATED PAYMENT", "SIMULATED PAYMENT", 2, 200);
	confere_cmd(8, CMD_RAMWR, 0);
	zassert_equal(bus.jan[2].bytes, 0);
	confere_fim(t, true);
	confere_barramento_limpo();

	/* O pedido seguinte desenha tudo e nao apaga a falha anterior. */
	fakes_reset();
	t = pede_cobranca(400);
	esperar_desenho();
	confere_cobranca(0, 0, "BRL 4.00");
	confere_fim(t, false);
	zassert_equal(st7789_failed(), t - 1U);
}

/* ---- Boot com os drivers prontos --------------------------------------- */

static void acha_display(const struct k_thread *thread, void *dado)
{
	const char *nome = k_thread_name_get((k_tid_t)thread);

	if (nome != NULL && strcmp(nome, "display") == 0) {
		*(k_tid_t *)dado = (k_tid_t)thread;
	}
}

ZTEST(st7789, test_26_boot_com_drivers_prontos_inicializa_antes_do_primeiro_pedido)
{
	k_tid_t display = NULL;
	uint32_t feito = st7789_done();
	uint32_t t;

	/* Encerra a thread do display (parada na fila) e cria outra, como num
	 * boot novo, agora com SPI e pinos prontos.
	 */
	k_thread_foreach(acha_display, &display);
	zassert_not_null(display, "thread do display nao encontrada");
	k_thread_abort(display);

	zassert_equal(st7789_start(), 0);
	esperar_init();

	/* Inicializou inteira sem pedido nenhum, e isso nao conclui pedido. */
	confere_init();
	zassert_equal(bus.n_cmds, 5);
	zassert_equal(bus.n_jan, 0);
	zassert_equal(bus.escritas, ESCRITAS_INIT);
	zassert_equal(st7789_done(), feito);
	confere_barramento_limpo();

	/* O primeiro pedido ja desenha, sem os 400 ms da inicializacao. */
	fakes_reset();
	t = pede_placa("ABC1D23");
	esperar_desenho();
	zassert_equal(fake_spi_is_ready_dt_fake.call_count, 0);
	zassert_equal(fake_gpio_pin_configure_dt_fake.call_count, 0);
	zassert_equal(bus.n_reset, 0);
	confere_texto(0, 0, "ABC1D23", "ABC1D23", 4, 40);
	zassert_equal(bus.escritas, ESCRITAS_TEXTO(4));
	confere_fim(t, false);
	confere_barramento_limpo();
}
```
