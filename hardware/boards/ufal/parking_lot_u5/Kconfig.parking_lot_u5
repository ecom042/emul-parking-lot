## hardware/boards/ufal/parking_lot_u5/board.yml
```yaml
board:
  name: parking_lot_u5
  full_name: Parking lot controller (STM32U5A5)
  vendor: ufal
  socs:
    - name: stm32u5a5xx
```

## hardware/dts/bindings/course,st7789v-reference.yaml
```yaml
description: Course native RGB565 ST7789V SPI subset
compatible: "course,st7789v-reference"
include: spi-device.yaml

properties:
  dc-gpios:
    type: phandle-array
    required: true
    description: Data/command select output; active selects data.
  reset-gpios:
    type: phandle-array
    required: true
    description: Hardware reset output (active low on this board).
```
